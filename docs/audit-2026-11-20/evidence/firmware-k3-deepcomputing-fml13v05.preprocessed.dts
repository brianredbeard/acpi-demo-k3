# 0 "/tmp/k3-independent-audit/platforms/Platform/Spacemit/K3/DeviceTree/k3-deepcomputing-fml13v05.dts"
# 0 "<built-in>"
# 0 "<command-line>"
# 1 "/tmp/k3-independent-audit/platforms/Platform/Spacemit/K3/DeviceTree/k3-deepcomputing-fml13v05.dts"
# 11 "/tmp/k3-independent-audit/platforms/Platform/Spacemit/K3/DeviceTree/k3-deepcomputing-fml13v05.dts"
/dts-v1/;

# 1 "/tmp/k3-independent-audit/platforms/Platform/Spacemit/K3/DeviceTree/K3Cpus.dtsi" 1







/ {
 cpus: cpus {
  #address-cells = <1>;
  #size-cells = <0>;

  timebase-frequency = <24000000>;

  cpu_0: cpu@0 {
   device_type = "cpu";
   reg = <0>;
   status = "okay";
   compatible = "riscv";
   riscv,isa = "rv64imafdcvh";
   riscv,isa-base = "rv64i";
   riscv,isa-extensions = "i", "m", "a", "f", "d", "c", "v", "h",
     "zicbom", "zicboz", "zicntr", "zicond", "zicsr",
     "zifencei", "zihintpause", "zihpm", "zfh", "zfhmin",
     "zba", "zbb", "zbc", "zbs", "zkt", "zvbb", "zvbc",
     "zvfh", "zvfhmin", "zvkb", "zvkg", "zvkn", "zvknc",
     "zvkned", "zvkng", "zvknha", "zvknhb", "zvks",
     "zvksc", "zvksed", "zvksh", "zvksg", "zvkt", "ssaia",
     "sscofpmf", "sstc", "svinval", "svnapot", "svpbmt",
     "smstateen";
   riscv,cbom-block-size = <64>;
   riscv,cboz-block-size = <64>;
   i-cache-block-size = <64>;
   i-cache-size = <65536>;
   i-cache-sets = <256>;
   d-cache-block-size = <64>;
   d-cache-size = <65536>;
   d-cache-sets = <256>;
   mmu-type = "riscv,sv39";
   cpu-cacheline = "64Bytes";
   cpu0_intc: interrupt-controller {
    #interrupt-cells = <1>;
    compatible = "riscv,cpu-intc";
    interrupt-controller;
   };
  };

  cpu_1: cpu@1 {
   device_type = "cpu";
   reg = <1>;
   status = "okay";
   compatible = "riscv";
   riscv,isa = "rv64imafdcvh";
   riscv,isa-base = "rv64i";
   riscv,isa-extensions = "i", "m", "a", "f", "d", "c", "v", "h",
     "zicbom", "zicboz", "zicntr", "zicond", "zicsr",
     "zifencei", "zihintpause", "zihpm", "zfh", "zfhmin",
     "zba", "zbb", "zbc", "zbs", "zkt", "zvbb", "zvbc",
     "zvfh", "zvfhmin", "zvkb", "zvkg", "zvkn", "zvknc",
     "zvkned", "zvkng", "zvknha", "zvknhb", "zvks",
     "zvksc", "zvksed", "zvksh", "zvksg", "zvkt", "ssaia",
     "sscofpmf", "sstc", "svinval", "svnapot", "svpbmt",
     "smstateen";
   riscv,cbom-block-size = <64>;
   riscv,cboz-block-size = <64>;
   i-cache-block-size = <64>;
   i-cache-size = <65536>;
   i-cache-sets = <256>;
   d-cache-block-size = <64>;
   d-cache-size = <65536>;
   d-cache-sets = <256>;
   mmu-type = "riscv,sv39";
   cpu-cacheline = "64Bytes";
   cpu1_intc: interrupt-controller {
    #interrupt-cells = <1>;
    compatible = "riscv,cpu-intc";
    interrupt-controller;
   };
  };

  cpu_2: cpu@2 {
   device_type = "cpu";
   reg = <2>;
   status = "okay";
   compatible = "riscv";
   riscv,isa = "rv64imafdcvh";
   riscv,isa-base = "rv64i";
   riscv,isa-extensions = "i", "m", "a", "f", "d", "c", "v", "h",
     "zicbom", "zicboz", "zicntr", "zicond", "zicsr",
     "zifencei", "zihintpause", "zihpm", "zfh", "zfhmin",
     "zba", "zbb", "zbc", "zbs", "zkt", "zvbb", "zvbc",
     "zvfh", "zvfhmin", "zvkb", "zvkg", "zvkn", "zvknc",
     "zvkned", "zvkng", "zvknha", "zvknhb", "zvks",
     "zvksc", "zvksed", "zvksh", "zvksg", "zvkt", "ssaia",
     "sscofpmf", "sstc", "svinval", "svnapot", "svpbmt",
     "smstateen";
   riscv,cbom-block-size = <64>;
   riscv,cboz-block-size = <64>;
   i-cache-block-size = <64>;
   i-cache-size = <65536>;
   i-cache-sets = <256>;
   d-cache-block-size = <64>;
   d-cache-size = <65536>;
   d-cache-sets = <256>;
   mmu-type = "riscv,sv39";

   cpu2_intc: interrupt-controller {
    #interrupt-cells = <1>;
    compatible = "riscv,cpu-intc";
    interrupt-controller;
   };
  };

  cpu_3: cpu@3 {
   device_type = "cpu";
   reg = <3>;
   status = "okay";
   compatible = "riscv";
   riscv,isa = "rv64imafdcvh";
   riscv,isa-base = "rv64i";
   riscv,isa-extensions = "i", "m", "a", "f", "d", "c", "v", "h",
     "zicbom", "zicboz", "zicntr", "zicond", "zicsr",
     "zifencei", "zihintpause", "zihpm", "zfh", "zfhmin",
     "zba", "zbb", "zbc", "zbs", "zkt", "zvbb", "zvbc",
     "zvfh", "zvfhmin", "zvkb", "zvkg", "zvkn", "zvknc",
     "zvkned", "zvkng", "zvknha", "zvknhb", "zvks",
     "zvksc", "zvksed", "zvksh", "zvksg", "zvkt", "ssaia",
     "sscofpmf", "sstc", "svinval", "svnapot", "svpbmt",
     "smstateen";
   riscv,cbom-block-size = <64>;
   riscv,cboz-block-size = <64>;
   i-cache-block-size = <64>;
   i-cache-size = <65536>;
   i-cache-sets = <256>;
   d-cache-block-size = <64>;
   d-cache-size = <65536>;
   d-cache-sets = <256>;
   mmu-type = "riscv,sv39";

   cpu3_intc: interrupt-controller {
    #interrupt-cells = <1>;
    compatible = "riscv,cpu-intc";
    interrupt-controller;
   };
  };

  cpu_4: cpu@4 {
   device_type = "cpu";
   reg = <4>;
   status = "okay";
   compatible = "riscv";
   riscv,isa = "rv64imafdcvh";
   riscv,isa-base = "rv64i";
   riscv,isa-extensions = "i", "m", "a", "f", "d", "c", "v", "h",
     "zicbom", "zicboz", "zicntr", "zicond", "zicsr",
     "zifencei", "zihintpause", "zihpm", "zfh", "zfhmin",
     "zba", "zbb", "zbc", "zbs", "zkt", "zvbb", "zvbc",
     "zvfh", "zvfhmin", "zvkb", "zvkg", "zvkn", "zvknc",
     "zvkned", "zvkng", "zvknha", "zvknhb", "zvks",
     "zvksc", "zvksed", "zvksh", "zvksg", "zvkt", "ssaia",
     "sscofpmf", "sstc", "svinval", "svnapot", "svpbmt",
     "smstateen";
   riscv,cbom-block-size = <64>;
   riscv,cboz-block-size = <64>;
   i-cache-block-size = <64>;
   i-cache-size = <65536>;
   i-cache-sets = <256>;
   d-cache-block-size = <64>;
   d-cache-size = <65536>;
   d-cache-sets = <256>;
   mmu-type = "riscv,sv39";

   cpu4_intc: interrupt-controller {
    #interrupt-cells = <1>;
    compatible = "riscv,cpu-intc";
    interrupt-controller;
   };
  };

  cpu_5: cpu@5 {
   device_type = "cpu";
   reg = <5>;
   status = "okay";
   compatible = "riscv";
   riscv,isa = "rv64imafdcvh";
   riscv,isa-base = "rv64i";
   riscv,isa-extensions = "i", "m", "a", "f", "d", "c", "v", "h",
     "zicbom", "zicboz", "zicntr", "zicond", "zicsr",
     "zifencei", "zihintpause", "zihpm", "zfh", "zfhmin",
     "zba", "zbb", "zbc", "zbs", "zkt", "zvbb", "zvbc",
     "zvfh", "zvfhmin", "zvkb", "zvkg", "zvkn", "zvknc",
     "zvkned", "zvkng", "zvknha", "zvknhb", "zvks",
     "zvksc", "zvksed", "zvksh", "zvksg", "zvkt", "ssaia",
     "sscofpmf", "sstc", "svinval", "svnapot", "svpbmt",
     "smstateen";
   riscv,cbom-block-size = <64>;
   riscv,cboz-block-size = <64>;
   i-cache-block-size = <64>;
   i-cache-size = <65536>;
   i-cache-sets = <256>;
   d-cache-block-size = <64>;
   d-cache-size = <65536>;
   d-cache-sets = <256>;
   mmu-type = "riscv,sv39";

   cpu5_intc: interrupt-controller {
    #interrupt-cells = <1>;
    compatible = "riscv,cpu-intc";
    interrupt-controller;
   };
  };

  cpu_6: cpu@6 {
   device_type = "cpu";
   reg = <6>;
   status = "okay";
   compatible = "riscv";
   riscv,isa = "rv64imafdcvh";
   riscv,isa-base = "rv64i";
   riscv,isa-extensions = "i", "m", "a", "f", "d", "c", "v", "h",
     "zicbom", "zicboz", "zicntr", "zicond", "zicsr",
     "zifencei", "zihintpause", "zihpm", "zfh", "zfhmin",
     "zba", "zbb", "zbc", "zbs", "zkt", "zvbb", "zvbc",
     "zvfh", "zvfhmin", "zvkb", "zvkg", "zvkn", "zvknc",
     "zvkned", "zvkng", "zvknha", "zvknhb", "zvks",
     "zvksc", "zvksed", "zvksh", "zvksg", "zvkt", "ssaia",
     "sscofpmf", "sstc", "svinval", "svnapot", "svpbmt",
     "smstateen";
   riscv,cbom-block-size = <64>;
   riscv,cboz-block-size = <64>;
   i-cache-block-size = <64>;
   i-cache-size = <65536>;
   i-cache-sets = <256>;
   d-cache-block-size = <64>;
   d-cache-size = <65536>;
   d-cache-sets = <256>;
   mmu-type = "riscv,sv39";

   cpu6_intc: interrupt-controller {
    #interrupt-cells = <1>;
    compatible = "riscv,cpu-intc";
    interrupt-controller;
   };
  };

  cpu_7: cpu@7 {
   device_type = "cpu";
   reg = <7>;
   status = "okay";
   compatible = "riscv";
   riscv,isa = "rv64imafdcvh";
   riscv,isa-base = "rv64i";
   riscv,isa-extensions = "i", "m", "a", "f", "d", "c", "v", "h",
     "zicbom", "zicboz", "zicntr", "zicond", "zicsr",
     "zifencei", "zihintpause", "zihpm", "zfh", "zfhmin",
     "zba", "zbb", "zbc", "zbs", "zkt", "zvbb", "zvbc",
     "zvfh", "zvfhmin", "zvkb", "zvkg", "zvkn", "zvknc",
     "zvkned", "zvkng", "zvknha", "zvknhb", "zvks",
     "zvksc", "zvksed", "zvksh", "zvksg", "zvkt", "ssaia",
     "sscofpmf", "sstc", "svinval", "svnapot", "svpbmt",
     "smstateen";
   riscv,cbom-block-size = <64>;
   riscv,cboz-block-size = <64>;
   i-cache-block-size = <64>;
   i-cache-size = <65536>;
   i-cache-sets = <256>;
   d-cache-block-size = <64>;
   d-cache-size = <65536>;
   d-cache-sets = <256>;
   mmu-type = "riscv,sv39";

   cpu7_intc: interrupt-controller {
    #interrupt-cells = <1>;
    compatible = "riscv,cpu-intc";
    interrupt-controller;
   };
  };

  cpu_8: cpu@8 {
   device_type = "cpu";
   reg = <8>;
   status = "okay";
   compatible = "riscv";
   riscv,isa = "rv64imafdcv";
   riscv,isa-base = "rv64i";
   riscv,isa-extensions = "i", "m", "a", "f", "d", "c", "v",
     "zicbom", "zicboz", "zicntr", "zicond", "zicsr",
     "zifencei", "zihintpause", "zihpm", "zfh", "zfhmin",
     "zba", "zbb", "zbc", "zbs", "zkt", "zvbb", "zvbc",
     "zvfh", "zvfhmin", "zvkb", "zvkg", "zvkn", "zvknc",
     "zvkned", "zvkng", "zvknha", "zvknhb", "zvks",
     "zvksc", "zvksed", "zvksh", "zvksg", "zvkt", "ssaia",
     "sscofpmf", "sstc", "svinval", "svnapot", "svpbmt" ;
   riscv,cbom-block-size = <64>;
   riscv,cboz-block-size = <64>;
   i-cache-block-size = <64>;
   i-cache-size = <65536>;
   i-cache-sets = <256>;
   d-cache-block-size = <64>;
   d-cache-size = <65536>;
   d-cache-sets = <256>;
   mmu-type = "riscv,sv39";

   cpu8_intc: interrupt-controller {
    #interrupt-cells = <1>;
    compatible = "riscv,cpu-intc";
    interrupt-controller;
   };
  };

  cpu_9: cpu@9 {
   device_type = "cpu";
   reg = <9>;
   status = "okay";
   compatible = "riscv";
   riscv,isa = "rv64imafdcv";
   riscv,isa-base = "rv64i";
   riscv,isa-extensions = "i", "m", "a", "f", "d", "c", "v",
     "zicbom", "zicboz", "zicntr", "zicond", "zicsr",
     "zifencei", "zihintpause", "zihpm", "zfh", "zfhmin",
     "zba", "zbb", "zbc", "zbs", "zkt", "zvbb", "zvbc",
     "zvfh", "zvfhmin", "zvkb", "zvkg", "zvkn", "zvknc",
     "zvkned", "zvkng", "zvknha", "zvknhb", "zvks",
     "zvksc", "zvksed", "zvksh", "zvksg", "zvkt", "ssaia",
     "sscofpmf", "sstc", "svinval", "svnapot", "svpbmt" ;
   riscv,cbom-block-size = <64>;
   riscv,cboz-block-size = <64>;
   i-cache-block-size = <64>;
   i-cache-size = <65536>;
   i-cache-sets = <256>;
   d-cache-block-size = <64>;
   d-cache-size = <65536>;
   d-cache-sets = <256>;
   mmu-type = "riscv,sv39";

   cpu9_intc: interrupt-controller {
    #interrupt-cells = <1>;
    compatible = "riscv,cpu-intc";
    interrupt-controller;
   };
  };

  cpu_10: cpu@10 {
   device_type = "cpu";
   reg = <10>;
   status = "okay";
   compatible = "riscv";
   riscv,isa = "rv64imafdcv";
   riscv,isa-base = "rv64i";
   riscv,isa-extensions = "i", "m", "a", "f", "d", "c", "v",
     "zicbom", "zicboz", "zicntr", "zicond", "zicsr",
     "zifencei", "zihintpause", "zihpm", "zfh", "zfhmin",
     "zba", "zbb", "zbc", "zbs", "zkt", "zvbb", "zvbc",
     "zvfh", "zvfhmin", "zvkb", "zvkg", "zvkn", "zvknc",
     "zvkned", "zvkng", "zvknha", "zvknhb", "zvks",
     "zvksc", "zvksed", "zvksh", "zvksg", "zvkt", "ssaia",
     "sscofpmf", "sstc", "svinval", "svnapot", "svpbmt" ;
   riscv,cbom-block-size = <64>;
   riscv,cboz-block-size = <64>;
   i-cache-block-size = <64>;
   i-cache-size = <65536>;
   i-cache-sets = <256>;
   d-cache-block-size = <64>;
   d-cache-size = <65536>;
   d-cache-sets = <256>;
   mmu-type = "riscv,sv39";

   cpu10_intc: interrupt-controller {
    #interrupt-cells = <1>;
    compatible = "riscv,cpu-intc";
    interrupt-controller;
   };
  };

  cpu_11: cpu@11 {
   device_type = "cpu";
   reg = <11>;
   status = "okay";
   compatible = "riscv";
   riscv,isa = "rv64imafdcv";
   riscv,isa-base = "rv64i";
   riscv,isa-extensions = "i", "m", "a", "f", "d", "c", "v",
     "zicbom", "zicboz", "zicntr", "zicond", "zicsr",
     "zifencei", "zihintpause", "zihpm", "zfh", "zfhmin",
     "zba", "zbb", "zbc", "zbs", "zkt", "zvbb", "zvbc",
     "zvfh", "zvfhmin", "zvkb", "zvkg", "zvkn", "zvknc",
     "zvkned", "zvkng", "zvknha", "zvknhb", "zvks",
     "zvksc", "zvksed", "zvksh", "zvksg", "zvkt", "ssaia",
     "sscofpmf", "sstc", "svinval", "svnapot", "svpbmt" ;
   riscv,cbom-block-size = <64>;
   riscv,cboz-block-size = <64>;
   i-cache-block-size = <64>;
   i-cache-size = <65536>;
   i-cache-sets = <256>;
   d-cache-block-size = <64>;
   d-cache-size = <65536>;
   d-cache-sets = <256>;
   mmu-type = "riscv,sv39";

   cpu11_intc: interrupt-controller {
    #interrupt-cells = <1>;
    compatible = "riscv,cpu-intc";
    interrupt-controller;
   };
  };

  cpu_12: cpu@12 {
   device_type = "cpu";
   reg = <12>;
   status = "okay";
   compatible = "riscv";
   riscv,isa = "rv64imafdcv";
   riscv,isa-base = "rv64i";
   riscv,isa-extensions = "i", "m", "a", "f", "d", "c", "v",
     "zicbom", "zicboz", "zicntr", "zicond", "zicsr",
     "zifencei", "zihintpause", "zihpm", "zfh", "zfhmin",
     "zba", "zbb", "zbc", "zbs", "zkt", "zvbb", "zvbc",
     "zvfh", "zvfhmin", "zvkb", "zvkg", "zvkn", "zvknc",
     "zvkned", "zvkng", "zvknha", "zvknhb", "zvks",
     "zvksc", "zvksed", "zvksh", "zvksg", "zvkt", "ssaia",
     "sscofpmf", "sstc", "svinval", "svnapot", "svpbmt" ;
   riscv,cbom-block-size = <64>;
   riscv,cboz-block-size = <64>;
   i-cache-block-size = <64>;
   i-cache-size = <65536>;
   i-cache-sets = <256>;
   d-cache-block-size = <64>;
   d-cache-size = <65536>;
   d-cache-sets = <256>;
   mmu-type = "riscv,sv39";

   cpu12_intc: interrupt-controller {
    #interrupt-cells = <1>;
    compatible = "riscv,cpu-intc";
    interrupt-controller;
   };
  };

  cpu_13: cpu@13 {
   device_type = "cpu";
   reg = <13>;
   status = "okay";
   compatible = "riscv";
   riscv,isa = "rv64imafdcv";
   riscv,isa-base = "rv64i";
   riscv,isa-extensions = "i", "m", "a", "f", "d", "c", "v",
     "zicbom", "zicboz", "zicntr", "zicond", "zicsr",
     "zifencei", "zihintpause", "zihpm", "zfh", "zfhmin",
     "zba", "zbb", "zbc", "zbs", "zkt", "zvbb", "zvbc",
     "zvfh", "zvfhmin", "zvkb", "zvkg", "zvkn", "zvknc",
     "zvkned", "zvkng", "zvknha", "zvknhb", "zvks",
     "zvksc", "zvksed", "zvksh", "zvksg", "zvkt", "ssaia",
     "sscofpmf", "sstc", "svinval", "svnapot", "svpbmt" ;
   riscv,cbom-block-size = <64>;
   riscv,cboz-block-size = <64>;
   i-cache-block-size = <64>;
   i-cache-size = <65536>;
   i-cache-sets = <256>;
   d-cache-block-size = <64>;
   d-cache-size = <65536>;
   d-cache-sets = <256>;
   mmu-type = "riscv,sv39";

   cpu13_intc: interrupt-controller {
    #interrupt-cells = <1>;
    compatible = "riscv,cpu-intc";
    interrupt-controller;
   };
  };

  cpu_14: cpu@14 {
   device_type = "cpu";
   reg = <14>;
   status = "okay";
   compatible = "riscv";
   riscv,isa = "rv64imafdcv";
   riscv,isa-base = "rv64i";
   riscv,isa-extensions = "i", "m", "a", "f", "d", "c", "v",
     "zicbom", "zicboz", "zicntr", "zicond", "zicsr",
     "zifencei", "zihintpause", "zihpm", "zfh", "zfhmin",
     "zba", "zbb", "zbc", "zbs", "zkt", "zvbb", "zvbc",
     "zvfh", "zvfhmin", "zvkb", "zvkg", "zvkn", "zvknc",
     "zvkned", "zvkng", "zvknha", "zvknhb", "zvks",
     "zvksc", "zvksed", "zvksh", "zvksg", "zvkt", "ssaia",
     "sscofpmf", "sstc", "svinval", "svnapot", "svpbmt" ;
   riscv,cbom-block-size = <64>;
   riscv,cboz-block-size = <64>;
   i-cache-block-size = <64>;
   i-cache-size = <65536>;
   i-cache-sets = <256>;
   d-cache-block-size = <64>;
   d-cache-size = <65536>;
   d-cache-sets = <256>;
   mmu-type = "riscv,sv39";

   cpu14_intc: interrupt-controller {
    #interrupt-cells = <1>;
    compatible = "riscv,cpu-intc";
    interrupt-controller;
   };
  };

  cpu_15: cpu@15 {
   device_type = "cpu";
   reg = <15>;
   status = "okay";
   compatible = "riscv";
   riscv,isa = "rv64imafdcv";
   riscv,isa-base = "rv64i";
   riscv,isa-extensions = "i", "m", "a", "f", "d", "c", "v",
     "zicbom", "zicboz", "zicntr", "zicond", "zicsr",
     "zifencei", "zihintpause", "zihpm", "zfh", "zfhmin",
     "zba", "zbb", "zbc", "zbs", "zkt", "zvbb", "zvbc",
     "zvfh", "zvfhmin", "zvkb", "zvkg", "zvkn", "zvknc",
     "zvkned", "zvkng", "zvknha", "zvknhb", "zvks",
     "zvksc", "zvksed", "zvksh", "zvksg", "zvkt", "ssaia",
     "sscofpmf", "sstc", "svinval", "svnapot", "svpbmt" ;
   riscv,cbom-block-size = <64>;
   riscv,cboz-block-size = <64>;
   i-cache-block-size = <64>;
   i-cache-size = <65536>;
   i-cache-sets = <256>;
   d-cache-block-size = <64>;
   d-cache-size = <65536>;
   d-cache-sets = <256>;
   mmu-type = "riscv,sv39";

   cpu15_intc: interrupt-controller {
    #interrupt-cells = <1>;
    compatible = "riscv,cpu-intc";
    interrupt-controller;
   };
  };
 };
};
# 14 "/tmp/k3-independent-audit/platforms/Platform/Spacemit/K3/DeviceTree/k3-deepcomputing-fml13v05.dts" 2
# 1 "/tmp/k3-independent-audit/platforms/Platform/Spacemit/K3/DeviceTree/K3.dtsi" 1







/ {
 compatible = "spacemit,k3", "riscv";
 #address-cells = <2>;
 #size-cells = <2>;

 chosen {
  stdout-path = "uart0:115200";
 };

 aliases {
  console = &uart0;
 };

 memory@100000000 {
  device_type = "memory";
  reg = <0x1 0x00000000 0x0 0x80000000>;
 };

 reserved-memory {
  #address-cells = <2>;
  #size-cells = <2>;
  ranges;

  rcpu0_pwr: rcpu0_pwr@100200000 {
   reg = <0x1 0x200000 0x0 0x200000>;
   no-map;
  };

  rcpu0_heap: rcpu0_heap@100400000 {
   reg = <0x1 0x400000 0x0 0x200000>;
   no-map;
  };

  rcpu0_vdev0buffer: vdev0buffer@100600000 {
   compatible = "shared-dma-pool";
   reg = <0x1 0x600000 0x0 0xfc000>;
   no-map;
  };

  rcpu0_rsc_table: rcpu0_rsc_table@1006fc000 {
   reg = <0x1 0x6fc000 0x0 0x4000>;
   no-map;
  };

  rcpu1_runtime: rcpu1_runtime@100800000 {
   reg = <0x1 0x800000 0x0 0x200000>;
   no-map;
  };

  rcpu1_heap: rcpu1_heap@100a00000 {
   reg = <0x1 0xa00000 0x0 0x200000>;
   no-map;
  };

  rcpu1_vdev0buffer: vdev0buffer@100c00000 {
   compatible = "shared-dma-pool";
   reg = <0x1 0xc00000 0x0 0xfc000>;
   no-map;
  };

  rcpu1_rsc_table: rcpu1_rsc_table@100cfc000 {
   reg = <0x1 0xcfc000 0x0 0x4000>;
   no-map;
  };

  rpmi0: rpmi0@100e00000 {
   reg = <0x1 0xe00000 0x0 0x4000>;
   no-map;
  };

  rcpu_dtb_table: rcpu_dtb_table@100d00000 {
   reg = <0x1 0xd00000 0x0 0x100000>;
   no-map;
  };
 };

 soc {
  #address-cells = <2>;
  #size-cells = <2>;
  compatible = "simple-bus";
  ranges;

  clint0: clint@f1810000 {
   compatible = "riscv,clint0";
   interrupts-extended = <&cpu0_intc 3 &cpu0_intc 7
    &cpu1_intc 3 &cpu1_intc 7
    &cpu2_intc 3 &cpu2_intc 7
    &cpu3_intc 3 &cpu3_intc 7
    &cpu4_intc 3 &cpu4_intc 7
    &cpu5_intc 3 &cpu5_intc 7
    &cpu6_intc 3 &cpu6_intc 7
    &cpu7_intc 3 &cpu7_intc 7
    &cpu8_intc 3 &cpu8_intc 7
    &cpu9_intc 3 &cpu9_intc 7
    &cpu10_intc 3 &cpu10_intc 7
    &cpu11_intc 3 &cpu11_intc 7
    &cpu12_intc 3 &cpu12_intc 7
    &cpu13_intc 3 &cpu13_intc 7
    &cpu14_intc 3 &cpu14_intc 7
    &cpu15_intc 3 &cpu15_intc 7
   >;
   reg = <0x0 0xf1810000 0x0 0x00010000>;
   clint,has-no-64bit-mmio;
  };

  maplic: interrupt-controller@f1800000 {
   compatible = "riscv,aplic";
   msi-parent = <&mimsic>;

   reg = <0x0 0xf1800000 0x0 0x4000>;
   interrupt-controller;
   #interrupt-cells = <2>;

   riscv,num-sources = <512>;
   riscv,children = <&saplic>;

   riscv,delegate = <&saplic 1 512>;
   status = "okay";
  };

  saplic: interrupt-controller@e0804000 {
   compatible = "riscv,aplic";

   reg = <0x0 0xe0804000 0x0 0x4000>;
   msi-parent = <&simsic>;
   #interrupt-cells = <2>;
   interrupt-controller;

   riscv,num-sources = <512>;
   status = "disabled";
  };

  mimsic: interrupt-controller@f1000000 {
   compatible = "riscv,imsics";
   interrupts-extended = <&cpu0_intc 11 &cpu1_intc 11
     &cpu2_intc 11 &cpu3_intc 11
     &cpu4_intc 11 &cpu5_intc 11
     &cpu6_intc 11 &cpu7_intc 11
     &cpu8_intc 11 &cpu9_intc 11
     &cpu10_intc 11 &cpu11_intc 11
     &cpu12_intc 11 &cpu13_intc 11
     &cpu14_intc 11 &cpu15_intc 11>;
   reg = <0x0 0xf1000000 0x0 0x10000>;
   interrupt-controller;
   #interrupt-cells = <0>;
   #msi-cells = <0>;
   msi-controller;

   riscv,num-ids = <511>;
   status = "okay";
  };

  simsic: interrupt-controller@e0400000 {
   compatible = "riscv,imsics";
   interrupts-extended = <&cpu0_intc 9 &cpu1_intc 9
    &cpu2_intc 9 &cpu3_intc 9
    &cpu4_intc 9 &cpu5_intc 9
    &cpu6_intc 9 &cpu7_intc 9
    &cpu8_intc 9 &cpu9_intc 9
    &cpu10_intc 9 &cpu11_intc 9
    &cpu12_intc 9 &cpu13_intc 9
    &cpu14_intc 9 &cpu15_intc 9>;
   reg = <0x0 0xe0400000 0x0 0x400000>;
   interrupt-controller;
   #interrupt-cells = <0>;
   #msi-cells = <0>;
   msi-controller;

   riscv,num-ids = <511>;

   riscv,num-guest-ids = <511>;

   riscv,hart-index-bits = <4>;
# 190 "/tmp/k3-independent-audit/platforms/Platform/Spacemit/K3/DeviceTree/K3.dtsi"
   riscv,guest-index-bits = <6>;
   status = "okay";
  };

  rpmi_shmem_mbox: rpmi-shmem-mbox@cac90c00 {
   compatible = "riscv,rpmi-shmem-mbox";
   reg = <0x1 0x00e00000 0x0 0x1000>,
    <0x1 0x00e01000 0x0 0x1000>,
    <0x1 0x00e02000 0x0 0x1000>,
    <0x1 0x00e03000 0x0 0x1000>,
    <0x0 0xcac90c00 0x0 0x100>;
   reg-names = "a2p-req", "p2a-ack", "p2a-req", "a2p-ack", "db-reg";
   riscv,slot-size = <256>;
   #mbox-cells = <1>;
   status = "okay";
  };

  rpmi_mpxy_clk: rpmi-mpxy-clk@0 {
   compatible = "riscv,rpmi-mpxy-clock";
   mboxes = <&rpmi_shmem_mbox 8>;
   riscv,sbi-mpxy-channel-id = <8>;
   status = "okay";
  };

  rpmi_mpxy_voltage: rpmi-mpxy-voltage@0 {
   compatible = "riscv,rpmi-mpxy-voltage";
   mboxes = <&rpmi_shmem_mbox 7>;
   riscv,sbi-mpxy-channel-id = <7>;
   status = "okay";
  };

  rpmi_system_suspend: rpmi-system-suspend@0 {
   compatible = "riscv,rpmi-system-suspend";
   mboxes = <&rpmi_shmem_mbox 4>;
   riscv,sbi-mpxy-channel-id = <4>;
   status = "okay";
  };

  rpmi_mpxy_hsm: rpmi-mpxy-hsm@0 {
   compatible = "riscv,rpmi-hsm";
   mboxes = <&rpmi_shmem_mbox 5>;
   riscv,sbi-mpxy-channel-id = <5>;
   status = "okay";
  };

  rpmi_mpxy_domain: rpmi-mpxy-domain@0 {
   compatible = "riscv,rpmi-mpxy-domain";
   mboxes = <&rpmi_shmem_mbox 9>;
   riscv,sbi-mpxy-channel-id = <9>;
   status = "okay";
  };

  rpmi_mpxy_rtc: rpmi-mpxy-rtc@0 {
   compatible = "riscv,rpmi-mpxy-rtc";
   mboxes = <&rpmi_shmem_mbox 14>;
   riscv,sbi-mpxy-channel-id = <14>;
   status = "okay";
  };

  rpmi_mpxy_pwrkey: rpmi-mpxy-pwrkey@0 {
   compatible = "riscv,rpmi-mpxy-pwrkey";
   mboxes = <&rpmi_shmem_mbox 15>;
   riscv,sbi-mpxy-channel-id = <15>;
   status = "okay";
  };

  rpmi_mpxy_sysreset: rpmi-mpxy-sysreset@0 {
   compatible = "riscv,rpmi-system-reset";
   mboxes = <&rpmi_shmem_mbox 3>;
   riscv,sbi-mpxy-channel-id = <3>;
   status = "okay";
  };

  uart0: uart@d4017000 {
   compatible = "ns16550";
   reg = <0x00000000 0xD4017000 0x00000000 0x00000100>;
   reg-shift = <2>;
   reg-io-width = <4>;
   clock-frequency = <14745600>;
   status = "okay";
  };

  pinctrl: pinctrl@d401e000 {
   compatible = "pinctrl-single";
   reg = <0x0 0xd401e000 0x0 0x400>;
   #address-cells = <1>;
   #size-cells = <1>;
   #pinctrl-cells = <2>;
   #gpio-range-cells = <3>;
   pinctrl-single,register-width = <32>;
   pinctrl-single,function-mask = <0xfff7>;

   range: gpio-range {
    #pinctrl-single,gpio-range-cells = <3>;
   };
  };

 };


 pmu {
  compatible = "riscv,pmu";

  riscv,event-to-mhpmevent =

   <0x00001 0x0 0x1e>,

   <0x00002 0x0 0x1f>,

   <0x00005 0x0 0x01>,

   <0x00006 0x0 0x02>,

   <0x00008 0x0 0x03>,

   <0x00009 0x0 0x04>,

   <0x10000 0x0 0x06>,

   <0x10001 0x0 0x05>,

   <0x10002 0x0 0x0a>,

   <0x10003 0x0 0x09>,

   <0x10004 0x0 0x08>,

   <0x10005 0x0 0x07>,

   <0x10008 0x0 0x0c>,

   <0x10009 0x0 0x0b>,

   <0x10018 0x0 0x16>,

   <0x1001a 0x0 0x1a>,

   <0x1001b 0x0 0x19>,

   <0x10020 0x0 0x1c>,

   <0x10021 0x0 0x1b>;







  riscv,event-to-mhpmcounters =
   <0x00001 0x00001 0x00020000>,
   <0x00002 0x00002 0x00040000>,
   <0x00005 0x00006 0x0001fff8>,
   <0x00008 0x00009 0x0001fff8>,
   <0x10000 0x10005 0x0001fff8>,
   <0x10008 0x10009 0x0001fff8>,
   <0x10018 0x10018 0x0001fff8>,
   <0x1001a 0x1001b 0x0001fff8>,
   <0x10020 0x10021 0x0001fff8>;







  riscv,raw-event-to-mhpmcounters =
   <0x0 0x01 0xffffffff 0xffffffff 0x0001fff8>,
   <0x0 0x02 0xffffffff 0xffffffff 0x0001fff8>,
   <0x0 0x03 0xffffffff 0xffffffff 0x0001fff8>,
   <0x0 0x04 0xffffffff 0xffffffff 0x0001fff8>,
   <0x0 0x05 0xffffffff 0xffffffff 0x0001fff8>,
   <0x0 0x06 0xffffffff 0xffffffff 0x0001fff8>,
   <0x0 0x07 0xffffffff 0xffffffff 0x0001fff8>,
   <0x0 0x08 0xffffffff 0xffffffff 0x0001fff8>,
   <0x0 0x09 0xffffffff 0xffffffff 0x0001fff8>,
   <0x0 0x0a 0xffffffff 0xffffffff 0x0001fff8>,
   <0x0 0x0b 0xffffffff 0xffffffff 0x0001fff8>,
   <0x0 0x0c 0xffffffff 0xffffffff 0x0001fff8>,
   <0x0 0x10 0xffffffff 0xffffffff 0x0001fff8>,
   <0x0 0x11 0xffffffff 0xffffffff 0x0001fff8>,
   <0x0 0x12 0xffffffff 0xffffffff 0x0001fff8>,
   <0x0 0x13 0xffffffff 0xffffffff 0x0001fff8>,
   <0x0 0x14 0xffffffff 0xffffffff 0x0001fff8>,
   <0x0 0x15 0xffffffff 0xffffffff 0x0001fff8>,
   <0x0 0x16 0xffffffff 0xffffffff 0x0001fff8>,
   <0x0 0x17 0xffffffff 0xffffffff 0x0001fff8>,
   <0x0 0x18 0xffffffff 0xffffffff 0x0001fff8>,
   <0x0 0x19 0xffffffff 0xffffffff 0x0001fff8>,
   <0x0 0x1a 0xffffffff 0xffffffff 0x0001fff8>,
   <0x0 0x1b 0xffffffff 0xffffffff 0x0001fff8>,
   <0x0 0x1c 0xffffffff 0xffffffff 0x0001fff8>,
   <0x0 0x1e 0xffffffff 0xffffffff 0x00020000>,
   <0x0 0x1f 0xffffffff 0xffffffff 0x00040000>,
   <0x0 0x20 0xffffffff 0xffffffff 0x0001fff8>,
   <0x0 0x21 0xffffffff 0xffffffff 0x0001fff8>,
   <0x0 0x22 0xffffffff 0xffffffff 0x0001fff8>,
   <0x0 0x24 0xffffffff 0xffffffff 0x0001fff8>,
   <0x0 0x25 0xffffffff 0xffffffff 0x0001fff8>,
   <0x0 0x26 0xffffffff 0xffffffff 0x0001fff8>,
   <0x0 0x27 0xffffffff 0xffffffff 0x0001fff8>,
   <0x0 0x28 0xffffffff 0xffffffff 0x0001fff8>,
   <0x0 0x29 0xffffffff 0xffffffff 0x0001fff8>,
   <0x0 0x2b 0xffffffff 0xffffffff 0x0001fff8>,
   <0x0 0x2d 0xffffffff 0xffffffff 0x0001fff8>,
   <0x0 0x32 0xffffffff 0xffffffff 0x0001fff8>,
   <0x0 0x33 0xffffffff 0xffffffff 0x0001fff8>,
   <0x0 0x34 0xffffffff 0xffffffff 0x0001fff8>,
   <0x0 0x35 0xffffffff 0xffffffff 0x0001fff8>,
   <0x0 0x36 0xffffffff 0xffffffff 0x0001fff8>,
   <0x0 0x37 0xffffffff 0xffffffff 0x0001fff8>,
   <0x0 0x38 0xffffffff 0xffffffff 0x0001fff8>,
   <0x0 0x3a 0xffffffff 0xffffffff 0x0001fff8>,
   <0x0 0x3b 0xffffffff 0xffffffff 0x0001fff8>,
   <0x0 0x3c 0xffffffff 0xffffffff 0x0001fff8>,
   <0x0 0x3d 0xffffffff 0xffffffff 0x0001fff8>,
   <0x0 0x3f 0xffffffff 0xffffffff 0x0001fff8>;
 };
};

# 1 "/tmp/k3-independent-audit/platforms/Platform/Spacemit/K3/DeviceTree/../MUSE-Pico/DeviceTree/MUSE-PicoPinctrl.dtsi" 1







# 1 "/tmp/k3-independent-audit/platforms/Platform/Spacemit/K3/DeviceTree/dt-bindings/pinctrl/k3-pinctrl.h" 1
# 9 "/tmp/k3-independent-audit/platforms/Platform/Spacemit/K3/DeviceTree/../MUSE-Pico/DeviceTree/MUSE-PicoPinctrl.dtsi" 2



&pinctrl {
 pinctrl_uart0_0: uart0_0_grp {
  pinctrl-single,pins = <
   ((((42) + 0)) * 4)(2)(((1 << 6) | (6 << 13) | (8 << 9)))
   ((((43) + 0)) * 4)(2)(((1 << 6) | (6 << 13) | (8 << 9)))
  >;
 };

 pinctrl_uart0_1: uart0_1_grp {
  pinctrl-single,pins = <
   ((((93) + 0)) * 4)(3)(((1 << 6) | (6 << 13) | (4 << 9)))
   ((((94) + 0)) * 4)(3)(((1 << 6) | (6 << 13) | (4 << 9)))
  >;
 };

 pinctrl_uart0_2: uart0_2_grp {
  pinctrl-single,pins = <
   ((((134) + 0)) * 4)(2)(((1 << 6) | (6 << 13) | (4 << 9)))
   ((((135) + 0)) * 4)(2)(((1 << 6) | (6 << 13) | (4 << 9)))
  >;
 };

 pinctrl_uart0_3: uart0_3_grp {
  pinctrl-single,pins = <
   ((((147) + 0)) * 4)(5)(((1 << 6) | (6 << 13) | (4 << 9)))
   ((((148) + 0)) * 4)(5)(((1 << 6) | (6 << 13) | (4 << 9)))
  >;
 };

 pinctrl_uart1_0: uart1_0_grp {
  pinctrl-single,pins = <
   ((((95) + 0)) * 4)(2)(((1 << 6) | (6 << 13) | (4 << 9)))
   ((((96) + 0)) * 4)(2)(((1 << 6) | (6 << 13) | (4 << 9)))
   ((((97) + 0)) * 4)(2)(((1 << 6) | (6 << 13) | (4 << 9)))
   ((((98) + 0)) * 4)(2)(((1 << 6) | (6 << 13) | (4 << 9)))
  >;
 };

 pinctrl_uart1_1: uart1_1_grp {
  pinctrl-single,pins = <
   ((((121) + 0)) * 4)(1)(((1 << 6) | (6 << 13) | (4 << 9)))
   ((((120) + 0)) * 4)(1)(((1 << 6) | (6 << 13) | (4 << 9)))
   ((((119) + 0)) * 4)(1)(((1 << 6) | (6 << 13) | (4 << 9)))
   ((((118) + 0)) * 4)(1)(((1 << 6) | (6 << 13) | (4 << 9)))
  >;
 };

 pinctrl_uart2_0: uart2_0grp {
  pinctrl-single,pins =<
   ((((136) + 0)) * 4)(2)(((1 << 6) | (6 << 13) | (4 << 9)))
   ((((137) + 0)) * 4)(2)(((1 << 6) | (6 << 13) | (4 << 9)))
   ((((138) + 0)) * 4)(2)(((1 << 6) | (6 << 13) | (4 << 9)))
   ((((139) + 0)) * 4)(2)(((1 << 6) | (6 << 13) | (4 << 9)))
  >;
 };

 pinctrl_uart2_1: uart2_1grp {
  pinctrl-single,pins =<
   ((((97) + 0)) * 4)(1)(((1 << 6) | (6 << 13) | (4 << 9)))
   ((((98) + 0)) * 4)(1)(((1 << 6) | (6 << 13) | (4 << 9)))
  >;
 };

 pinctrl_uart3_0: uart3_0_grp {
  pinctrl-single,pins =<
   ((((26) + 0)) * 4)(2)(((1 << 6) | (6 << 13) | (4 << 9)))
   ((((27) + 0)) * 4)(2)(((1 << 6) | (6 << 13) | (4 << 9)))
   ((((28) + 0)) * 4)(2)(((1 << 6) | (6 << 13) | (4 << 9)))
   ((((29) + 0)) * 4)(2)(((1 << 6) | (6 << 13) | (4 << 9)))
  >;
 };

 pinctrl_uart3_1: uart3_1_grp {
  pinctrl-single,pins =<
   ((((56) + 0)) * 4)(2)(((1 << 6) | (6 << 13) | (4 << 9)))
   ((((55) + 0)) * 4)(2)(((1 << 6) | (6 << 13) | (4 << 9)))
   ((((53) + 0)) * 4)(2)(((1 << 6) | (6 << 13) | (4 << 9)))
   ((((54) + 0)) * 4)(2)(((1 << 6) | (6 << 13) | (4 << 9)))
  >;
 };

 pinctrl_uart4_0: uart4_0_grp {
  pinctrl-single,pins =<
   ((((90) + 0)) * 4)(3)(((1 << 6) | (6 << 13) | (2 << 9)))
   ((((91) + 0)) * 4)(3)(((1 << 6) | (6 << 13) | (2 << 9)))
   ((((86) + 0)) * 4)(3)(((1 << 6) | (6 << 13) | (2 << 9)))
   ((((87) + 0)) * 4)(3)(((1 << 6) | (6 << 13) | (2 << 9)))
  >;
 };

 pinctrl_uart4_1: uart4_1_grp {
  pinctrl-single,pins =<
   ((((99) + 0)) * 4)(3)(((1 << 6) | (6 << 13) | (2 << 9)))
   ((((100) + 0)) * 4)(3)(((1 << 6) | (6 << 13) | (2 << 9)))
   ((((101) + 0)) * 4)(3)(((1 << 6) | (6 << 13) | (2 << 9)))
   ((((102) + 0)) * 4)(3)(((1 << 6) | (6 << 13) | (2 << 9)))
  >;
 };

 pinctrl_uart5_0: uart5_0_grp {
  pinctrl-single,pins =<
   ((((21) + 0)) * 4)(2)(((1 << 6) | (6 << 13) | (4 << 9)))
   ((((22) + 0)) * 4)(2)(((1 << 6) | (6 << 13) | (4 << 9)))
   ((((23) + 0)) * 4)(2)(((1 << 6) | (6 << 13) | (4 << 9)))
   ((((24) + 0)) * 4)(2)(((1 << 6) | (6 << 13) | (4 << 9)))
  >;
 };

 pinctrl_uart5_1: uart5_1_grp {
  pinctrl-single,pins =<
   ((((83) + 0)) * 4)(4)(((1 << 6) | (6 << 13) | (4 << 9)))
   ((((82) + 0)) * 4)(4)(((1 << 6) | (6 << 13) | (4 << 9)))
  >;
 };

 pinctrl_uart5_2: uart5_2_grp {
  pinctrl-single,pins = <
   ((((147) + 0)) * 4)(4)(((1 << 6) | (6 << 13) | (8 << 9)))
   ((((148) + 0)) * 4)(4)(((1 << 6) | (6 << 13) | (8 << 9)))
  >;
 };

 pinctrl_uart6_0: uart6_0_grp {
  pinctrl-single,pins =<
   ((((48) + 0)) * 4)(2)(((1 << 6) | (6 << 13) | (4 << 9)))
   ((((49) + 0)) * 4)(2)(((1 << 6) | (6 << 13) | (4 << 9)))
   ((((50) + 0)) * 4)(2)(((1 << 6) | (6 << 13) | (4 << 9)))
   ((((51) + 0)) * 4)(2)(((1 << 6) | (6 << 13) | (4 << 9)))
  >;
 };

 pinctrl_uart6_1: uart6_1_grp {
  pinctrl-single,pins =<
   ((((122) + 0)) * 4)(3)(((1 << 6) | (6 << 13) | (4 << 9)))
   ((((123) + 0)) * 4)(3)(((1 << 6) | (6 << 13) | (4 << 9)))
  >;
 };

 pinctrl_uart7_0: uart7_0_grp {
  pinctrl-single,pins =<
   ((((13) + 0)) * 4)(2)(((1 << 6) | (6 << 13) | (4 << 9)))
   ((((14) + 0)) * 4)(2)(((1 << 6) | (6 << 13) | (4 << 9)))
   ((((12) + 0)) * 4)(2)(((1 << 6) | (6 << 13) | (4 << 9)))
   ((((11) + 0)) * 4)(2)(((1 << 6) | (6 << 13) | (4 << 9)))
  >;
 };

 pinctrl_uart7_1: uart7_1_grp {
  pinctrl-single,pins =<
   ((((23) + 0)) * 4)(5)(((1 << 6) | (6 << 13) | (4 << 9)))
   ((((24) + 0)) * 4)(5)(((1 << 6) | (6 << 13) | (4 << 9)))
   ((((25) + 0)) * 4)(5)(((1 << 6) | (6 << 13) | (4 << 9)))
   ((((26) + 0)) * 4)(5)(((1 << 6) | (6 << 13) | (4 << 9)))
  >;
 };

 pinctrl_uart8_0: uart8_0_grp {
  pinctrl-single,pins =<
   ((((12) + 0)) * 4)(5)(((1 << 6) | (6 << 13) | (4 << 9)))
   ((((11) + 0)) * 4)(5)(((1 << 6) | (6 << 13) | (4 << 9)))
  >;
 };

 pinctrl_uart8_1: uart8_1_grp {
  pinctrl-single,pins =<
   ((((76) + 0)) * 4)(3)(((1 << 6) | (6 << 13) | (4 << 9)))
   ((((77) + 0)) * 4)(3)(((1 << 6) | (6 << 13) | (4 << 9)))
   ((((78) + 0)) * 4)(3)(((1 << 6) | (6 << 13) | (4 << 9)))
   ((((79) + 0)) * 4)(3)(((1 << 6) | (6 << 13) | (4 << 9)))
  >;
 };

 pinctrl_uart9_0: uart9_0_grp {
  pinctrl-single,pins =<
   ((((84) + 0)) * 4)(2)(((1 << 6) | (6 << 13) | (4 << 9)))
   ((((85) + 0)) * 4)(2)(((1 << 6) | (6 << 13) | (4 << 9)))
   ((((82) + 0)) * 4)(2)(((1 << 6) | (6 << 13) | (4 << 9)))
   ((((83) + 0)) * 4)(2)(((1 << 6) | (6 << 13) | (4 << 9)))
  >;
 };

 pinctrl_uart9_1: uart9_1_grp {
  pinctrl-single,pins =<
   ((((149) + 0)) * 4)(4)(((1 << 6) | (6 << 13) | (4 << 9)))
   ((((150) + 0)) * 4)(4)(((1 << 6) | (6 << 13) | (4 << 9)))
  >;
 };

 pinctrl_uart10_0: uart10_0_grp {
  pinctrl-single,pins =<
   ((((31) + 0)) * 4)(2)(((1 << 6) | (6 << 13) | (4 << 9)))
   ((((32) + 0)) * 4)(2)(((1 << 6) | (6 << 13) | (4 << 9)))
   ((((33) + 0)) * 4)(2)(((1 << 6) | (6 << 13) | (4 << 9)))
   ((((34) + 0)) * 4)(2)(((1 << 6) | (6 << 13) | (4 << 9)))
  >;
 };

 pinctrl_uart10_1: uart10_1_grp {
  pinctrl-single,pins =<
   ((((44) + 0)) * 4)(2)(((1 << 6) | (6 << 13) | (4 << 9)))
   ((((45) + 0)) * 4)(2)(((1 << 6) | (6 << 13) | (4 << 9)))
   ((((46) + 0)) * 4)(2)(((1 << 6) | (6 << 13) | (4 << 9)))
   ((((47) + 0)) * 4)(2)(((1 << 6) | (6 << 13) | (4 << 9)))
  >;
 };

 pinctrl_i2c0_0: i2c0_0_grp {
  pinctrl-single,pins =<
   ((((0) + 0)) * 4)(6)(((1 << 6) | (6 << 13) | (0 << 9)))
   ((((1) + 0)) * 4)(6)(((1 << 6) | (6 << 13) | (0 << 9)))
  >;
 };

 pinctrl_i2c0_1: i2c0_1_grp {
  pinctrl-single,pins =<
   ((((42) + 0)) * 4)(5)(((1 << 6) | (6 << 13) | (0 << 9)))
   ((((43) + 0)) * 4)(5)(((1 << 6) | (6 << 13) | (0 << 9)))
  >;
 };

 pinctrl_i2c0_2: i2c0_2_grp {
  pinctrl-single,pins =<
   ((((48) + 0)) * 4)(5)(((1 << 6) | (6 << 13) | (0 << 9)))
   ((((49) + 0)) * 4)(5)(((1 << 6) | (6 << 13) | (0 << 9)))
  >;
 };

 pinctrl_i2c0_3: i2c0_3_grp {
  pinctrl-single,pins =<
   ((((76) + 0)) * 4)(6)(((1 << 6) | (6 << 13) | (0 << 9)))
   ((((77) + 0)) * 4)(6)(((1 << 6) | (6 << 13) | (0 << 9)))
  >;
 };

 pinctrl_i2c0_4: i2c0_4_grp {
  pinctrl-single,pins =<
   ((((115) + 0)) * 4)(4)(((1 << 6) | (6 << 13) | (0 << 9)))
   ((((116) + 0)) * 4)(4)(((1 << 6) | (6 << 13) | (0 << 9)))
  >;
 };

 pinctrl_i2c1_0: i2c1_0_grp {
  pinctrl-single,pins =<
   ((((2) + 0)) * 4)(6)(((1 << 6) | (6 << 13) | (0 << 9)))
   ((((3) + 0)) * 4)(6)(((1 << 6) | (6 << 13) | (0 << 9)))
  >;
 };

 pinctrl_i2c1_1: i2c1_1_grp {
  pinctrl-single,pins =<
   ((((54) + 0)) * 4)(5)(((1 << 6) | (6 << 13) | (0 << 9)))
   ((((55) + 0)) * 4)(5)(((1 << 6) | (6 << 13) | (0 << 9)))
  >;
 };

 pinctrl_i2c1_2: i2c1_2_grp {
  pinctrl-single,pins =<
   ((((78) + 0)) * 4)(6)(((1 << 6) | (6 << 13) | (0 << 9)))
   ((((79) + 0)) * 4)(6)(((1 << 6) | (6 << 13) | (0 << 9)))
  >;
 };

 pinctrl_i2c1_3: i2c1_3_grp {
  pinctrl-single,pins =<
   ((((102) + 0)) * 4)(6)(((1 << 6) | (6 << 13) | (0 << 9)))
   ((((103) + 0)) * 4)(6)(((1 << 6) | (6 << 13) | (0 << 9)))
  >;
 };

 pinctrl_i2c2_0: i2c2_0_grp {
  pinctrl-single,pins =<
   ((((5) + 0)) * 4)(6)(((1 << 6) | (6 << 13) | (0 << 9)))
   ((((6) + 0)) * 4)(6)(((1 << 6) | (6 << 13) | (0 << 9)))
  >;
 };

 pinctrl_i2c2_1: i2c2_1_grp {
  pinctrl-single,pins =<
   ((((46) + 0)) * 4)(5)(((1 << 6) | (6 << 13) | (0 << 9)))
   ((((47) + 0)) * 4)(5)(((1 << 6) | (6 << 13) | (0 << 9)))
  >;
 };

 pinctrl_i2c2_2: i2c2_2_grp {
  pinctrl-single,pins =<
   ((((80) + 0)) * 4)(6)(((1 << 6) | (6 << 13) | (0 << 9)))
   ((((81) + 0)) * 4)(6)(((1 << 6) | (6 << 13) | (0 << 9)))
  >;
 };

 pinctrl_i2c2_3: i2c2_3_grp {
  pinctrl-single,pins =<
   ((((120) + 0)) * 4)(2)(((1 << 6) | (6 << 13) | (0 << 9)))
   ((((121) + 0)) * 4)(2)(((1 << 6) | (6 << 13) | (0 << 9)))
  >;
 };

 pinctrl_i2c3_0: i2c3_0_grp {
  pinctrl-single,pins =<
   ((((36) + 0)) * 4)(4)(((1 << 6) | (6 << 13) | (0 << 9)))
   ((((37) + 0)) * 4)(4)(((1 << 6) | (6 << 13) | (0 << 9)))
  >;
 };

 pinctrl_i2c3_1: i2c3_1_grp {
  pinctrl-single,pins =<
   ((((82) + 0)) * 4)(6)(((1 << 6) | (6 << 13) | (0 << 9)))
   ((((83) + 0)) * 4)(6)(((1 << 6) | (6 << 13) | (0 << 9)))
  >;
 };

 pinctrl_i2c3_2: i2c3_2_grp {
  pinctrl-single,pins =<
   ((((105) + 0)) * 4)(4)(((1 << 6) | (6 << 13) | (0 << 9)))
   ((((106) + 0)) * 4)(4)(((1 << 6) | (6 << 13) | (0 << 9)))
  >;
 };

 pinctrl_i2c3_3: i2c3_3_grp {
  pinctrl-single,pins =<
   ((((144) + 0)) * 4)(5)(((1 << 6) | (6 << 13) | (0 << 9)))
   ((((145) + 0)) * 4)(5)(((1 << 6) | (6 << 13) | (0 << 9)))
  >;
 };

 pinctrl_i2c4_0: i2c4_0_grp {
  pinctrl-single,pins =<
   ((((11) + 0)) * 4)(6)(((1 << 6) | (6 << 13) | (0 << 9)))
   ((((12) + 0)) * 4)(6)(((1 << 6) | (6 << 13) | (0 << 9)))
  >;
 };

 pinctrl_i2c4_1: i2c4_1_grp {
  pinctrl-single,pins =<
   ((((50) + 0)) * 4)(5)(((1 << 6) | (6 << 13) | (0 << 9)))
   ((((51) + 0)) * 4)(5)(((1 << 6) | (6 << 13) | (0 << 9)))
  >;
 };

 pinctrl_i2c4_2: i2c4_2_grp {
  pinctrl-single,pins =<
   ((((111) + 0)) * 4)(4)(((1 << 6) | (6 << 13) | (0 << 9)))
   ((((112) + 0)) * 4)(4)(((1 << 6) | (6 << 13) | (0 << 9)))
  >;
 };

 pinctrl_i2c4_3: i2c4_3_grp {
  pinctrl-single,pins =<
   ((((138) + 0)) * 4)(6)(((1 << 6) | (6 << 13) | (0 << 9)))
   ((((139) + 0)) * 4)(6)(((1 << 6) | (6 << 13) | (0 << 9)))
  >;
 };

 pinctrl_i2c5_0: i2c5_0_grp {
  pinctrl-single,pins =<
   ((((26) + 0)) * 4)(6)(((1 << 6) | (6 << 13) | (0 << 9)))
   ((((25) + 0)) * 4)(6)(((1 << 6) | (6 << 13) | (0 << 9)))
  >;
 };

 pinctrl_i2c5_1: i2c5_1_grp {
  pinctrl-single,pins =<
   ((((63) + 0)) * 4)(5)(((1 << 6) | (6 << 13) | (0 << 9)))
   ((((64) + 0)) * 4)(5)(((1 << 6) | (6 << 13) | (0 << 9)))
  >;
 };

 pinctrl_i2c5_2: i2c5_2_grp {
  pinctrl-single,pins =<
   ((((93) + 0)) * 4)(5)(((1 << 6) | (6 << 13) | (0 << 9)))
   ((((94) + 0)) * 4)(5)(((1 << 6) | (6 << 13) | (0 << 9)))
  >;
 };

 pinctrl_i2c5_3: i2c5_3_grp {
  pinctrl-single,pins =<
   ((((126) + 0)) * 4)(4)(((1 << 6) | (6 << 13) | (0 << 9)))
   ((((127) + 0)) * 4)(4)(((1 << 6) | (6 << 13) | (0 << 9)))
  >;
 };

 pinctrl_i2c6_0: i2c6_0_grp {
  pinctrl-single,pins =<
   ((((7) + 0)) * 4)(6)(((1 << 6) | (6 << 13) | (0 << 9)))
   ((((8) + 0)) * 4)(6)(((1 << 6) | (6 << 13) | (0 << 9)))
  >;
 };

 pinctrl_i2c6_1: i2c6_1_grp {
  pinctrl-single,pins =<
   ((((14) + 0)) * 4)(6)(((1 << 6) | (6 << 13) | (0 << 9)))
   ((((15) + 0)) * 4)(6)(((1 << 6) | (6 << 13) | (0 << 9)))
  >;
 };

 pinctrl_i2c6_2: i2c6_2_grp {
  pinctrl-single,pins =<
   ((((61) + 0)) * 4)(5)(((1 << 6) | (6 << 13) | (0 << 9)))
   ((((62) + 0)) * 4)(5)(((1 << 6) | (6 << 13) | (0 << 9)))
  >;
 };

 pinctrl_i2c6_3: i2c6_3_grp {
  pinctrl-single,pins =<
   ((((61) + 0)) * 4)(5)(((1 << 6) | (6 << 13) | (0 << 9)))
   ((((62) + 0)) * 4)(5)(((1 << 6) | (6 << 13) | (0 << 9)))
  >;
 };

 pinctrl_i2c6_4: i2c6_4_grp {
  pinctrl-single,pins =<
   ((((153) + 0)) * 4)(2)(((1 << 6) | (6 << 13) | (0 << 9)))
   ((((154) + 0)) * 4)(2)(((1 << 6) | (6 << 13) | (0 << 9)))
  >;
 };

 pinctrl_i2c8: i2c8_grp {
  pinctrl-single,pins =<
   ((((128) + 0)) * 4)(0)(((1 << 6) | (6 << 13) | (0 << 9)))
   ((((129) + 0)) * 4)(0)(((1 << 6) | (6 << 13) | (0 << 9)))
  >;
 };

 pinctrl_pwm0_0: pwm0_0_grp {
  pinctrl-single,pins = <
   ((((0) + 0)) * 4)(3)(((1 << 6) | (6 << 13) | (8 << 9)))
  >;
 };

 pinctrl_pwm0_1: pwm0_1_grp {
  pinctrl-single,pins =<
   ((((42) + 0)) * 4)(6)(((1 << 6) | (6 << 13) | (4 << 9)))
  >;
 };

 pinctrl_pwm1_0: pwm1_0_grp {
  pinctrl-single,pins = <
   ((((1) + 0)) * 4)(3)(((1 << 6) | (6 << 13) | (8 << 9)))
  >;
 };

 pinctrl_pwm1_1: pwm1_1_grp {
  pinctrl-single,pins = <
   ((((43) + 0)) * 4)(6)(((1 << 6) | (6 << 13) | (4 << 9)))
  >;
 };

 pinctrl_pwm1_2: pwm1_2_grp {
  pinctrl-single,pins = <
   ((((95) + 0)) * 4)(6)(((1 << 6) | (6 << 13) | (4 << 9)))
  >;
 };

 pinctrl_pwm2_0: pwm2_0_grp {
  pinctrl-single,pins = <
   ((((2) + 0)) * 4)(3)(((1 << 6) | (6 << 13) | (8 << 9)))
  >;
 };

 pinctrl_pwm2_1: pwm2_1_grp {
  pinctrl-single,pins = <
   ((((44) + 0)) * 4)(6)(((1 << 6) | (6 << 13) | (4 << 9)))
  >;
 };

 pinctrl_pwm2_2: pwm2_2_grp {
  pinctrl-single,pins = <
   ((((96) + 0)) * 4)(6)(((1 << 6) | (6 << 13) | (4 << 9)))
  >;
 };

 pinctrl_pwm2_3: pwm2_3_grp {
  pinctrl-single,pins = <
   ((((136) + 0)) * 4)(4)(((1 << 6) | (6 << 13) | (4 << 9)))
  >;
 };

 pinctrl_pwm3_0: pwm3_0_grp {
  pinctrl-single,pins = <
   ((((3) + 0)) * 4)(3)(((1 << 6) | (6 << 13) | (4 << 9)))
  >;
 };

 pinctrl_pwm3_1: pwm3_1_grp {
  pinctrl-single,pins = <
   ((((45) + 0)) * 4)(6)(((1 << 6) | (6 << 13) | (4 << 9)))
  >;
 };

 pinctrl_pwm3_2: pwm3_2_grp {
  pinctrl-single,pins = <
   ((((97) + 0)) * 4)(6)(((1 << 6) | (6 << 13) | (4 << 9)))
  >;
 };

 pinctrl_pwm3_3: pwm3_3_grp {
  pinctrl-single,pins = <
   ((((137) + 0)) * 4)(4)(((1 << 6) | (6 << 13) | (8 << 9)))
  >;
 };

 pinctrl_pwm4_0: pwm4_0_grp {
  pinctrl-single,pins = <
   ((((4) + 0)) * 4)(3)(((1 << 6) | (6 << 13) | (4 << 9)))
  >;
 };

 pinctrl_pwm4_1: pwm4_1_grp {
  pinctrl-single,pins = <
   ((((46) + 0)) * 4)(6)(((1 << 6) | (6 << 13) | (4 << 9)))
  >;
 };

 pinctrl_pwm4_2: pwm4_2_grp {
  pinctrl-single,pins = <
   ((((138) + 0)) * 4)(4)(((1 << 6) | (6 << 13) | (8 << 9)))
  >;
 };

 pinctrl_pwm5_0: pwm5_0_grp {
  pinctrl-single,pins = <
   ((((5) + 0)) * 4)(3)(((1 << 6) | (6 << 13) | (4 << 9)))
  >;
 };

 pinctrl_pwm5_1: pwm5_1_grp {
  pinctrl-single,pins = <
   ((((47) + 0)) * 4)(6)(((1 << 6) | (6 << 13) | (4 << 9)))
  >;
 };

 pinctrl_pwm5_2: pwm5_2_grp {
  pinctrl-single,pins = <
   ((((139) + 0)) * 4)(4)(((1 << 6) | (6 << 13) | (8 << 9)))
  >;
 };

 pinctrl_pwm6_0: pwm6_0_grp {
  pinctrl-single,pins = <
   ((((6) + 0)) * 4)(3)(((1 << 6) | (6 << 13) | (4 << 9)))
  >;
 };

 pinctrl_pwm6_1: pwm6_1_grp {
  pinctrl-single,pins = <
   ((((48) + 0)) * 4)(6)(((1 << 6) | (6 << 13) | (4 << 9)))
  >;
 };

 pinctrl_pwm6_2: pwm6_2_grp {
  pinctrl-single,pins =<
   ((((147) + 0)) * 4)(3)(((1 << 6) | (6 << 13) | (4 << 9)))
  >;
 };

 pinctrl_pwm7_0: pwm7_0_grp {
  pinctrl-single,pins =<
   ((((7) + 0)) * 4)(3)(((1 << 6) | (6 << 13) | (4 << 9)))
  >;
 };

 pinctrl_pwm7_1: pwm7_1_grp {
  pinctrl-single,pins =<
   ((((49) + 0)) * 4)(6)(((1 << 6) | (6 << 13) | (4 << 9)))
  >;
 };

 pinctrl_pwm7_2: pwm7_2_grp {
  pinctrl-single,pins = <
   ((((148) + 0)) * 4)(3)(((1 << 6) | (6 << 13) | (4 << 9)))
  >;
 };

 pinctrl_pwm8_0: pwm8_0_grp {
  pinctrl-single,pins =<
   ((((8) + 0)) * 4)(3)(((1 << 6) | (6 << 13) | (4 << 9)))
  >;
 };

 pinctrl_pwm8_1: pwm8_1_grp {
  pinctrl-single,pins =<
   ((((50) + 0)) * 4)(6)(((1 << 6) | (6 << 13) | (4 << 9)))
  >;
 };

 pinctrl_pwm8_2: pwm8_2_grp {
  pinctrl-single,pins =<
   ((((149) + 0)) * 4)(3)(((1 << 6) | (6 << 13) | (4 << 9)))
  >;
 };

 pinctrl_pwm9_0: pwm9_0_grp {
  pinctrl-single,pins =<
   ((((9) + 0)) * 4)(3)(((1 << 6) | (6 << 13) | (4 << 9)))
  >;
 };

 pinctrl_pwm9_1: pwm9_1_grp {
  pinctrl-single,pins =<
   ((((51) + 0)) * 4)(6)(((1 << 6) | (6 << 13) | (4 << 9)))
  >;
 };

 pinctrl_pwm9_2: pwm9_2_grp {
  pinctrl-single,pins =<
   ((((150) + 0)) * 4)(3)(((1 << 6) | (6 << 13) | (4 << 9)))
  >;
 };

 pinctrl_pwm10_0: pwm10_0_grp {
  pinctrl-single,pins =<
   ((((10) + 0)) * 4)(3)(((1 << 6) | (6 << 13) | (4 << 9)))
  >;
 };

 pinctrl_pwm10_1: pwm10_1_grp {
  pinctrl-single,pins =<
   ((((52) + 0)) * 4)(6)(((1 << 6) | (6 << 13) | (4 << 9)))
  >;
 };

 pinctrl_pwm10_2: pwm10_2_grp {
  pinctrl-single,pins =<
   ((((143) + 0)) * 4)(4)(((1 << 6) | (6 << 13) | (4 << 9)))
  >;
 };

 pinctrl_pwm11_0: pwm11_0_grp {
  pinctrl-single,pins =<
   ((((53) + 0)) * 4)(6)(((1 << 6) | (6 << 13) | (4 << 9)))
  >;
 };

 pinctrl_pwm11_1: pwm11_1_grp {
  pinctrl-single,pins =<
   ((((142) + 0)) * 4)(4)(((1 << 6) | (6 << 13) | (4 << 9)))
  >;
 };

 pinctrl_pwm12_0: pwm12_0_grp {
  pinctrl-single,pins =<
   ((((54) + 0)) * 4)(6)(((1 << 6) | (6 << 13) | (4 << 9)))
  >;
 };

 pinctrl_pwm12_1: pwm12_1_grp {
  pinctrl-single,pins =<
   ((((141) + 0)) * 4)(4)(((1 << 6) | (6 << 13) | (4 << 9)))
  >;
 };

 pinctrl_pwm12_2: pwm12_2_grp {
  pinctrl-single,pins =<
   ((((128) + 0)) * 4)(4)(((1 << 6) | (6 << 13) | (4 << 9)))
  >;
 };

 pinctrl_pwm13_0: pwm13_0_grp {
  pinctrl-single,pins =<
   ((((13) + 0)) * 4)(3)(((1 << 6) | (6 << 13) | (4 << 9)))
  >;
 };

 pinctrl_pwm13_1: pwm13_1_grp {
  pinctrl-single,pins =<
   ((((55) + 0)) * 4)(6)(((1 << 6) | (6 << 13) | (4 << 9)))
  >;
 };

 pinctrl_pwm13_2: pwm13_2_grp {
  pinctrl-single,pins =<
   ((((129) + 0)) * 4)(4)(((1 << 6) | (6 << 13) | (4 << 9)))
  >;
 };

 pinctrl_pwm13_3: pwm13_3_grp {
  pinctrl-single,pins =<
   ((((140) + 0)) * 4)(4)(((1 << 6) | (6 << 13) | (4 << 9)))
  >;
 };

 pinctrl_pwm14_0: pwm14_0_grp {
  pinctrl-single,pins =<
   ((((14) + 0)) * 4)(3)(((1 << 6) | (6 << 13) | (4 << 9)))
  >;
 };

 pinctrl_pwm14_1: pwm14_1_grp {
  pinctrl-single,pins =<
   ((((56) + 0)) * 4)(6)(((1 << 6) | (6 << 13) | (4 << 9)))
  >;
 };

 pinctrl_pwm14_2: pwm14_2_grp {
  pinctrl-single,pins =<
   ((((130) + 0)) * 4)(4)(((1 << 6) | (6 << 13) | (8 << 9)))
  >;
 };

 pinctrl_pwm14_3: pwm14_3_grp {
  pinctrl-single,pins =<
   ((((146) + 0)) * 4)(4)(((1 << 6) | (6 << 13) | (4 << 9)))
  >;
 };

 pinctrl_pwm15_0: pwm15_0_grp {
  pinctrl-single,pins =<
   ((((21) + 0)) * 4)(3)(((1 << 6) | (6 << 13) | (4 << 9)))
  >;
 };

 pinctrl_pwm15_1: pwm15_1_grp {
  pinctrl-single,pins =<
   ((((57) + 0)) * 4)(6)(((1 << 6) | (6 << 13) | (4 << 9)))
  >;
 };

 pinctrl_pwm15_2: pwm15_2_grp {
  pinctrl-single,pins =<
   ((((144) + 0)) * 4)(4)(((1 << 6) | (6 << 13) | (4 << 9)))
  >;
 };

 pinctrl_pwm16_0: pwm16_0_grp {
  pinctrl-single,pins =<
   ((((22) + 0)) * 4)(3)(((1 << 6) | (6 << 13) | (4 << 9)))
  >;
 };

 pinctrl_pwm16_1: pwm16_1_grp {
  pinctrl-single,pins =<
   ((((58) + 0)) * 4)(6)(((1 << 6) | (6 << 13) | (4 << 9)))
  >;
 };

 pinctrl_pwm16_2: pwm16_2_grp {
  pinctrl-single,pins =<
   ((((133) + 0)) * 4)(4)(((1 << 6) | (6 << 13) | (4 << 9)))
  >;
 };

 pinctrl_pwm16_3: pwm16_3_grp {
  pinctrl-single,pins =<
   ((((145) + 0)) * 4)(4)(((1 << 6) | (6 << 13) | (4 << 9)))
  >;
 };

 pinctrl_pwm17_0: pwm17_0_grp {
  pinctrl-single,pins =<
   ((((23) + 0)) * 4)(3)(((1 << 6) | (6 << 13) | (4 << 9)))
  >;
 };

 pinctrl_pwm17_1: pwm17_1_grp {
  pinctrl-single,pins =<
   ((((59) + 0)) * 4)(6)(((1 << 6) | (6 << 13) | (4 << 9)))
  >;
 };

 pinctrl_pwm17_2: pwm17_2_grp {
  pinctrl-single,pins =<
   ((((105) + 0)) * 4)(6)(((1 << 6) | (6 << 13) | (4 << 9)))
  >;
 };

 pinctrl_pwm18_0: pwm18_0_grp {
  pinctrl-single,pins =<
   ((((24) + 0)) * 4)(3)(((1 << 6) | (6 << 13) | (4 << 9)))
  >;
 };

 pinctrl_pwm18_1: pwm18_1_grp {
  pinctrl-single,pins =<
   ((((60) + 0)) * 4)(6)(((1 << 6) | (6 << 13) | (4 << 9)))
  >;
 };

 pinctrl_pwm18_2: pwm18_2_grp {
  pinctrl-single,pins =<
   ((((106) + 0)) * 4)(6)(((1 << 6) | (6 << 13) | (4 << 9)))
  >;
 };

 pinctrl_pwm19_0: pwm19_0_grp {
  pinctrl-single,pins =<
   ((((25) + 0)) * 4)(3)(((1 << 6) | (6 << 13) | (4 << 9)))
  >;
 };

 pinctrl_pwm19_1: pwm19_1_grp {
  pinctrl-single,pins =<
   ((((61) + 0)) * 4)(6)(((1 << 6) | (6 << 13) | (4 << 9)))
  >;
 };

 pinctrl_pwm19_2: pwm19_2_grp {
  pinctrl-single,pins =<
   ((((107) + 0)) * 4)(6)(((1 << 6) | (6 << 13) | (4 << 9)))
  >;
 };

 pinctrl_rpwm0_0: rpwm0_0_grp {
  pinctrl-single,pins = <
   ((((15) + 0)) * 4)(3)(((1 << 6) | (6 << 13) | (8 << 9)))
  >;
 };

 pinctrl_rpwm0_1: rpwm0_1_grp {
  pinctrl-single,pins = <
   ((((27) + 0)) * 4)(3)(((1 << 6) | (6 << 13) | (8 << 9)))
  >;
 };

 pinctrl_rpwm0_2: rpwm0_2_grp {
  pinctrl-single,pins = <
   ((((64) + 0)) * 4)(6)(((1 << 6) | (6 << 13) | (8 << 9)))
  >;
 };

 pinctrl_rpwm1_0: rpwm1_0_grp {
  pinctrl-single,pins = <
   ((((16) + 0)) * 4)(3)(((1 << 6) | (6 << 13) | (8 << 9)))
  >;
 };

 pinctrl_rpwm1_1: rpwm1_1_grp {
  pinctrl-single,pins = <
   ((((28) + 0)) * 4)(3)(((1 << 6) | (6 << 13) | (8 << 9)))
  >;
 };

 pinctrl_rpwm1_2: rpwm1_2_grp {
  pinctrl-single,pins = <
   ((((65) + 0)) * 4)(6)(((1 << 6) | (6 << 13) | (8 << 9)))
  >;
 };

 pinctrl_rpwm2_0: rpwm2_0_grp {
  pinctrl-single,pins = <
   ((((17) + 0)) * 4)(3)(((1 << 6) | (6 << 13) | (8 << 9)))
  >;
 };

 pinctrl_rpwm2_1: rpwm2_1_grp {
  pinctrl-single,pins = <
   ((((29) + 0)) * 4)(3)(((1 << 6) | (6 << 13) | (8 << 9)))
  >;
 };

 pinctrl_rpwm2_2: rpwm2_2_grp {
  pinctrl-single,pins = <
   ((((66) + 0)) * 4)(6)(((1 << 6) | (6 << 13) | (8 << 9)))
  >;
 };

 pinctrl_rpwm3_0: rpwm3_0_grp {
  pinctrl-single,pins = <
   ((((18) + 0)) * 4)(3)(((1 << 6) | (6 << 13) | (8 << 9)))
  >;
 };

 pinctrl_rpwm3_1: rpwm3_1_grp {
  pinctrl-single,pins = <
   ((((30) + 0)) * 4)(3)(((1 << 6) | (6 << 13) | (8 << 9)))
  >;
 };

 pinctrl_rpwm3_2: rpwm3_2_grp {
  pinctrl-single,pins = <
   ((((67) + 0)) * 4)(6)(((1 << 6) | (6 << 13) | (8 << 9)))
  >;
 };

 pinctrl_rpwm4_0: rpwm4_0_grp {
  pinctrl-single,pins = <
   ((((19) + 0)) * 4)(3)(((1 << 6) | (6 << 13) | (8 << 9)))
  >;
 };

 pinctrl_rpwm4_1: rpwm4_1_grp {
  pinctrl-single,pins = <
   ((((31) + 0)) * 4)(3)(((1 << 6) | (6 << 13) | (8 << 9)))
  >;
 };

 pinctrl_rpwm4_2: rpwm4_2_grp {
  pinctrl-single,pins = <
   ((((93) + 0)) * 4)(6)(((1 << 6) | (6 << 13) | (8 << 9)))
  >;
 };

 pinctrl_rpwm5_0: rpwm5_0_grp {
  pinctrl-single,pins = <
   ((((20) + 0)) * 4)(3)(((1 << 6) | (6 << 13) | (8 << 9)))
  >;
 };

 pinctrl_rpwm5_1: rpwm5_1_grp {
  pinctrl-single,pins = <
   ((((32) + 0)) * 4)(3)(((1 << 6) | (6 << 13) | (8 << 9)))
  >;
 };

 pinctrl_rpwm5_2: rpwm5_2_grp {
  pinctrl-single,pins = <
   ((((92) + 0)) * 4)(5)(((1 << 6) | (6 << 13) | (8 << 9)))
  >;
 };

 pinctrl_rpwm6_0: rpwm6_0_grp {
  pinctrl-single,pins = <
   ((((33) + 0)) * 4)(3)(((1 << 6) | (6 << 13) | (8 << 9)))
  >;
 };

 pinctrl_rpwm6_1: rpwm6_1_grp {
  pinctrl-single,pins = <
   ((((94) + 0)) * 4)(6)(((1 << 6) | (6 << 13) | (8 << 9)))
  >;
 };

 pinctrl_rpwm6_2: rpwm6_2_grp {
  pinctrl-single,pins = <
   ((((109) + 0)) * 4)(6)(((1 << 6) | (6 << 13) | (8 << 9)))
  >;
 };

 pinctrl_rpwm7_0: rpwm7_0_grp {
  pinctrl-single,pins = <
   ((((34) + 0)) * 4)(3)(((1 << 6) | (6 << 13) | (8 << 9)))
  >;
 };

 pinctrl_rpwm7_1: rpwm7_1_grp {
  pinctrl-single,pins = <
   ((((110) + 0)) * 4)(6)(((1 << 6) | (6 << 13) | (8 << 9)))
  >;
 };

 pinctrl_rpwm8_0: rpwm8_0_grp {
  pinctrl-single,pins = <
   ((((35) + 0)) * 4)(3)(((1 << 6) | (6 << 13) | (8 << 9)))
  >;
 };

 pinctrl_rpwm8_1: rpwm8_1_grp {
  pinctrl-single,pins = <
   ((((111) + 0)) * 4)(6)(((1 << 6) | (6 << 13) | (8 << 9)))
  >;
 };

 pinctrl_rpwm9_0: rpwm9_0_grp {
  pinctrl-single,pins = <
   ((((36) + 0)) * 4)(3)(((1 << 6) | (6 << 13) | (8 << 9)))
  >;
 };

 pinctrl_rpwm9_1: rpwm9_1_grp {
  pinctrl-single,pins = <
   ((((112) + 0)) * 4)(6)(((1 << 6) | (6 << 13) | (8 << 9)))
  >;
 };

 pinctrl_sspa0_0: sspa0_0_grp {
  pinctrl-single,pins =<
   ((((81) + 0)) * 4)(2)(((1 << 6) | (6 << 13) | (0 << 9)))
   ((((82) + 0)) * 4)(2)(((1 << 6) | (6 << 13) | (0 << 9)))
   ((((83) + 0)) * 4)(2)(((1 << 6) | (6 << 13) | (0 << 9)))
   ((((84) + 0)) * 4)(2)(((1 << 6) | (6 << 13) | (0 << 9)))
   ((((85) + 0)) * 4)(2)(((1 << 6) | (6 << 13) | (0 << 9)))
  >;
 };

 pinctrl_sspa0_1: sspa0_1_grp {
  pinctrl-single,pins =<
   ((((115) + 0)) * 4)(2)(((1 << 6) | (6 << 13) | (0 << 9)))
   ((((111) + 0)) * 4)(2)(((1 << 6) | (6 << 13) | (0 << 9)))
   ((((112) + 0)) * 4)(2)(((1 << 6) | (6 << 13) | (0 << 9)))
   ((((113) + 0)) * 4)(2)(((1 << 6) | (6 << 13) | (0 << 9)))
   ((((114) + 0)) * 4)(2)(((1 << 6) | (6 << 13) | (0 << 9)))
  >;
 };

 pinctrl_sspa1_0: sspa1_0_grp {
  pinctrl-single,pins =<
   ((((19) + 0)) * 4)(2)(((1 << 6) | (6 << 13) | (0 << 9)))
   ((((15) + 0)) * 4)(2)(((1 << 6) | (6 << 13) | (0 << 9)))
   ((((16) + 0)) * 4)(2)(((1 << 6) | (6 << 13) | (0 << 9)))
   ((((17) + 0)) * 4)(2)(((1 << 6) | (6 << 13) | (0 << 9)))
   ((((18) + 0)) * 4)(2)(((1 << 6) | (6 << 13) | (0 << 9)))
  >;
 };

 pinctrl_sspa1_1: sspa1_1_grp {
  pinctrl-single,pins =<
   ((((126) + 0)) * 4)(2)(((1 << 6) | (6 << 13) | (0 << 9)))
   ((((122) + 0)) * 4)(2)(((1 << 6) | (6 << 13) | (0 << 9)))
   ((((123) + 0)) * 4)(2)(((1 << 6) | (6 << 13) | (0 << 9)))
   ((((124) + 0)) * 4)(2)(((1 << 6) | (6 << 13) | (0 << 9)))
   ((((125) + 0)) * 4)(2)(((1 << 6) | (6 << 13) | (0 << 9)))
  >;
 };

 pinctrl_sspa2_0: sspa2_0_grp {
  pinctrl-single,pins =<
   ((((80) + 0)) * 4)(2)(((1 << 6) | (6 << 13) | (0 << 9)))
   ((((76) + 0)) * 4)(2)(((1 << 6) | (6 << 13) | (0 << 9)))
   ((((77) + 0)) * 4)(2)(((1 << 6) | (6 << 13) | (0 << 9)))
   ((((78) + 0)) * 4)(2)(((1 << 6) | (6 << 13) | (0 << 9)))
   ((((79) + 0)) * 4)(2)(((1 << 6) | (6 << 13) | (0 << 9)))
  >;
 };

 pinctrl_sspa3_0: sspa3_0_grp {
  pinctrl-single,pins =<
   ((((103) + 0)) * 4)(2)(((1 << 6) | (6 << 13) | (0 << 9)))
   ((((99) + 0)) * 4)(2)(((1 << 6) | (6 << 13) | (0 << 9)))
   ((((100) + 0)) * 4)(2)(((1 << 6) | (6 << 13) | (0 << 9)))
   ((((101) + 0)) * 4)(2)(((1 << 6) | (6 << 13) | (0 << 9)))
   ((((102) + 0)) * 4)(2)(((1 << 6) | (6 << 13) | (0 << 9)))
  >;
 };

 pinctrl_sspa4_0: sspa4_0_grp {
  pinctrl-single,pins =<
   ((((73) + 0)) * 4)(2)(((1 << 6) | (6 << 13) | (0 << 9)))
   ((((69) + 0)) * 4)(2)(((1 << 6) | (6 << 13) | (0 << 9)))
   ((((70) + 0)) * 4)(2)(((1 << 6) | (6 << 13) | (0 << 9)))
   ((((71) + 0)) * 4)(2)(((1 << 6) | (6 << 13) | (0 << 9)))
   ((((72) + 0)) * 4)(2)(((1 << 6) | (6 << 13) | (0 << 9)))
  >;
 };

 pinctrl_sspa5_0: sspa5_0_grp {
  pinctrl-single,pins =<
   ((((4) + 0)) * 4)(2)(((1 << 6) | (6 << 13) | (0 << 9)))
   ((((0) + 0)) * 4)(2)(((1 << 6) | (6 << 13) | (0 << 9)))
   ((((1) + 0)) * 4)(2)(((1 << 6) | (6 << 13) | (0 << 9)))
   ((((2) + 0)) * 4)(2)(((1 << 6) | (6 << 13) | (0 << 9)))
   ((((3) + 0)) * 4)(2)(((1 << 6) | (6 << 13) | (0 << 9)))
  >;
 };

 pinctrl_ssp0_0: ssp0_0_grp {
  pinctrl-single,pins = <
   ((((55) + 0)) * 4)(3)(((1 << 6) | (0 << 13) | (8 << 9)))
   ((((56) + 0)) * 4)(3)(((1 << 6) | (6 << 13) | (8 << 9)))
   ((((53) + 0)) * 4)(3)(((1 << 6) | (0 << 13) | (8 << 9)))
   ((((54) + 0)) * 4)(3)(((1 << 6) | (0 << 13) | (8 << 9)))
  >;
 };

 pinctrl_ssp0_1: ssp0_1_grp {
  pinctrl-single,pins = <
   ((((83) + 0)) * 4)(1)(((1 << 6) | (0 << 13) | (8 << 9)))
   ((((84) + 0)) * 4)(1)(((1 << 6) | (6 << 13) | (8 << 9)))
   ((((81) + 0)) * 4)(1)(((1 << 6) | (0 << 13) | (8 << 9)))
   ((((82) + 0)) * 4)(1)(((1 << 6) | (0 << 13) | (8 << 9)))
  >;
 };

 pinctrl_ssp0_2: ssp0_2_grp {
  pinctrl-single,pins = <
   ((((106) + 0)) * 4)(1)(((1 << 6) | (0 << 13) | (8 << 9)))
   ((((107) + 0)) * 4)(1)(((1 << 6) | (6 << 13) | (8 << 9)))
   ((((104) + 0)) * 4)(1)(((1 << 6) | (0 << 13) | (8 << 9)))
   ((((105) + 0)) * 4)(1)(((1 << 6) | (0 << 13) | (8 << 9)))
  >;
 };

 pinctrl_ssp1_0: ssp1_0_grp {
  pinctrl-single,pins = <
   ((((34) + 0)) * 4)(5)(((1 << 6) | (0 << 13) | (8 << 9)))
   ((((35) + 0)) * 4)(5)(((1 << 6) | (6 << 13) | (8 << 9)))
   ((((32) + 0)) * 4)(5)(((1 << 6) | (0 << 13) | (8 << 9)))
   ((((33) + 0)) * 4)(5)(((1 << 6) | (0 << 13) | (8 << 9)))
  >;
 };

 pinctrl_ssp1_1: ssp1_1_grp {
  pinctrl-single,pins = <
   ((((113) + 0)) * 4)(1)(((1 << 6) | (0 << 13) | (8 << 9)))
   ((((114) + 0)) * 4)(1)(((1 << 6) | (6 << 13) | (8 << 9)))
   ((((111) + 0)) * 4)(1)(((1 << 6) | (0 << 13) | (8 << 9)))
   ((((112) + 0)) * 4)(1)(((1 << 6) | (0 << 13) | (8 << 9)))
  >;
 };

 pinctrl_ssp2_0: ssp2_0_grp {
  pinctrl-single,pins = <
   ((((30) + 0)) * 4)(5)(((1 << 6) | (0 << 13) | (8 << 9)))
   ((((31) + 0)) * 4)(5)(((1 << 6) | (6 << 13) | (8 << 9)))
   ((((28) + 0)) * 4)(5)(((1 << 6) | (0 << 13) | (8 << 9)))
   ((((29) + 0)) * 4)(5)(((1 << 6) | (0 << 13) | (8 << 9)))
  >;
 };

 pinctrl_ssp2_1: ssp2_1_grp {
  pinctrl-single,pins = <
   ((((106) + 0)) * 4)(2)(((1 << 6) | (0 << 13) | (8 << 9)))
   ((((107) + 0)) * 4)(2)(((1 << 6) | (6 << 13) | (8 << 9)))
   ((((104) + 0)) * 4)(2)(((1 << 6) | (0 << 13) | (8 << 9)))
   ((((105) + 0)) * 4)(2)(((1 << 6) | (0 << 13) | (8 << 9)))
  >;
 };

 pinctrl_ssp3_0: ssp3_0_grp {
  pinctrl-single,pins = <
   ((((70) + 0)) * 4)(6)(((1 << 6) | (0 << 13) | (8 << 9)))
   ((((71) + 0)) * 4)(6)(((1 << 6) | (6 << 13) | (8 << 9)))
   ((((68) + 0)) * 4)(6)(((1 << 6) | (0 << 13) | (8 << 9)))
   ((((69) + 0)) * 4)(6)(((1 << 6) | (0 << 13) | (8 << 9)))
  >;
 };

 pinctrl_ssp3_1: ssp3_1_grp {
  pinctrl-single,pins = <
   ((((101) + 0)) * 4)(2)(((1 << 6) | (0 << 13) | (4 << 9)))
   ((((102) + 0)) * 4)(2)(((1 << 6) | (6 << 13) | (4 << 9)))
   ((((99) + 0)) * 4)(2)(((1 << 6) | (0 << 13) | (4 << 9)))
   ((((100) + 0)) * 4)(2)(((1 << 6) | (0 << 13) | (4 << 9)))
  >;
 };

 pinctrl_qspi: qspi_grp {
  pinctrl-single,pins = <
   ((((143) + 0)) * 4)(0)(((1 << 6) | (0 << 13) | (8 << 9)))
   ((((142) + 0)) * 4)(0)(((1 << 6) | (0 << 13) | (8 << 9)))
   ((((141) + 0)) * 4)(0)(((1 << 6) | (0 << 13) | (8 << 9)))
   ((((140) + 0)) * 4)(0)(((1 << 6) | (0 << 13) | (8 << 9)))
   ((((146) + 0)) * 4)(0)(((1 << 6) | (0 << 13) | (8 << 9)))
   ((((145) + 0)) * 4)(0)(((1 << 6) | (6 << 13) | (8 << 9)))
  >;
 };

 pinctrl_espi0: espi0_grp {
  pinctrl-single,pins = <
   ((((91) + 0)) * 4)(4)(((1 << 6) | (6 << 13) | (8 << 9)))
   ((((92) + 0)) * 4)(4)(((1 << 6) | (6 << 13) | (8 << 9)))
   ((((93) + 0)) * 4)(4)(((1 << 6) | (6 << 13) | (8 << 9)))
   ((((94) + 0)) * 4)(4)(((1 << 6) | (6 << 13) | (8 << 9)))
   ((((95) + 0)) * 4)(4)(((1 << 6) | (6 << 13) | (8 << 9)))
   ((((96) + 0)) * 4)(4)(((1 << 6) | (6 << 13) | (8 << 9)))
   ((((97) + 0)) * 4)(4)(((1 << 6) | (6 << 13) | (8 << 9)))
   ((((98) + 0)) * 4)(4)(((1 << 6) | (6 << 13) | (8 << 9)))
  >;
 };

 pinctrl_espi1: espi1_grp {
  pinctrl-single,pins = <
   ((((0) + 0)) * 4)(5)(((1 << 6) | (6 << 13) | (8 << 9)))
   ((((1) + 0)) * 4)(5)(((1 << 6) | (6 << 13) | (8 << 9)))
   ((((2) + 0)) * 4)(5)(((1 << 6) | (6 << 13) | (8 << 9)))
   ((((3) + 0)) * 4)(5)(((1 << 6) | (6 << 13) | (8 << 9)))
   ((((4) + 0)) * 4)(5)(((1 << 6) | (6 << 13) | (8 << 9)))
   ((((5) + 0)) * 4)(5)(((1 << 6) | (6 << 13) | (8 << 9)))
   ((((6) + 0)) * 4)(5)(((1 << 6) | (6 << 13) | (8 << 9)))
   ((((7) + 0)) * 4)(5)(((1 << 6) | (6 << 13) | (8 << 9)))
  >;
 };

 pinctrl_espi2: espi2_grp {
  pinctrl-single,pins = <
   ((((68) + 0)) * 4)(3)(((1 << 6) | (6 << 13) | (8 << 9)))
   ((((69) + 0)) * 4)(3)(((1 << 6) | (6 << 13) | (8 << 9)))
   ((((70) + 0)) * 4)(3)(((1 << 6) | (6 << 13) | (8 << 9)))
   ((((71) + 0)) * 4)(3)(((1 << 6) | (6 << 13) | (8 << 9)))
   ((((72) + 0)) * 4)(3)(((1 << 6) | (6 << 13) | (8 << 9)))
   ((((73) + 0)) * 4)(3)(((1 << 6) | (6 << 13) | (8 << 9)))
   ((((74) + 0)) * 4)(3)(((1 << 6) | (6 << 13) | (8 << 9)))
   ((((75) + 0)) * 4)(3)(((1 << 6) | (6 << 13) | (8 << 9)))
  >;
 };

 pinctrl_rcpu_espi0: rcpu_espi0_grp {
  pinctrl-single,pins = <
   ((((86) + 0)) * 4)(2)(((1 << 6) | (6 << 13) | (8 << 9)))
   ((((87) + 0)) * 4)(2)(((1 << 6) | (6 << 13) | (8 << 9)))
   ((((88) + 0)) * 4)(2)(((1 << 6) | (6 << 13) | (8 << 9)))
   ((((89) + 0)) * 4)(2)(((1 << 6) | (6 << 13) | (8 << 9)))
   ((((90) + 0)) * 4)(2)(((1 << 6) | (6 << 13) | (8 << 9)))
   ((((91) + 0)) * 4)(2)(((1 << 6) | (6 << 13) | (8 << 9)))
   ((((92) + 0)) * 4)(2)(((1 << 6) | (6 << 13) | (8 << 9)))
   ((((93) + 0)) * 4)(2)(((1 << 6) | (6 << 13) | (8 << 9)))
  >;
 };

 pinctrl_mmc1: mmc1_grp {
  power-source = <3300>;
  pinctrl-single,pins = <
   ((((134) + 0)) * 4)(0)(((1 << 6) | (6 << 13) | (8 << 9)))
   ((((135) + 0)) * 4)(0)(((1 << 6) | (6 << 13) | (8 << 9)))
   ((((136) + 0)) * 4)(0)(((1 << 6) | (6 << 13) | (8 << 9)))
   ((((137) + 0)) * 4)(0)(((1 << 6) | (6 << 13) | (8 << 9)))
   ((((138) + 0)) * 4)(0)(((1 << 6) | (6 << 13) | (8 << 9)))
   ((((139) + 0)) * 4)(0)(((1 << 6) | (5 << 13) | (8 << 9)))
  >;
 };

 pinctrl_mmc1_fast: mmc1_fast_grp {
  power-source = <1800>;
  pinctrl-single,pins = <
   ((((134) + 0)) * 4)(0)(((1 << 6) | (6 << 13) | (6 << 9)))
   ((((135) + 0)) * 4)(0)(((1 << 6) | (6 << 13) | (6 << 9)))
   ((((136) + 0)) * 4)(0)(((1 << 6) | (6 << 13) | (6 << 9)))
   ((((137) + 0)) * 4)(0)(((1 << 6) | (6 << 13) | (6 << 9)))
   ((((138) + 0)) * 4)(0)(((1 << 6) | (6 << 13) | (6 << 9)))
   ((((139) + 0)) * 4)(0)(((1 << 6) | (5 << 13) | (6 << 9)))
  >;
 };

 pinctrl_mmc2: mmc2_grp {
  pinctrl-single,pins =<
   ((((122) + 0)) * 4)(1)(((1 << 6) | (6 << 13) | (4 << 9)))
   ((((123) + 0)) * 4)(1)(((1 << 6) | (6 << 13) | (4 << 9)))
   ((((124) + 0)) * 4)(1)(((1 << 6) | (6 << 13) | (4 << 9)))
   ((((125) + 0)) * 4)(1)(((1 << 6) | (6 << 13) | (4 << 9)))
   ((((126) + 0)) * 4)(1)(((1 << 6) | (6 << 13) | (4 << 9)))
   ((((127) + 0)) * 4)(1)(((1 << 6) | (6 << 13) | (4 << 9)))
  >;
 };

 pinctrl_usb0: usb0_grp {
  pinctrl-single,pins =<
   ((((17) + 0)) * 4)(6)(((1 << 6) | (5 << 13) | (4 << 9)))
   ((((18) + 0)) * 4)(6)(((1 << 6) | (5 << 13) | (4 << 9)))
   ((((19) + 0)) * 4)(6)(((1 << 6) | (5 << 13) | (4 << 9)))
  >;
 };

 pinctrl_usb1: usb1_grp {
  pinctrl-single,pins =<
   ((((95) + 0)) * 4)(3)(((1 << 6) | (5 << 13) | (4 << 9)))
   ((((96) + 0)) * 4)(3)(((1 << 6) | (5 << 13) | (4 << 9)))
   ((((97) + 0)) * 4)(3)(((1 << 6) | (5 << 13) | (4 << 9)))
  >;
 };

 pinctrl_usb2: usb2_grp {
  pinctrl-single,pins =<
   ((((116) + 0)) * 4)(2)(((1 << 6) | (5 << 13) | (4 << 9)))
   ((((117) + 0)) * 4)(2)(((1 << 6) | (5 << 13) | (4 << 9)))
   ((((118) + 0)) * 4)(2)(((1 << 6) | (5 << 13) | (4 << 9)))
  >;
 };

 usb30_drd_dir_0_cfg: usb30_drd_dir-0-cfg {
  pinctrl-single,pins =<
   ((((86) + 0)) * 4)(6)(((1 << 6) | (6 << 13) | (8 << 9)))
  >;
 };

 pinctrl_pcie0_0: pcie0_0_grp {
  pinctrl-single,pins =<
   ((((42) + 0)) * 4)(4)(((1 << 6) | (0 << 13) | (4 << 9)))
   ((((43) + 0)) * 4)(4)(((1 << 6) | (0 << 13) | (4 << 9)))
   ((((44) + 0)) * 4)(4)(((1 << 6) | (0 << 13) | (4 << 9)))
  >;
 };

 pinctrl_pcie0_1: pcie0_1_grp {
  pinctrl-single,pins =<
   ((((79) + 0)) * 4)(5)(((1 << 6) | (6 << 13) | (8 << 9)))
   ((((80) + 0)) * 4)(5)(((1 << 6) | (6 << 13) | (8 << 9)))
   ((((81) + 0)) * 4)(5)(((1 << 6) | (6 << 13) | (8 << 9)))
  >;
 };

 pinctrl_pcie0_2: pcie0_2_grp {
  pinctrl-single,pins =<
   ((((108) + 0)) * 4)(5)(((1 << 6) | (0 << 13) | (4 << 9)))
   ((((109) + 0)) * 4)(5)(((1 << 6) | (0 << 13) | (4 << 9)))
   ((((110) + 0)) * 4)(5)(((1 << 6) | (0 << 13) | (4 << 9)))
  >;
 };

 pinctrl_pcie1_0: pcie1_0_grp {
  pinctrl-single,pins =<
   ((((21) + 0)) * 4)(4)(((1 << 6) | (0 << 13) | (4 << 9)))
   ((((22) + 0)) * 4)(4)(((1 << 6) | (0 << 13) | (4 << 9)))
   ((((23) + 0)) * 4)(4)(((1 << 6) | (0 << 13) | (4 << 9)))
  >;
 };

 pinctrl_pcie1_1: pcie1_1_grp {
  pinctrl-single,pins =<
   ((((88) + 0)) * 4)(4)(((1 << 6) | (0 << 13) | (4 << 9)))
   ((((89) + 0)) * 4)(4)(((1 << 6) | (0 << 13) | (4 << 9)))
   ((((90) + 0)) * 4)(4)(((1 << 6) | (0 << 13) | (4 << 9)))
  >;
 };

 pinctrl_pcie1_2: pcie1_2_grp {
  pinctrl-single,pins =<
   ((((113) + 0)) * 4)(5)(((1 << 6) | (0 << 13) | (4 << 9)))
   ((((114) + 0)) * 4)(5)(((1 << 6) | (0 << 13) | (4 << 9)))
   ((((115) + 0)) * 4)(5)(((1 << 6) | (0 << 13) | (4 << 9)))
  >;
 };

 pinctrl_pcie2_0: pcie2_0_grp {
  pinctrl-single,pins =<
   ((((12) + 0)) * 4)(4)(((1 << 6) | (0 << 13) | (4 << 9)))
   ((((13) + 0)) * 4)(4)(((1 << 6) | (0 << 13) | (4 << 9)))
   ((((14) + 0)) * 4)(4)(((1 << 6) | (0 << 13) | (4 << 9)))
  >;
 };

 pinctrl_pcie2_1: pcie2_1_grp {
  pinctrl-single,pins =<
   ((((25) + 0)) * 4)(4)(((1 << 6) | (0 << 13) | (4 << 9)))
   ((((26) + 0)) * 4)(4)(((1 << 6) | (0 << 13) | (4 << 9)))
   ((((27) + 0)) * 4)(4)(((1 << 6) | (0 << 13) | (4 << 9)))
  >;
 };

 pinctrl_pcie2_2: pcie2_2_grp {
  pinctrl-single,pins =<
   ((((58) + 0)) * 4)(4)(((1 << 6) | (0 << 13) | (4 << 9)))
   ((((59) + 0)) * 4)(4)(((1 << 6) | (0 << 13) | (4 << 9)))
   ((((60) + 0)) * 4)(4)(((1 << 6) | (0 << 13) | (4 << 9)))
  >;
 };

 pinctrl_pcie3_0: pcie3_0_grp {
  pinctrl-single,pins =<
   ((((3) + 0)) * 4)(4)(((1 << 6) | (0 << 13) | (4 << 9)))
   ((((4) + 0)) * 4)(4)(((1 << 6) | (0 << 13) | (4 << 9)))
   ((((5) + 0)) * 4)(4)(((1 << 6) | (0 << 13) | (4 << 9)))
  >;
 };

 pinctrl_pcie3_1: pcie3_1_grp {
  pinctrl-single,pins =<
   ((((105) + 0)) * 4)(5)(((1 << 6) | (0 << 13) | (4 << 9)))
   ((((106) + 0)) * 4)(5)(((1 << 6) | (0 << 13) | (4 << 9)))
   ((((107) + 0)) * 4)(5)(((1 << 6) | (0 << 13) | (4 << 9)))
  >;
 };

 pinctrl_pcie3_2: pcie3_2_grp {
  pinctrl-single,pins =<
   ((((124) + 0)) * 4)(3)(((1 << 6) | (0 << 13) | (4 << 9)))
   ((((125) + 0)) * 4)(3)(((1 << 6) | (0 << 13) | (4 << 9)))
   ((((126) + 0)) * 4)(3)(((1 << 6) | (0 << 13) | (4 << 9)))
  >;
 };

 pinctrl_pcie4_0: pcie4_0_grp {
  pinctrl-single,pins =<
   ((((31) + 0)) * 4)(4)(((1 << 6) | (0 << 13) | (4 << 9)))
   ((((32) + 0)) * 4)(4)(((1 << 6) | (0 << 13) | (4 << 9)))
   ((((33) + 0)) * 4)(4)(((1 << 6) | (0 << 13) | (4 << 9)))
  >;
 };

 pinctrl_pcie4_1: pcie4_1_grp {
  pinctrl-single,pins =<
   ((((76) + 0)) * 4)(5)(((1 << 6) | (0 << 13) | (4 << 9)))
   ((((77) + 0)) * 4)(5)(((1 << 6) | (0 << 13) | (4 << 9)))
   ((((78) + 0)) * 4)(5)(((1 << 6) | (0 << 13) | (4 << 9)))
  >;
 };

 pinctrl_gmac0: gmac0_grp {
  pinctrl-single,pins =<
   ((((0) + 0)) * 4)(1)(((1 << 6) | (0 << 13) | (4 << 9)))
   ((((1) + 0)) * 4)(1)(((1 << 6) | (0 << 13) | (4 << 9)))
   ((((2) + 0)) * 4)(1)(((1 << 6) | (0 << 13) | (4 << 9)))
   ((((3) + 0)) * 4)(1)(((1 << 6) | (0 << 13) | (4 << 9)))
   ((((4) + 0)) * 4)(1)(((1 << 6) | (0 << 13) | (4 << 9)))
   ((((5) + 0)) * 4)(1)(((1 << 6) | (0 << 13) | (4 << 9)))
   ((((6) + 0)) * 4)(1)(((1 << 6) | (0 << 13) | (4 << 9)))
   ((((7) + 0)) * 4)(1)(((1 << 6) | (0 << 13) | (4 << 9)))
   ((((8) + 0)) * 4)(1)(((1 << 6) | (0 << 13) | (4 << 9)))
   ((((9) + 0)) * 4)(1)(((1 << 6) | (0 << 13) | (4 << 9)))
   ((((10) + 0)) * 4)(1)(((1 << 6) | (0 << 13) | (4 << 9)))
   ((((11) + 0)) * 4)(1)(((1 << 6) | (0 << 13) | (4 << 9)))
   ((((12) + 0)) * 4)(1)(((1 << 6) | (0 << 13) | (4 << 9)))
   ((((13) + 0)) * 4)(1)(((1 << 6) | (0 << 13) | (4 << 9)))
   ((((14) + 0)) * 4)(1)(((1 << 6) | (0 << 13) | (4 << 9)))
   ((((20) + 0)) * 4)(1)(((1 << 6) | (0 << 13) | (4 << 9)))
  >;
 };

 pinctrl_gmac1: gmac1_grp {
  pinctrl-single,pins =<
   ((((21) + 0)) * 4)(1)(((1 << 6) | (0 << 13) | (4 << 9)))
   ((((22) + 0)) * 4)(1)(((1 << 6) | (0 << 13) | (4 << 9)))
   ((((23) + 0)) * 4)(1)(((1 << 6) | (0 << 13) | (4 << 9)))
   ((((24) + 0)) * 4)(1)(((1 << 6) | (0 << 13) | (4 << 9)))
   ((((25) + 0)) * 4)(1)(((1 << 6) | (0 << 13) | (4 << 9)))
   ((((26) + 0)) * 4)(1)(((1 << 6) | (0 << 13) | (4 << 9)))
   ((((27) + 0)) * 4)(1)(((1 << 6) | (0 << 13) | (4 << 9)))
   ((((28) + 0)) * 4)(1)(((1 << 6) | (0 << 13) | (4 << 9)))
   ((((29) + 0)) * 4)(1)(((1 << 6) | (0 << 13) | (4 << 9)))
   ((((30) + 0)) * 4)(1)(((1 << 6) | (0 << 13) | (4 << 9)))
   ((((31) + 0)) * 4)(1)(((1 << 6) | (0 << 13) | (4 << 9)))
   ((((32) + 0)) * 4)(1)(((1 << 6) | (0 << 13) | (4 << 9)))
   ((((33) + 0)) * 4)(1)(((1 << 6) | (0 << 13) | (4 << 9)))
   ((((34) + 0)) * 4)(1)(((1 << 6) | (0 << 13) | (4 << 9)))
   ((((35) + 0)) * 4)(1)(((1 << 6) | (0 << 13) | (4 << 9)))
   ((((36) + 0)) * 4)(1)(((1 << 6) | (0 << 13) | (4 << 9)))
  >;
 };

 pinctrl_gmac2: gmac2_grp {
  pinctrl-single,pins =<
   ((((42) + 0)) * 4)(1)(((1 << 6) | (0 << 13) | (4 << 9)))
   ((((43) + 0)) * 4)(1)(((1 << 6) | (0 << 13) | (4 << 9)))
   ((((44) + 0)) * 4)(1)(((1 << 6) | (0 << 13) | (4 << 9)))
   ((((45) + 0)) * 4)(1)(((1 << 6) | (0 << 13) | (4 << 9)))
   ((((46) + 0)) * 4)(1)(((1 << 6) | (0 << 13) | (4 << 9)))
   ((((47) + 0)) * 4)(1)(((1 << 6) | (0 << 13) | (4 << 9)))
   ((((48) + 0)) * 4)(1)(((1 << 6) | (0 << 13) | (4 << 9)))
   ((((49) + 0)) * 4)(1)(((1 << 6) | (0 << 13) | (4 << 9)))
   ((((50) + 0)) * 4)(1)(((1 << 6) | (0 << 13) | (4 << 9)))
   ((((51) + 0)) * 4)(1)(((1 << 6) | (0 << 13) | (4 << 9)))
   ((((52) + 0)) * 4)(1)(((1 << 6) | (0 << 13) | (4 << 9)))
   ((((53) + 0)) * 4)(1)(((1 << 6) | (0 << 13) | (4 << 9)))
   ((((54) + 0)) * 4)(1)(((1 << 6) | (0 << 13) | (4 << 9)))
   ((((55) + 0)) * 4)(1)(((1 << 6) | (0 << 13) | (4 << 9)))
   ((((56) + 0)) * 4)(1)(((1 << 6) | (0 << 13) | (4 << 9)))
   ((((57) + 0)) * 4)(1)(((1 << 6) | (0 << 13) | (4 << 9)))
  >;
 };

 pinctrl_can0_0: can0_0_grp {
  pinctrl-single,pins = <
   ((((11) + 0)) * 4)(3)(((1 << 6) | (6 << 13) | (4 << 9)))
   ((((12) + 0)) * 4)(3)(((1 << 6) | (6 << 13) | (4 << 9)))
  >;
 };

 pinctrl_can0_1: can0_1_grp {
  pinctrl-single,pins = <
   ((((44) + 0)) * 4)(3)(((1 << 6) | (6 << 13) | (4 << 9)))
   ((((45) + 0)) * 4)(3)(((1 << 6) | (6 << 13) | (4 << 9)))
  >;
 };

 pinctrl_can0_2: can0_2_grp {
  pinctrl-single,pins = <
   ((((76) + 0)) * 4)(4)(((1 << 6) | (6 << 13) | (4 << 9)))
   ((((77) + 0)) * 4)(4)(((1 << 6) | (6 << 13) | (4 << 9)))
  >;
 };

 pinctrl_can1_0: can1_0_grp {
  pinctrl-single,pins = <
   ((((49) + 0)) * 4)(3)(((1 << 6) | (6 << 13) | (4 << 9)))
   ((((48) + 0)) * 4)(3)(((1 << 6) | (6 << 13) | (4 << 9)))
  >;
 };

 pinctrl_can1_1: can1_1_grp {
  pinctrl-single,pins = <
   ((((89) + 0)) * 4)(6)(((1 << 6) | (6 << 13) | (4 << 9)))
   ((((88) + 0)) * 4)(6)(((1 << 6) | (6 << 13) | (4 << 9)))
  >;
 };

 pinctrl_can1_2: can1_2_grp {
  pinctrl-single,pins = <
   ((((109) + 0)) * 4)(4)(((1 << 6) | (6 << 13) | (4 << 9)))
   ((((110) + 0)) * 4)(4)(((1 << 6) | (6 << 13) | (4 << 9)))
  >;
 };

 pinctrl_can2_0: can2_0_grp {
  pinctrl-single,pins = <
   ((((50) + 0)) * 4)(3)(((1 << 6) | (6 << 13) | (4 << 9)))
   ((((51) + 0)) * 4)(3)(((1 << 6) | (6 << 13) | (4 << 9)))
  >;
 };

 pinctrl_can2_1: can2_1_grp {
  pinctrl-single,pins = <
   ((((86) + 0)) * 4)(4)(((1 << 6) | (6 << 13) | (4 << 9)))
   ((((87) + 0)) * 4)(4)(((1 << 6) | (6 << 13) | (4 << 9)))
  >;
 };

 pinctrl_can2_2: can2_2_grp {
  pinctrl-single,pins = <
   ((((109) + 0)) * 4)(4)(((1 << 6) | (6 << 13) | (4 << 9)))
   ((((110) + 0)) * 4)(4)(((1 << 6) | (6 << 13) | (4 << 9)))
  >;
 };

 pinctrl_can3_1: can3_1_grp {
  pinctrl-single,pins = <
   ((((81) + 0)) * 4)(4)(((1 << 6) | (6 << 13) | (4 << 9)))
   ((((80) + 0)) * 4)(4)(((1 << 6) | (6 << 13) | (4 << 9)))
  >;
 };

 pinctrl_can3_2: can3_2_grp {
  pinctrl-single,pins = <
   ((((103) + 0)) * 4)(4)(((1 << 6) | (6 << 13) | (4 << 9)))
   ((((104) + 0)) * 4)(4)(((1 << 6) | (6 << 13) | (4 << 9)))
  >;
 };

 pinctrl_can4_1: can4_1_grp {
  pinctrl-single,pins = <
   ((((40) + 0)) * 4)(6)(((1 << 6) | (6 << 13) | (4 << 9)))
   ((((41) + 0)) * 4)(6)(((1 << 6) | (6 << 13) | (4 << 9)))
  >;
 };

 pinctrl_can4_2: can4_2_grp {
  pinctrl-single,pins = <
   ((((102) + 0)) * 4)(4)(((1 << 6) | (6 << 13) | (4 << 9)))
   ((((101) + 0)) * 4)(4)(((1 << 6) | (6 << 13) | (4 << 9)))
  >;
 };

 pinctrl_can4_3: can4_3_grp {
  pinctrl-single,pins = <
   ((((120) + 0)) * 4)(4)(((1 << 6) | (6 << 13) | (4 << 9)))
   ((((121) + 0)) * 4)(4)(((1 << 6) | (6 << 13) | (4 << 9)))
  >;
 };

 pinctrl_camera1_0: camera1_0_grp {
  pinctrl-single,pins =<
   ((((13) + 0)) * 4)(5)(((1 << 6) | (0 << 13) | (4 << 9)))
  >;
 };

 pinctrl_camera1_1: camera1_1_grp {
  pinctrl-single,pins =<
   ((((46) + 0)) * 4)(3)(((1 << 6) | (0 << 13) | (4 << 9)))
  >;
 };

 pinctrl_camera1_2: camera1_2_grp {
  pinctrl-single,pins =<
   ((((75) + 0)) * 4)(2)(((1 << 6) | (0 << 13) | (4 << 9)))
  >;
 };

 pinctrl_camera2_0: camera2_0_grp {
  pinctrl-single,pins =<
   ((((34) + 0)) * 4)(4)(((1 << 6) | (0 << 13) | (4 << 9)))
  >;
 };

 pinctrl_camera2_1: camera2_1_grp {
  pinctrl-single,pins =<
   ((((47) + 0)) * 4)(3)(((1 << 6) | (0 << 13) | (4 << 9)))
  >;
 };

 pinctrl_camera2_2: camera2_2_grp {
  pinctrl-single,pins =<
   ((((74) + 0)) * 4)(2)(((1 << 6) | (0 << 13) | (4 << 9)))
  >;
 };

 pinctrl_camera3_0: camera3_0_grp {
  pinctrl-single,pins =<
   ((((35) + 0)) * 4)(4)(((1 << 6) | (0 << 13) | (4 << 9)))
  >;
 };

 pinctrl_camera3_1: camera3_1_grp {
  pinctrl-single,pins =<
   ((((52) + 0)) * 4)(5)(((1 << 6) | (0 << 13) | (4 << 9)))
  >;
 };

 pinctrl_camera3_2: camera3_2_grp {
  pinctrl-single,pins =<
   ((((85) + 0)) * 4)(1)(((1 << 6) | (0 << 13) | (4 << 9)))
  >;
 };

 pinctrl_camera4_0: camera4_0_grp {
  pinctrl-single,pins =<
   ((((43) + 0)) * 4)(3)(((1 << 6) | (0 << 13) | (4 << 9)))
  >;
 };

 pinctrl_camera4_1: camera4_1_grp {
  pinctrl-single,pins =<
   ((((67) + 0)) * 4)(4)(((1 << 6) | (0 << 13) | (4 << 9)))
  >;
 };

 pinctrl_camera4_2: camera4_2_grp {
  pinctrl-single,pins =<
   ((((99) + 0)) * 4)(6)(((1 << 6) | (0 << 13) | (4 << 9)))
  >;
 };

 pinctrl_mn_clk1_0: mn_clk1_0_grp {
  pinctrl-single,pins = <
   ((((14) + 0)) * 4)(5)(((1 << 6) | (0 << 13) | (4 << 9)))
  >;
 };

 pinctrl_mn_clk1_1: mn_clk1_1_grp {
  pinctrl-single,pins = <
   ((((39) + 0)) * 4)(3)(((1 << 6) | (0 << 13) | (4 << 9)))
  >;
 };

 pinctrl_mn_clk1_2: mn_clk1_2_grp {
  pinctrl-single,pins = <
   ((((70) + 0)) * 4)(5)(((1 << 6) | (0 << 13) | (4 << 9)))
  >;
 };

 pinctrl_mn_clk1_3: mn_clk1_3_grp {
  pinctrl-single,pins = <
   ((((101) + 0)) * 4)(6)(((1 << 6) | (0 << 13) | (4 << 9)))
  >;
 };

 pinctrl_mn_clk2_0: mn_clk2_0_grp {
  pinctrl-single,pins =<
   ((((15) + 0)) * 4)(5)(((1 << 6) | (0 << 13) | (4 << 9)))
  >;
 };

 pinctrl_mn_clk2_1: mn_clk2_1_grp {
  pinctrl-single,pins =<
   ((((40) + 0)) * 4)(3)(((1 << 6) | (0 << 13) | (4 << 9)))
  >;
 };

 pinctrl_mn_clk2_2: mn_clk2_2_grp {
  pinctrl-single,pins =<
   ((((71) + 0)) * 4)(5)(((1 << 6) | (0 << 13) | (4 << 9)))
  >;
 };

 pinctrl_vcxo_0: vcxo_0_grp {
  pinctrl-single,pins =<
   ((((74) + 0)) * 4)(4)(((1 << 6) | (0 << 13) | (4 << 9)))
   ((((75) + 0)) * 4)(4)(((1 << 6) | (0 << 13) | (4 << 9)))
  >;
 };

 pinctrl_vcxo_out_0: vcxo_out_0_grp {
  pinctrl-single,pins =<
   ((((75) + 0)) * 4)(4)(((1 << 6) | (0 << 13) | (4 << 9)))
  >;
 };

 pinctrl_32k_out_0: 32k_out_0_grp {
  pinctrl-single,pins =<
   ((((41) + 0)) * 4)(3)(((1 << 6) | (0 << 13) | (4 << 9)))
  >;
 };

 pinctrl_32k_out_1: 32k_out_1_grp {
  pinctrl-single,pins =<
   ((((98) + 0)) * 4)(3)(((1 << 6) | (0 << 13) | (4 << 9)))
  >;
 };

 pinctrl_32k_out_2: 32k_out_2_grp {
  pinctrl-single,pins =<
   ((((100) + 0)) * 4)(6)(((1 << 6) | (0 << 13) | (4 << 9)))
  >;
 };

 pinctrl_pri: pri_grp {
  pinctrl-single,pins =<
   ((((147) + 0)) * 4)(0)(((1 << 6) | (6 << 13) | (4 << 9)))
   ((((148) + 0)) * 4)(0)(((1 << 6) | (6 << 13) | (4 << 9)))
   ((((149) + 0)) * 4)(0)(((1 << 6) | (6 << 13) | (4 << 9)))
   ((((150) + 0)) * 4)(0)(((1 << 6) | (6 << 13) | (4 << 9)))
  >;
 };

 pinctrl_dp0_0: dp0_0_grp {
  pinctrl-single,pins =<
   ((((9) + 0)) * 4)(6)(((1 << 6) | (0 << 13) | (8 << 9)))
  >;
 };

 pinctrl_dp0_1: dp0_1_grp {
  pinctrl-single,pins =<
   ((((23) + 0)) * 4)(6)(((1 << 6) | (0 << 13) | (8 << 9)))
  >;
 };

 pinctrl_dp0_2: dp0_2_grp {
  pinctrl-single,pins =<
   ((((97) + 0)) * 4)(5)(((1 << 6) | (0 << 13) | (8 << 9)))
  >;
 };

 pinctrl_dp0_3: dp0_3_grp {
  pinctrl-single,pins =<
   ((((124) + 0)) * 4)(4)(((1 << 6) | (0 << 13) | (8 << 9)))
  >;
 };

 pinctrl_dp1_0: dp1_0_grp {
  pinctrl-single,pins =<
   ((((10) + 0)) * 4)(6)(((1 << 6) | (0 << 13) | (8 << 9)))
  >;
 };

 pinctrl_dp1_1: dp1_1_grp {
  pinctrl-single,pins =<
   ((((24) + 0)) * 4)(6)(((1 << 6) | (0 << 13) | (8 << 9)))
  >;
 };

 pinctrl_dp1_2: dp1_2_grp {
  pinctrl-single,pins =<
   ((((69) + 0)) * 4)(4)(((1 << 6) | (0 << 13) | (8 << 9)))
  >;
 };

 pinctrl_dp1_3: dp1_3_grp {
  pinctrl-single,pins =<
   ((((72) + 0)) * 4)(4)(((1 << 6) | (0 << 13) | (8 << 9)))
  >;
 };

 pinctrl_dp1_4: dp1_4_grp {
  pinctrl-single,pins =<
   ((((98) + 0)) * 4)(5)(((1 << 6) | (0 << 13) | (8 << 9)))
  >;
 };

 pinctrl_dp1_5: dp1_5_grp {
  pinctrl-single,pins =<
   ((((125) + 0)) * 4)(4)(((1 << 6) | (0 << 13) | (8 << 9)))
  >;
 };
};

/ {
 pinctrl_voltage_domain: pinctrl-voltage-domain {
  compatible = "spacemit,pinctrl-voltage-domain";
  spacemit,pin-voltage-map = <
   0 20 1800
   21 41 3300
   76 98 1800
   99 127 3300
   134 139 3300
   140 146 1800
  >;
 };
};
# 411 "/tmp/k3-independent-audit/platforms/Platform/Spacemit/K3/DeviceTree/K3.dtsi" 2
# 15 "/tmp/k3-independent-audit/platforms/Platform/Spacemit/K3/DeviceTree/k3-deepcomputing-fml13v05.dts" 2

/ {
 model = "DeepComputing FML13V05";
 compatible = "deepcomputing,fml13v05", "spacemit,k3", "riscv";
};

# 0 "/tmp/k3-independent-audit/platforms/Platform/Spacemit/K3/DeviceTree/Os/k3-pico-itx.os.dts"
# 0 "<built-in>"
# 0 "<command-line>"
# 1 "/tmp/k3-independent-audit/platforms/Platform/Spacemit/K3/DeviceTree/Os/k3-pico-itx.os.dts"

# 1 "/tmp/k3-independent-audit/platforms/Platform/Spacemit/K3/DeviceTree/Os/Sources/arch/riscv/boot/dts/spacemit/k3-pico-itx.dts" 1





# 1 "/tmp/k3-independent-audit/platforms/Platform/Spacemit/K3/DeviceTree/Os/Sources/include/dt-bindings/gpio/gpio.h" 1
# 7 "/tmp/k3-independent-audit/platforms/Platform/Spacemit/K3/DeviceTree/Os/Sources/arch/riscv/boot/dts/spacemit/k3-pico-itx.dts" 2

# 1 "/tmp/k3-independent-audit/platforms/Platform/Spacemit/K3/DeviceTree/Os/Sources/arch/riscv/boot/dts/spacemit/k3.dtsi" 1






# 1 "/tmp/k3-independent-audit/platforms/Platform/Spacemit/K3/DeviceTree/Os/Sources/include/dt-bindings/clock/spacemit,k3-clocks.h" 1
# 8 "/tmp/k3-independent-audit/platforms/Platform/Spacemit/K3/DeviceTree/Os/Sources/arch/riscv/boot/dts/spacemit/k3.dtsi" 2
# 1 "/tmp/k3-independent-audit/platforms/Platform/Spacemit/K3/DeviceTree/Os/Sources/include/dt-bindings/interrupt-controller/irq.h" 1
# 9 "/tmp/k3-independent-audit/platforms/Platform/Spacemit/K3/DeviceTree/Os/Sources/arch/riscv/boot/dts/spacemit/k3.dtsi" 2
# 1 "/tmp/k3-independent-audit/platforms/Platform/Spacemit/K3/DeviceTree/Os/Sources/include/dt-bindings/reset/spacemit,k3-resets.h" 1
# 10 "/tmp/k3-independent-audit/platforms/Platform/Spacemit/K3/DeviceTree/Os/Sources/arch/riscv/boot/dts/spacemit/k3.dtsi" 2
# 1 "/tmp/k3-independent-audit/platforms/Platform/Spacemit/K3/DeviceTree/Os/Sources/include/dt-bindings/phy/phy.h" 1
# 11 "/tmp/k3-independent-audit/platforms/Platform/Spacemit/K3/DeviceTree/Os/Sources/arch/riscv/boot/dts/spacemit/k3.dtsi" 2

# 1 "/tmp/k3-independent-audit/platforms/Platform/Spacemit/K3/DeviceTree/Os/Sources/arch/riscv/boot/dts/spacemit/k3-pdma.h" 1
# 13 "/tmp/k3-independent-audit/platforms/Platform/Spacemit/K3/DeviceTree/Os/Sources/arch/riscv/boot/dts/spacemit/k3.dtsi" 2

/dts-v1/;

/ {
 #address-cells = <2>;
 #size-cells = <2>;
 model = "SpacemiT K3";
 compatible = "spacemit,k3";

 cpus: cpus {
  #address-cells = <1>;
  #size-cells = <0>;
  timebase-frequency = <24000000>;

  cpu_0: cpu@0 {
   compatible = "spacemit,x100", "riscv";
   device_type = "cpu";
   reg = <0>;
   riscv,isa-base = "rv64i";
   riscv,isa-extensions = "i", "m", "a", "f", "d", "c", "b", "v", "h",
            "sha", "shcounterenw", "shgatpa", "shtvala",
            "shvsatpa", "shvstvala", "shvstvecd", "smaia",
            "smstateen", "ssaia", "ssccptr", "sscofpmf",
            "sscounterenw", "ssnpm", "ssstateen", "sstc",
            "sstvala", "sstvecd", "ssu64xl", "svade",
            "svinval", "svnapot", "svpbmt", "za64rs",
            "zawrs", "zba", "zbb", "zbc", "zbs", "zca",
            "zcb", "zcd", "zcmop", "zfa", "zfbfmin",
            "zfh", "zfhmin", "zicbom", "zicbop", "zicboz",
            "ziccamoa", "ziccif", "zicclsm", "ziccrse", "zicntr",
            "zicond", "zicsr", "zifencei", "zihintntl",
            "zihintpause", "zihpm", "zimop", "zkt", "zvbb",
            "zvbc", "zvfbfmin", "zvfbfwma", "zvfh",
            "zvfhmin", "zvkb", "zvkg", "zvkn", "zvknc",
            "zvkned", "zvkng", "zvknha", "zvknhb", "zvks",
            "zvksc", "zvksed", "zvksg", "zvksh", "zvkt";
   riscv,cbom-block-size = <64>;
   riscv,cbop-block-size = <64>;
   riscv,cboz-block-size = <64>;
   i-cache-block-size = <64>;
   i-cache-size = <65536>;
   i-cache-sets = <256>;
   d-cache-block-size = <64>;
   d-cache-size = <65536>;
   d-cache-sets = <256>;
   next-level-cache = <&l2_cache0>;
   mmu-type = "riscv,sv39";

   cpu0_intc: interrupt-controller {
    compatible = "riscv,cpu-intc";
    #interrupt-cells = <1>;
    interrupt-controller;
   };
  };

  cpu_1: cpu@1 {
   compatible = "spacemit,x100", "riscv";
   device_type = "cpu";
   reg = <1>;
   riscv,isa-base = "rv64i";
   riscv,isa-extensions = "i", "m", "a", "f", "d", "c", "b", "v", "h",
            "sha", "shcounterenw", "shgatpa", "shtvala",
            "shvsatpa", "shvstvala", "shvstvecd", "smaia",
            "smstateen", "ssaia", "ssccptr", "sscofpmf",
            "sscounterenw", "ssnpm", "ssstateen", "sstc",
            "sstvala", "sstvecd", "ssu64xl", "svade",
            "svinval", "svnapot", "svpbmt", "za64rs",
            "zawrs", "zba", "zbb", "zbc", "zbs", "zca",
            "zcb", "zcd", "zcmop", "zfa", "zfbfmin",
            "zfh", "zfhmin", "zicbom", "zicbop", "zicboz",
            "ziccamoa", "ziccif", "zicclsm", "ziccrse", "zicntr",
            "zicond", "zicsr", "zifencei", "zihintntl",
            "zihintpause", "zihpm", "zimop", "zkt", "zvbb",
            "zvbc", "zvfbfmin", "zvfbfwma", "zvfh",
            "zvfhmin", "zvkb", "zvkg", "zvkn", "zvknc",
            "zvkned", "zvkng", "zvknha", "zvknhb", "zvks",
            "zvksc", "zvksed", "zvksg", "zvksh", "zvkt";
   riscv,cbom-block-size = <64>;
   riscv,cbop-block-size = <64>;
   riscv,cboz-block-size = <64>;
   i-cache-block-size = <64>;
   i-cache-size = <65536>;
   i-cache-sets = <256>;
   d-cache-block-size = <64>;
   d-cache-size = <65536>;
   d-cache-sets = <256>;
   next-level-cache = <&l2_cache0>;
   mmu-type = "riscv,sv39";

   cpu1_intc: interrupt-controller {
    compatible = "riscv,cpu-intc";
    #interrupt-cells = <1>;
    interrupt-controller;
   };
  };

  cpu_2: cpu@2 {
   compatible = "spacemit,x100", "riscv";
   device_type = "cpu";
   reg = <2>;
   riscv,isa-base = "rv64i";
   riscv,isa-extensions = "i", "m", "a", "f", "d", "c", "b", "v", "h",
            "sha", "shcounterenw", "shgatpa", "shtvala",
            "shvsatpa", "shvstvala", "shvstvecd", "smaia",
            "smstateen", "ssaia", "ssccptr", "sscofpmf",
            "sscounterenw", "ssnpm", "ssstateen", "sstc",
            "sstvala", "sstvecd", "ssu64xl", "svade",
            "svinval", "svnapot", "svpbmt", "za64rs",
            "zawrs", "zba", "zbb", "zbc", "zbs", "zca",
            "zcb", "zcd", "zcmop", "zfa", "zfbfmin",
            "zfh", "zfhmin", "zicbom", "zicbop", "zicboz",
            "ziccamoa", "ziccif", "zicclsm", "ziccrse", "zicntr",
            "zicond", "zicsr", "zifencei", "zihintntl",
            "zihintpause", "zihpm", "zimop", "zkt", "zvbb",
            "zvbc", "zvfbfmin", "zvfbfwma", "zvfh",
            "zvfhmin", "zvkb", "zvkg", "zvkn", "zvknc",
            "zvkned", "zvkng", "zvknha", "zvknhb", "zvks",
            "zvksc", "zvksed", "zvksg", "zvksh", "zvkt";
   riscv,cbom-block-size = <64>;
   riscv,cbop-block-size = <64>;
   riscv,cboz-block-size = <64>;
   i-cache-block-size = <64>;
   i-cache-size = <65536>;
   i-cache-sets = <256>;
   d-cache-block-size = <64>;
   d-cache-size = <65536>;
   d-cache-sets = <256>;
   next-level-cache = <&l2_cache0>;
   mmu-type = "riscv,sv39";

   cpu2_intc: interrupt-controller {
    compatible = "riscv,cpu-intc";
    #interrupt-cells = <1>;
    interrupt-controller;
   };
  };

  cpu_3: cpu@3 {
   compatible = "spacemit,x100", "riscv";
   device_type = "cpu";
   reg = <3>;
   riscv,isa-base = "rv64i";
   riscv,isa-extensions = "i", "m", "a", "f", "d", "c", "b", "v", "h",
            "sha", "shcounterenw", "shgatpa", "shtvala",
            "shvsatpa", "shvstvala", "shvstvecd", "smaia",
            "smstateen", "ssaia", "ssccptr", "sscofpmf",
            "sscounterenw", "ssnpm", "ssstateen", "sstc",
            "sstvala", "sstvecd", "ssu64xl", "svade",
            "svinval", "svnapot", "svpbmt", "za64rs",
            "zawrs", "zba", "zbb", "zbc", "zbs", "zca",
            "zcb", "zcd", "zcmop", "zfa", "zfbfmin",
            "zfh", "zfhmin", "zicbom", "zicbop", "zicboz",
            "ziccamoa", "ziccif", "zicclsm", "ziccrse", "zicntr",
            "zicond", "zicsr", "zifencei", "zihintntl",
            "zihintpause", "zihpm", "zimop", "zkt", "zvbb",
            "zvbc", "zvfbfmin", "zvfbfwma", "zvfh",
            "zvfhmin", "zvkb", "zvkg", "zvkn", "zvknc",
            "zvkned", "zvkng", "zvknha", "zvknhb", "zvks",
            "zvksc", "zvksed", "zvksg", "zvksh", "zvkt";
   riscv,cbom-block-size = <64>;
   riscv,cbop-block-size = <64>;
   riscv,cboz-block-size = <64>;
   i-cache-block-size = <64>;
   i-cache-size = <65536>;
   i-cache-sets = <256>;
   d-cache-block-size = <64>;
   d-cache-size = <65536>;
   d-cache-sets = <256>;
   next-level-cache = <&l2_cache0>;
   mmu-type = "riscv,sv39";

   cpu3_intc: interrupt-controller {
    compatible = "riscv,cpu-intc";
    #interrupt-cells = <1>;
    interrupt-controller;
   };
  };

  cpu_4: cpu@4 {
   compatible = "spacemit,x100", "riscv";
   device_type = "cpu";
   reg = <4>;
   riscv,isa-base = "rv64i";
   riscv,isa-extensions = "i", "m", "a", "f", "d", "c", "b", "v", "h",
            "sha", "shcounterenw", "shgatpa", "shtvala",
            "shvsatpa", "shvstvala", "shvstvecd", "smaia",
            "smstateen", "ssaia", "ssccptr", "sscofpmf",
            "sscounterenw", "ssnpm", "ssstateen", "sstc",
            "sstvala", "sstvecd", "ssu64xl", "svade",
            "svinval", "svnapot", "svpbmt", "za64rs",
            "zawrs", "zba", "zbb", "zbc", "zbs", "zca",
            "zcb", "zcd", "zcmop", "zfa", "zfbfmin",
            "zfh", "zfhmin", "zicbom", "zicbop", "zicboz",
            "ziccamoa", "ziccif", "zicclsm", "ziccrse", "zicntr",
            "zicond", "zicsr", "zifencei", "zihintntl",
            "zihintpause", "zihpm", "zimop", "zkt", "zvbb",
            "zvbc", "zvfbfmin", "zvfbfwma", "zvfh",
            "zvfhmin", "zvkb", "zvkg", "zvkn", "zvknc",
            "zvkned", "zvkng", "zvknha", "zvknhb", "zvks",
            "zvksc", "zvksed", "zvksg", "zvksh", "zvkt";
   riscv,cbom-block-size = <64>;
   riscv,cbop-block-size = <64>;
   riscv,cboz-block-size = <64>;
   i-cache-block-size = <64>;
   i-cache-size = <65536>;
   i-cache-sets = <256>;
   d-cache-block-size = <64>;
   d-cache-size = <65536>;
   d-cache-sets = <256>;
   next-level-cache = <&l2_cache1>;
   mmu-type = "riscv,sv39";

   cpu4_intc: interrupt-controller {
    compatible = "riscv,cpu-intc";
    #interrupt-cells = <1>;
    interrupt-controller;
   };
  };

  cpu_5: cpu@5 {
   compatible = "spacemit,x100", "riscv";
   device_type = "cpu";
   reg = <5>;
   riscv,isa-base = "rv64i";
   riscv,isa-extensions = "i", "m", "a", "f", "d", "c", "b", "v", "h",
            "sha", "shcounterenw", "shgatpa", "shtvala",
            "shvsatpa", "shvstvala", "shvstvecd", "smaia",
            "smstateen", "ssaia", "ssccptr", "sscofpmf",
            "sscounterenw", "ssnpm", "ssstateen", "sstc",
            "sstvala", "sstvecd", "ssu64xl", "svade",
            "svinval", "svnapot", "svpbmt", "za64rs",
            "zawrs", "zba", "zbb", "zbc", "zbs", "zca",
            "zcb", "zcd", "zcmop", "zfa", "zfbfmin",
            "zfh", "zfhmin", "zicbom", "zicbop", "zicboz",
            "ziccamoa", "ziccif", "zicclsm", "ziccrse", "zicntr",
            "zicond", "zicsr", "zifencei", "zihintntl",
            "zihintpause", "zihpm", "zimop", "zkt", "zvbb",
            "zvbc", "zvfbfmin", "zvfbfwma", "zvfh",
            "zvfhmin", "zvkb", "zvkg", "zvkn", "zvknc",
            "zvkned", "zvkng", "zvknha", "zvknhb", "zvks",
            "zvksc", "zvksed", "zvksg", "zvksh", "zvkt";
   riscv,cbom-block-size = <64>;
   riscv,cbop-block-size = <64>;
   riscv,cboz-block-size = <64>;
   i-cache-block-size = <64>;
   i-cache-size = <65536>;
   i-cache-sets = <256>;
   d-cache-block-size = <64>;
   d-cache-size = <65536>;
   d-cache-sets = <256>;
   next-level-cache = <&l2_cache1>;
   mmu-type = "riscv,sv39";

   cpu5_intc: interrupt-controller {
    compatible = "riscv,cpu-intc";
    #interrupt-cells = <1>;
    interrupt-controller;
   };
  };

  cpu_6: cpu@6 {
   compatible = "spacemit,x100", "riscv";
   device_type = "cpu";
   reg = <6>;
   riscv,isa-base = "rv64i";
   riscv,isa-extensions = "i", "m", "a", "f", "d", "c", "b", "v", "h",
            "sha", "shcounterenw", "shgatpa", "shtvala",
            "shvsatpa", "shvstvala", "shvstvecd", "smaia",
            "smstateen", "ssaia", "ssccptr", "sscofpmf",
            "sscounterenw", "ssnpm", "ssstateen", "sstc",
            "sstvala", "sstvecd", "ssu64xl", "svade",
            "svinval", "svnapot", "svpbmt", "za64rs",
            "zawrs", "zba", "zbb", "zbc", "zbs", "zca",
            "zcb", "zcd", "zcmop", "zfa", "zfbfmin",
            "zfh", "zfhmin", "zicbom", "zicbop", "zicboz",
            "ziccamoa", "ziccif", "zicclsm", "ziccrse", "zicntr",
            "zicond", "zicsr", "zifencei", "zihintntl",
            "zihintpause", "zihpm", "zimop", "zkt", "zvbb",
            "zvbc", "zvfbfmin", "zvfbfwma", "zvfh",
            "zvfhmin", "zvkb", "zvkg", "zvkn", "zvknc",
            "zvkned", "zvkng", "zvknha", "zvknhb", "zvks",
            "zvksc", "zvksed", "zvksg", "zvksh", "zvkt";
   riscv,cbom-block-size = <64>;
   riscv,cbop-block-size = <64>;
   riscv,cboz-block-size = <64>;
   i-cache-block-size = <64>;
   i-cache-size = <65536>;
   i-cache-sets = <256>;
   d-cache-block-size = <64>;
   d-cache-size = <65536>;
   d-cache-sets = <256>;
   next-level-cache = <&l2_cache1>;
   mmu-type = "riscv,sv39";

   cpu6_intc: interrupt-controller {
    compatible = "riscv,cpu-intc";
    #interrupt-cells = <1>;
    interrupt-controller;
   };
  };

  cpu_7: cpu@7 {
   compatible = "spacemit,x100", "riscv";
   device_type = "cpu";
   reg = <7>;
   riscv,isa-base = "rv64i";
   riscv,isa-extensions = "i", "m", "a", "f", "d", "c", "b", "v", "h",
            "sha", "shcounterenw", "shgatpa", "shtvala",
            "shvsatpa", "shvstvala", "shvstvecd", "smaia",
            "smstateen", "ssaia", "ssccptr", "sscofpmf",
            "sscounterenw", "ssnpm", "ssstateen", "sstc",
            "sstvala", "sstvecd", "ssu64xl", "svade",
            "svinval", "svnapot", "svpbmt", "za64rs",
            "zawrs", "zba", "zbb", "zbc", "zbs", "zca",
            "zcb", "zcd", "zcmop", "zfa", "zfbfmin",
            "zfh", "zfhmin", "zicbom", "zicbop", "zicboz",
            "ziccamoa", "ziccif", "zicclsm", "ziccrse", "zicntr",
            "zicond", "zicsr", "zifencei", "zihintntl",
            "zihintpause", "zihpm", "zimop", "zkt", "zvbb",
            "zvbc", "zvfbfmin", "zvfbfwma", "zvfh",
            "zvfhmin", "zvkb", "zvkg", "zvkn", "zvknc",
            "zvkned", "zvkng", "zvknha", "zvknhb", "zvks",
            "zvksc", "zvksed", "zvksg", "zvksh", "zvkt";
   riscv,cbom-block-size = <64>;
   riscv,cbop-block-size = <64>;
   riscv,cboz-block-size = <64>;
   i-cache-block-size = <64>;
   i-cache-size = <65536>;
   i-cache-sets = <256>;
   d-cache-block-size = <64>;
   d-cache-size = <65536>;
   d-cache-sets = <256>;
   next-level-cache = <&l2_cache1>;
   mmu-type = "riscv,sv39";

   cpu7_intc: interrupt-controller {
    compatible = "riscv,cpu-intc";
    #interrupt-cells = <1>;
    interrupt-controller;
   };
  };

  l2_cache0: cache-controller-0 {
   compatible = "cache";
   cache-block-size = <64>;
   cache-level = <2>;
   cache-size = <4194304>;
   cache-sets = <4096>;
   cache-unified;
  };

  l2_cache1: cache-controller-1 {
   compatible = "cache";
   cache-block-size = <64>;
   cache-level = <2>;
   cache-size = <4194304>;
   cache-sets = <4096>;
   cache-unified;
  };

  cpu-map {
   cluster0 {
    core0 {
     cpu = <&cpu_0>;
    };
    core1 {
     cpu = <&cpu_1>;
    };
    core2 {
     cpu = <&cpu_2>;
    };
    core3 {
     cpu = <&cpu_3>;
    };
   };

   cluster1 {
    core0 {
     cpu = <&cpu_4>;
    };
    core1 {
     cpu = <&cpu_5>;
    };
    core2 {
     cpu = <&cpu_6>;
    };
    core3 {
     cpu = <&cpu_7>;
    };
   };
  };
 };

 clocks {
  vctcxo_1m: clock-1m {
   compatible = "fixed-clock";
   clock-frequency = <1000000>;
   clock-output-names = "vctcxo_1m";
   #clock-cells = <0>;
  };

  vctcxo_24m: clock-24m {
   compatible = "fixed-clock";
   clock-frequency = <24000000>;
   clock-output-names = "vctcxo_24m";
   #clock-cells = <0>;
  };

  vctcxo_3m: clock-3m {
   compatible = "fixed-clock";
   clock-frequency = <3000000>;
   clock-output-names = "vctcxo_3m";
   #clock-cells = <0>;
  };

  osc_32k: clock-32k {
   compatible = "fixed-clock";
   clock-frequency = <32768>;
   clock-output-names = "osc_32k";
   #clock-cells = <0>;
  };
 };

 resmem: reserved-memory {
  #address-cells = <2>;
  #size-cells = <2>;
  ranges;


  cmamem: linux,cma {
   compatible = "shared-dma-pool";
   reusable;
   size = <0 0x04000000>;
   alloc-ranges = <1 0x40000000 0 0x20000000>;
   linux,cma-default;
  };
# 458 "/tmp/k3-independent-audit/platforms/Platform/Spacemit/K3/DeviceTree/Os/Sources/arch/riscv/boot/dts/spacemit/k3.dtsi"
  fw_reserved: region@100000000 {
   reg = <0x1 0x00000000 0x0 0x02000000>;
   no-map;
  };
 };

 soc: soc {
  compatible = "simple-bus";
  interrupt-parent = <&saplic>;
  #address-cells = <2>;
  #size-cells = <2>;
  dma-noncoherent;
  ranges;

  pcie0_rc: pcie@80000000 {
   compatible = "spacemit,k3-pcie";
   reg = <0x0 0x80000000 0x0 0x00001000>,
         <0x0 0x80300000 0x0 0x00003f20>,
         <0x11 0x00000000 0x0 0x00010000>,
         <0x0 0x82900000 0x0 0x00001000>,
         <0x0 0x80100000 0x0 0x00001000>;
   reg-names = "dbi", "atu", "config", "link", "dbi2";
   device_type = "pci";
   #address-cells = <3>;
   #size-cells = <2>;
   clocks = <&syscon_apmu 89>,
     <&syscon_apmu 56>,
     <&syscon_apmu 57>;
   clock-names = "dbi", "mstr", "slv";
   msi-parent = <&simsic>;
   ranges = <0x01000000 0x00 0x00010000 0x11 0x00010000 0x0 0x00100000>,
     <0x02000000 0x0 0x00110000 0x11 0x00110000 0x0 0x7fef0000>,
     <0x43000000 0x18 0x00000000 0x18 0x00000000 0x1 0x00000000>;
   resets = <&syscon_apmu 81>,
     <&syscon_apmu 83>,
     <&syscon_apmu 82>;
   reset-names = "dbi", "mstr", "slv";
   max-link-speed = <3>;
   linux,pci-domain = <0>;
   spacemit,apmu = <&syscon_apmu 0x1f0>;
   status = "disabled";

   pcie0_port: pcie@0 {
    device_type = "pci";
    compatible = "pciclass,0604";
    reg = <0x0 0x0 0x0 0x0 0x0>;
    bus-range = <0x01 0xff>;
    #address-cells = <3>;
    #size-cells = <2>;
    ranges;
   };
  };

  pcie1_rc: pcie@80400000 {
   compatible = "spacemit,k3-pcie";
   reg = <0x0 0x80400000 0x0 0x00001000>,
         <0x0 0x80700000 0x0 0x00003f20>,
         <0x11 0x80000000 0x0 0x00010000>,
         <0x0 0x82c00000 0x0 0x00001000>,
         <0x0 0x80500000 0x0 0x00001000>;
   reg-names = "dbi", "atu", "config", "link", "dbi2";
   device_type = "pci";
   #address-cells = <3>;
   #size-cells = <2>;
   clocks = <&syscon_apmu 90>,
     <&syscon_apmu 58>,
     <&syscon_apmu 59>;
   clock-names = "dbi", "mstr", "slv";
   msi-parent = <&simsic>;
   ranges = <0x01000000 0x0 0x00010000 0x11 0x80010000 0x0 0x00100000>,
     <0x02000000 0x0 0x80110000 0x11 0x80110000 0x0 0x7fef0000>,
     <0x43000000 0x16 0x00000000 0x16 0x00000000 0x1 0x00000000>;
   resets = <&syscon_apmu 84>,
     <&syscon_apmu 86>,
     <&syscon_apmu 85>;
   reset-names = "dbi", "mstr", "slv";
   max-link-speed = <3>;
   linux,pci-domain = <1>;
   spacemit,apmu = <&syscon_apmu 0x1d0>;
   status = "disabled";

   pcie1_port: pcie@0 {
    device_type = "pci";
    compatible = "pciclass,0604";
    reg = <0x0 0x0 0x0 0x0 0x0>;
    bus-range = <0x01 0xff>;
    #address-cells = <3>;
    #size-cells = <2>;
    ranges;
   };
  };

  pcie2_rc: pcie@80800000 {
   compatible = "spacemit,k3-pcie";
   reg = <0x0 0x80800000 0x0 0x00001000>,
         <0x0 0x80b00000 0x0 0x00003f20>,
         <0x12 0x00000000 0x0 0x00010000>,
         <0x0 0x82d00000 0x0 0x00001000>,
         <0x0 0x80900000 0x0 0x00001000>;
   reg-names = "dbi", "atu", "config", "link", "dbi2";
   device_type = "pci";
   #address-cells = <3>;
   #size-cells = <2>;
   clocks = <&syscon_apmu 91>,
     <&syscon_apmu 60>,
     <&syscon_apmu 61>;
   clock-names = "dbi", "mstr", "slv";
   msi-parent = <&simsic>;
   ranges = <0x01000000 0x00 0x00000000 0x12 0x00010000 0x0 0x00100000>,
     <0x02000000 0x0 0x00110000 0x12 0x00110000 0x0 0x7fef0000>,
     <0x43000000 0x15 0x00000000 0x15 0x00000000 0x1 0x00000000>;
   resets = <&syscon_apmu 87>,
     <&syscon_apmu 89>,
     <&syscon_apmu 88>;
   reset-names = "dbi", "mstr", "slv";
   linux,pci-domain = <2>;
   max-link-speed = <3>;
   spacemit,apmu = <&syscon_apmu 0x1c8>;
   status = "disabled";

   pcie2_port: pcie@0 {
    device_type = "pci";
    compatible = "pciclass,0604";
    reg = <0x0 0x0 0x0 0x0 0x0>;
    bus-range = <0x01 0xff>;
    #address-cells = <3>;
    #size-cells = <2>;
    ranges;
   };
  };

  pcie3_rc: pcie@80c00000 {
   compatible = "spacemit,k3-pcie";
   reg = <0x0 0x80c00000 0x0 0x00001000>,
         <0x0 0x80f00000 0x0 0x00003f20>,
         <0x12 0x80000000 0x0 0x00010000>,
         <0x0 0x82a00000 0x0 0x00001000>,
         <0x0 0x80d00000 0x0 0x00001000>;
   reg-names = "dbi", "atu", "config", "link", "dbi2";
   device_type = "pci";
   #address-cells = <3>;
   #size-cells = <2>;
   clocks = <&syscon_apmu 92>,
     <&syscon_apmu 62>,
     <&syscon_apmu 63>;
   clock-names = "dbi", "mstr", "slv";
   msi-parent = <&simsic>;
   ranges = <0x01000000 0x0 0x00010000 0x12 0x80010000 0x0 0x100000>,
     <0x02000000 0x0 0x80110000 0x12 0x80110000 0x0 0x3fef0000>,
     <0x43000000 0x14 0x00000000 0x14 0x00000000 0x1 0x00000000>;
   resets = <&syscon_apmu 90>,
     <&syscon_apmu 92>,
     <&syscon_apmu 91>;
   reset-names = "dbi", "mstr", "slv";
   linux,pci-domain = <3>;
   bus-range = <0x00 0xff>;
   max-link-speed = <3>;
   spacemit,apmu = <&syscon_apmu 0x1e0>;
   status = "disabled";

   pcie3_port: pcie@0 {
    device_type = "pci";
    compatible = "pciclass,0604";
    reg = <0x0 0x0 0x0 0x0 0x0>;
    #address-cells = <3>;
    #size-cells = <2>;
    ranges;
   };
  };

  pcie4_rc: pcie@81000000 {
   compatible = "spacemit,k3-pcie";
   reg = <0x0 0x81000000 0x0 0x00001000>,
         <0x0 0x81300000 0x0 0x00003f20>,
         <0x12 0xc0000000 0x0 0x00010000>,
         <0x0 0x82b00000 0x0 0x00001000>,
         <0x0 0x81100000 0x0 0x00001000>;
   reg-names = "dbi", "atu", "config", "link", "dbi2";
   device_type = "pci";
   #address-cells = <3>;
   #size-cells = <2>;
   clocks = <&syscon_apmu 93>,
     <&syscon_apmu 64>,
     <&syscon_apmu 65>;
   clock-names = "dbi", "mstr", "slv";
   msi-parent = <&simsic>;
   ranges = <0x01000000 0x0 0x00000000 0x12 0xc0010000 0x0 0x100000>,
     <0x02000000 0x0 0xc0110000 0x12 0xc0110000 0x0 0x3fef0000>,
     <0x43000000 0x13 0x00000000 0x13 0x00000000 0x1 0x00000000>;
   resets = <&syscon_apmu 93>,
     <&syscon_apmu 95>,
     <&syscon_apmu 94>;
   reset-names = "dbi", "mstr", "slv";
   linux,pci-domain = <4>;
   max-link-speed = <3>;
   spacemit,apmu = <&syscon_apmu 0x1e8>;
   status = "disabled";

   pcie4_port: pcie@0 {
    device_type = "pci";
    compatible = "pciclass,0604";
    reg = <0x0 0x0 0x0 0x0 0x0>;
    bus-range = <0x01 0xff>;
    #address-cells = <3>;
    #size-cells = <2>;
    ranges;
   };
  };

  usb3b: usb@81400000 {
   compatible = "spacemit,k3-dwc3";
   reg = <0x0 0x81400000 0x0 0x10000>;
   interrupts = <125 4>;
   interrupt-parent = <&saplic>;
   clocks = <&syscon_apmu 32>;
   clock-names = "usbdrd30";
   resets = <&syscon_apmu 52>,
     <&syscon_apmu 62>,
     <&syscon_apmu 63>;
   reset-names = "ahb", "vcc", "phy";
   phy_type = "utmi";
   snps,dis_enblslpm_quirk;
   snps,dis_u2_susphy_quirk;
   snps,dis_u3_susphy_quirk;
   snps,dis-del-phy-power-chg-quirk;
   snps,dis-tx-ipgap-linecheck-quirk;
   snps,parkmode-disable-ss-quirk;
   dr_mode = "host";
   status = "disabled";
  };

  usb3b_u2phy: phy@81500000 {
   compatible = "spacemit,k3-usb2-phy";
   reg = <0x0 0x81500000 0x0 0x200>;
   clocks = <&syscon_apmu 32>;
   #phy-cells = <0>;
   status = "disabled";
  };

  usb3c: usb@81700000 {
   compatible = "spacemit,k3-dwc3";
   reg = <0x0 0x81700000 0x0 0x10000>;
   interrupts = <148 4>;
   interrupt-parent = <&saplic>;
   clocks = <&syscon_apmu 33>;
   clock-names = "usbdrd30";
   resets = <&syscon_apmu 64>,
     <&syscon_apmu 65>,
     <&syscon_apmu 66>;
   reset-names = "ahb", "vcc", "phy";
   phy_type = "utmi";
   snps,dis_enblslpm_quirk;
   snps,dis_u2_susphy_quirk;
   snps,dis_u3_susphy_quirk;
   snps,dis-del-phy-power-chg-quirk;
   snps,dis-tx-ipgap-linecheck-quirk;
   snps,parkmode-disable-ss-quirk;
   dr_mode = "host";
   status = "disabled";
  };

  usb3c_u2phy: phy@81800000 {
   compatible = "spacemit,k3-usb2-phy";
   reg = <0x0 0x81800000 0x0 0x200>;
   clocks = <&syscon_apmu 33>;
   #phy-cells = <0>;
   status = "disabled";
  };

  usb3d: usb@81a00000 {
   compatible = "spacemit,k3-dwc3";
   reg = <0x0 0x81a00000 0x0 0x10000>;
   interrupts = <149 4>;
   interrupt-parent = <&saplic>;
   clocks = <&syscon_apmu 34>;
   clock-names = "usbdrd30";
   resets = <&syscon_apmu 72>,
     <&syscon_apmu 73>,
     <&syscon_apmu 74>;
   reset-names = "ahb", "vcc", "phy";
   phy_type = "utmi";
   snps,dis_enblslpm_quirk;
   snps,dis_u2_susphy_quirk;
   snps,dis_u3_susphy_quirk;
   snps,dis-del-phy-power-chg-quirk;
   snps,dis-tx-ipgap-linecheck-quirk;
   snps,parkmode-disable-ss-quirk;
   dr_mode = "host";
   status = "disabled";
  };

  usb3d_u2phy: phy@81b00000 {
   compatible = "spacemit,k3-usb2-phy";
   reg = <0x0 0x81b00000 0x0 0x200>;
   clocks = <&syscon_apmu 34>;
   #phy-cells = <0>;
   status = "disabled";
  };

  combophy: phy@81d00000 {
   compatible = "spacemit,k3-combo-phy";
   reg = <0x0 0x81d00000 0x0 0x600000>;
   #phy-cells = <2>;
   spacemit,apb-spare = <&pll>;
   status = "disabled";
  };

  usb2_host: usb@c0a00000 {
   compatible = "spacemit,k3-dwc3";
   reg = <0x0 0xc0a00000 0x0 0x10000>;
   clocks = <&syscon_apmu 30>;
   clock-names = "usbdrd30";
   resets = <&syscon_apmu 16>,
     <&syscon_apmu 17>,
     <&syscon_apmu 18>;
   reset-names = "ahb", "vcc", "phy";
   interrupts = <105 4>;
   interrupt-parent = <&saplic>;
   phys = <&usb2_phy>;
   phy-names = "usb2-phy";
   phy_type = "utmi";
   snps,dis_enblslpm_quirk;
   snps,dis_u2_susphy_quirk;
   snps,dis-del-phy-power-chg-quirk;
   snps,dis-tx-ipgap-linecheck-quirk;
   dr_mode = "host";
   maximum-speed = "high-speed";
   status = "disabled";
  };

  usb2_phy: phy@c0a20000 {
   compatible = "spacemit,k3-usb2-phy";
   reg = <0x0 0xc0a20000 0x0 0x200>;
   clocks = <&syscon_apmu 30>;
   #phy-cells = <0>;
   status = "disabled";
  };

  ufshc: ufshc@c0e00000 {
   compatible = "spacemit,k3-ufshc";
   reg = <0x0 0xc0e00000 0x0 0x40000>;
   clocks = <&syscon_apmu 53>,
     <&syscon_apmu 94>;
   clock-names = "axi", "ref";
   resets = <&syscon_apmu 59>;
   interrupts = <135 4>;
   lanes-per-direction = <2>;
   operating-points-v2 = <&ufs_opp_table>;
   status = "disabled";

   ufs_opp_table: opp-table {
    compatible = "operating-points-v2";

    opp-1 {
     opp-hz = /bits/ 64 <491520000>,
       /bits/ 64 <19200000>;
    };
   };
  };

  eth0: ethernet@cac80000 {
   compatible = "spacemit,k3-dwmac", "snps,dwmac-5.40a";
   reg = <0x0 0xcac80000 0x0 0x2000>;
   clocks = <&syscon_apmu 66>,
     <&syscon_apmu 68>,
     <&syscon_apmu 69>;
   clock-names = "stmmaceth", "ptp_ref", "tx";
   interrupts = <131 4>,
         <276 4>;
   interrupt-names = "macirq", "eth_wake_irq";
   resets = <&syscon_apmu 67>;
   reset-names = "stmmaceth";
   rx-fifo-depth = <8192>;
   tx-fifo-depth = <8192>;
   snps,multicast-filter-bins = <64>;
   snps,perfect-filter-entries = <32>;
   snps,aal;
   snps,tso;
   snps,txpbl = <8>;
   snps,rxpbl = <8>;
   snps,force_sf_dma_mode;
   snps,axi-config = <&gmac0_axi_setup>;
   spacemit,apmu = <&syscon_apmu 0x3e4 0x3e8>;
   status = "disabled";

   mdio {
    compatible = "snps,dwmac-mdio";
    #address-cells = <1>;
    #size-cells = <0>;
   };

   gmac0_axi_setup: stmmac-axi-config {
    snps,wr_osr_lmt = <0xf>;
    snps,rd_osr_lmt = <0xf>;

    snps,blen = <256 128 64 32 16 0 0>;
   };
  };

  eth1: ethernet@cac82000 {
   compatible = "spacemit,k3-dwmac", "snps,dwmac-5.40a";
   reg = <0x0 0xcac82000 0x0 0x2000>;
   clocks = <&syscon_apmu 70>,
     <&syscon_apmu 72>,
     <&syscon_apmu 73>;
   clock-names = "stmmaceth", "ptp_ref", "tx";
   interrupts = <133 4>,
         <277 4>;
   interrupt-names = "macirq", "eth_wake_irq";
   resets = <&syscon_apmu 68>;
   reset-names = "stmmaceth";
   rx-fifo-depth = <8192>;
   tx-fifo-depth = <8192>;
   snps,multicast-filter-bins = <64>;
   snps,perfect-filter-entries = <32>;
   snps,aal;
   snps,tso;
   snps,txpbl = <8>;
   snps,rxpbl = <8>;
   snps,force_sf_dma_mode;
   snps,axi-config = <&gmac1_axi_setup>;
   spacemit,apmu = <&syscon_apmu 0x3ec 0x3f0>;
   status = "disabled";

   mdio {
    compatible = "snps,dwmac-mdio";
    #address-cells = <1>;
    #size-cells = <0>;
   };

   gmac1_axi_setup: stmmac-axi-config {
    snps,wr_osr_lmt = <0xf>;
    snps,rd_osr_lmt = <0xf>;

    snps,blen = <256 128 64 32 16 0 0>;
   };
  };

  eth2: ethernet@cac8e000 {
   compatible = "spacemit,k3-dwmac", "snps,dwmac-5.40a";
   reg = <0x0 0xcac8e000 0x0 0x2000>;
   clocks = <&syscon_apmu 74>,
     <&syscon_apmu 76>,
     <&syscon_apmu 77>;
   clock-names = "stmmaceth", "ptp_ref", "tx";
   interrupts = <130 4>,
         <278 4>;
   interrupt-names = "macirq", "eth_wake_irq";
   resets = <&syscon_apmu 69>;
   reset-names = "stmmaceth";
   rx-fifo-depth = <4096>;
   tx-fifo-depth = <4096>;
   snps,multicast-filter-bins = <64>;
   snps,perfect-filter-entries = <32>;
   snps,aal;
   snps,tso;
   snps,txpbl = <8>;
   snps,rxpbl = <8>;
   snps,force_sf_dma_mode;
   snps,axi-config = <&gmac2_axi_setup>;
   spacemit,apmu = <&syscon_apmu 0x248 0x24c>;
   status = "disabled";

   mdio {
    compatible = "snps,dwmac-mdio";
    #address-cells = <1>;
    #size-cells = <0>;
   };

   gmac2_axi_setup: stmmac-axi-config {
    snps,wr_osr_lmt = <0xf>;
    snps,rd_osr_lmt = <0xf>;

    snps,blen = <256 128 64 32 16 0 0>;
   };
  };

  usb3a_u2phy: phy@cad20000 {
   compatible = "spacemit,k3-usb2-phy";
   reg = <0x0 0xcad20000 0x0 0x200>;
   clocks = <&syscon_apmu 30>;
   #phy-cells = <0>;
   status = "disabled";
  };

  usb3a_u3phy: phy@cad30000 {
   compatible = "spacemit,k3-usb3-phy",
         "spacemit,k3-typec-switch";
   spacemit,apmu = <&syscon_apmu>;
   spacemit,apb-spare = <&pll>;
   clocks = <&syscon_apmu 31>;
   reg = <0x0 0xcad30000 0x0 0x200>,
         <0x0 0xcad40000 0x0 0x200>;
   #phy-cells = <0>;
   status = "disabled";
  };

  usb3a: usb3@cad00000 {
   compatible = "spacemit,k3-dwc3";
   reg = <0x0 0xcad00000 0x0 0x10000>;
   spacemit,syscon-apmu = <&syscon_apmu 0x3c4>;
   interrupts = <118 4>,
         <156 4>;
   interrupt-names = "dwc3", "wakeup";
   interrupt-parent = <&saplic>;
   clocks = <&syscon_apmu 31>;
   resets = <&syscon_apmu 19>,
     <&syscon_apmu 20>,
     <&syscon_apmu 51>;
   phys = <&usb3a_u3phy>, <&usb3a_u2phy>;
   phy-names = "usb3-phy", "usb2-phy";
   phy_type = "utmi";
   snps,dis_enblslpm_quirk;
   snps,dis_u2_susphy_quirk;
   snps,dis_u3_susphy_quirk;
   snps,dis-del-phy-power-chg-quirk;
   snps,dis-tx-ipgap-linecheck-quirk;
   snps,parkmode-disable-ss-quirk;
   status = "disabled";
  };

  pdma: dma-controller@d4000000 {
   compatible = "spacemit,k3-pdma";
   reg = <0x0 0xd4000000 0x0 0x4000>;
   clocks = <&syscon_apmu 37>;
   resets = <&syscon_apmu 23>;
   interrupts = <72 4>;
   dma-channels = <16>;
   #dma-cells = <1>;
   status = "okay";
  };

  i2c0: i2c@d4010800 {
   compatible = "spacemit,k3-i2c", "spacemit,k1-i2c";
   reg = <0x0 0xd4010800 0x0 0x38>;
   #address-cells = <1>;
   #size-cells = <0>;
   interrupts = <36 4>;
   clocks = <&syscon_apbc 73>,
     <&syscon_apbc 80>;
   clock-names = "func", "bus";
   clock-frequency = <400000>;
   resets = <&syscon_apbc 35>;
   status = "disabled";
  };

  i2c1: i2c@d4011000 {
   compatible = "spacemit,k3-i2c", "spacemit,k1-i2c";
   reg = <0x0 0xd4011000 0x0 0x38>;
   #address-cells = <1>;
   #size-cells = <0>;
   interrupts = <37 4>;
   clocks = <&syscon_apbc 74>,
     <&syscon_apbc 81>;
   clock-names = "func", "bus";
   clock-frequency = <400000>;
   resets = <&syscon_apbc 36>;
   status = "disabled";
  };

  i2c2: i2c@d4012000 {
   compatible = "spacemit,k3-i2c", "spacemit,k1-i2c";
   reg = <0x0 0xd4012000 0x0 0x38>;
   #address-cells = <1>;
   #size-cells = <0>;
   interrupts = <38 4>;
   clocks = <&syscon_apbc 75>,
     <&syscon_apbc 82>;
   clock-names = "func", "bus";
   clock-frequency = <400000>;
   resets = <&syscon_apbc 37>;
   status = "disabled";
  };

  i2c4: i2c@d4012800 {
   compatible = "spacemit,k3-i2c", "spacemit,k1-i2c";
   reg = <0x0 0xd4012800 0x0 0x38>;
   #address-cells = <1>;
   #size-cells = <0>;
   interrupts = <40 4>;
   clocks = <&syscon_apbc 76>,
     <&syscon_apbc 83>;
   clock-names = "func", "bus";
   clock-frequency = <400000>;
   resets = <&syscon_apbc 38>;
   status = "disabled";
  };

  i2c5: i2c@d4013800 {
   compatible = "spacemit,k3-i2c", "spacemit,k1-i2c";
   reg = <0x0 0xd4013800 0x0 0x38>;
   #address-cells = <1>;
   #size-cells = <0>;
   interrupts = <41 4>;
   clocks = <&syscon_apbc 77>,
     <&syscon_apbc 84>;
   clock-names = "func", "bus";
   clock-frequency = <400000>;
   resets = <&syscon_apbc 39>;
   status = "disabled";
  };

  syscon_apbc: system-controller@d4015000 {
   compatible = "spacemit,k3-syscon-apbc";
   reg = <0x0 0xd4015000 0x0 0x1000>;
   clocks = <&osc_32k>, <&vctcxo_1m>, <&vctcxo_3m>, <&vctcxo_24m>;
   clock-names = "osc", "vctcxo_1m", "vctcxo_3m", "vctcxo_24m";
   #clock-cells = <1>;
   #reset-cells = <1>;
  };

  uart0: serial@d4017000 {
   compatible = "spacemit,k3-uart", "intel,xscale-uart";
   reg = <0x0 0xd4017000 0x0 0x100>;
   reg-shift = <2>;
   reg-io-width = <4>;
   clocks = <&syscon_apbc 0>,
     <&syscon_apbc 10>;
   clock-names = "core", "bus";
   resets = <&syscon_apbc 0>;
   interrupts = <42 4>;
   status = "disabled";
  };

  uart2: serial@d4017100 {
   compatible = "spacemit,k3-uart", "intel,xscale-uart";
   reg = <0x0 0xd4017100 0x0 0x100>;
   reg-shift = <2>;
   reg-io-width = <4>;
   clocks = <&syscon_apbc 1>,
     <&syscon_apbc 11>;
   clock-names = "core", "bus";
   resets = <&syscon_apbc 1>;
   interrupts = <44 4>;
   status = "disabled";
  };

  uart3: serial@d4017200 {
   compatible = "spacemit,k3-uart", "intel,xscale-uart";
   reg = <0x0 0xd4017200 0x0 0x100>;
   reg-shift = <2>;
   reg-io-width = <4>;
   clocks = <&syscon_apbc 2>,
     <&syscon_apbc 12>;
   clock-names = "core", "bus";
   resets = <&syscon_apbc 2>;
   interrupts = <45 4>;
   status = "disabled";
  };

  uart4: serial@d4017300 {
   compatible = "spacemit,k3-uart", "intel,xscale-uart";
   reg = <0x0 0xd4017300 0x0 0x100>;
   reg-shift = <2>;
   reg-io-width = <4>;
   clocks = <&syscon_apbc 3>,
     <&syscon_apbc 13>;
   clock-names = "core", "bus";
   resets = <&syscon_apbc 3>;
   interrupts = <46 4>;
   status = "disabled";
  };

  uart5: serial@d4017400 {
   compatible = "spacemit,k3-uart", "intel,xscale-uart";
   reg = <0x0 0xd4017400 0x0 0x100>;
   reg-shift = <2>;
   reg-io-width = <4>;
   clocks = <&syscon_apbc 4>,
     <&syscon_apbc 14>;
   clock-names = "core", "bus";
   resets = <&syscon_apbc 4>;
   interrupts = <47 4>;
   status = "disabled";
  };

  uart6: serial@d4017500 {
   compatible = "spacemit,k3-uart", "intel,xscale-uart";
   reg = <0x0 0xd4017500 0x0 0x100>;
   reg-shift = <2>;
   reg-io-width = <4>;
   clocks = <&syscon_apbc 5>,
     <&syscon_apbc 15>;
   clock-names = "core", "bus";
   resets = <&syscon_apbc 5>;
   interrupts = <48 4>;
   status = "disabled";
  };

  uart7: serial@d4017600 {
   compatible = "spacemit,k3-uart", "intel,xscale-uart";
   reg = <0x0 0xd4017600 0x0 0x100>;
   reg-shift = <2>;
   reg-io-width = <4>;
   clocks = <&syscon_apbc 6>,
     <&syscon_apbc 16>;
   clock-names = "core", "bus";
   resets = <&syscon_apbc 6>;
   interrupts = <49 4>;
   status = "disabled";
  };

  uart8: serial@d4017700 {
   compatible = "spacemit,k3-uart", "intel,xscale-uart";
   reg = <0x0 0xd4017700 0x0 0x100>;
   reg-shift = <2>;
   reg-io-width = <4>;
   clocks = <&syscon_apbc 7>,
     <&syscon_apbc 17>;
   clock-names = "core", "bus";
   resets = <&syscon_apbc 7>;
   interrupts = <50 4>;
   status = "disabled";
  };

  uart9: serial@d4017800 {
   compatible = "spacemit,k3-uart", "intel,xscale-uart";
   reg = <0x0 0xd4017800 0x0 0x100>;
   reg-shift = <2>;
   reg-io-width = <4>;
   clocks = <&syscon_apbc 8>,
     <&syscon_apbc 18>;
   clock-names = "core", "bus";
   resets = <&syscon_apbc 8>;
   interrupts = <51 4>;
   status = "disabled";
  };

  thermal: thermal@d4018000 {
   compatible = "spacemit,k3-tsensor";
   reg = <0x0 0xd4018000 0x0 0x100>;
   interrupt-parent = <&saplic>;
   interrupts = <61 4>;
   interrupt-names = "tsensor";
   clocks = <&syscon_apbc 128>,
    <&syscon_apbc 129>;
   clock-names = "func", "bus";
   resets = <&syscon_apbc 61>;
   sensor_range = <0x0 0x7>;
   tsensor_map = <1 0 1 1 1 1 1 1>;
   temperature_offset = <274>;
   #thermal-sensor-cells = <1>;
   status = "okay";
  };

  i2c6: i2c@d4018800 {
   compatible = "spacemit,k3-i2c", "spacemit,k1-i2c";
   reg = <0x0 0xd4018800 0x0 0x38>;
   #address-cells = <1>;
   #size-cells = <0>;
   interrupts = <70 4>;
   clocks = <&syscon_apbc 78>,
     <&syscon_apbc 85>;
   clock-names = "func", "bus";
   clock-frequency = <400000>;
   resets = <&syscon_apbc 40>;
   status = "disabled";
  };

  gpio: gpio@d4019000 {
   compatible = "spacemit,k3-gpio";
   reg = <0x0 0xd4019000 0x0 0x100>;
   clocks = <&syscon_apbc 20>,
     <&syscon_apbc 21>;
   clock-names = "core", "bus";
   gpio-controller;
   #gpio-cells = <3>;
   interrupts = <58 4>;
   interrupt-parent = <&saplic>;
   interrupt-controller;
   #interrupt-cells = <3>;
   gpio-ranges = <&pinctrl 0 0 0 32>,
          <&pinctrl 1 0 32 32>,
          <&pinctrl 2 0 64 32>,
          <&pinctrl 3 0 96 32>;
  };

  i2c8: i2c@d401d800 {
   compatible = "spacemit,k3-i2c", "spacemit,k1-i2c";
   reg = <0x0 0xd401d800 0x0 0x38>;
   #address-cells = <1>;
   #size-cells = <0>;
   interrupts = <19 4>;
   clocks = <&syscon_apbc 79>,
     <&syscon_apbc 86>;
   clock-names = "func", "bus";
   clock-frequency = <400000>;
   resets = <&syscon_apbc 41>;
   status = "disabled";
  };

  pwm0: pwm@d401a000 {
   compatible = "spacemit,k3-pwm", "marvell,pxa910-pwm";
   reg = <0x0 0xd401a000 0x0 0x10>;
   clocks = <&syscon_apbc 22>,
     <&syscon_apbc 42>;
   clock-names = "func", "bus";
   resets = <&syscon_apbc 11>;
   #pwm-cells = <3>;
   status = "disabled";
  };

  pwm1: pwm@d401a400 {
   compatible = "spacemit,k3-pwm", "marvell,pxa910-pwm";
   reg = <0x0 0xd401a400 0x0 0x10>;
   clocks = <&syscon_apbc 23>,
     <&syscon_apbc 43>;
   clock-names = "func", "bus";
   resets = <&syscon_apbc 12>;
   #pwm-cells = <3>;
   status = "disabled";
  };

  pwm2: pwm@d401a800 {
   compatible = "spacemit,k3-pwm", "marvell,pxa910-pwm";
   reg = <0x0 0xd401a800 0x0 0x10>;
   clocks = <&syscon_apbc 24>,
     <&syscon_apbc 44>;
   clock-names = "func", "bus";
   resets = <&syscon_apbc 13>;
   #pwm-cells = <3>;
   status = "disabled";
  };

  pwm3: pwm@d401ac00 {
   compatible = "spacemit,k3-pwm", "marvell,pxa910-pwm";
   reg = <0x0 0xd401ac00 0x0 0x10>;
   clocks = <&syscon_apbc 25>,
     <&syscon_apbc 45>;
   clock-names = "func", "bus";
   resets = <&syscon_apbc 14>;
   #pwm-cells = <3>;
   status = "disabled";
  };

  pwm4: pwm@d401b000 {
   compatible = "spacemit,k3-pwm", "marvell,pxa910-pwm";
   reg = <0x0 0xd401b000 0x0 0x10>;
   clocks = <&syscon_apbc 26>,
     <&syscon_apbc 46>;
   clock-names = "func", "bus";
   resets = <&syscon_apbc 15>;
   #pwm-cells = <3>;
   status = "disabled";
  };

  pwm5: pwm@d401b400 {
   compatible = "spacemit,k3-pwm", "marvell,pxa910-pwm";
   reg = <0x0 0xd401b400 0x0 0x10>;
   clocks = <&syscon_apbc 27>,
     <&syscon_apbc 47>;
   clock-names = "func", "bus";
   resets = <&syscon_apbc 16>;
   #pwm-cells = <3>;
   status = "disabled";
  };

  pwm6: pwm@d401b800 {
   compatible = "spacemit,k3-pwm", "marvell,pxa910-pwm";
   reg = <0x0 0xd401b800 0x0 0x10>;
   clocks = <&syscon_apbc 28>,
     <&syscon_apbc 48>;
   clock-names = "func", "bus";
   resets = <&syscon_apbc 17>;
   #pwm-cells = <3>;
   status = "disabled";
  };

  pwm7: pwm@d401bc00 {
   compatible = "spacemit,k3-pwm", "marvell,pxa910-pwm";
   reg = <0x0 0xd401bc00 0x0 0x10>;
   clocks = <&syscon_apbc 29>,
     <&syscon_apbc 49>;
   clock-names = "func", "bus";
   resets = <&syscon_apbc 18>;
   #pwm-cells = <3>;
   status = "disabled";
  };

  spi3: spi@d401c000 {
   compatible = "spacemit,k3-spi", "spacemit,k1-spi";
   reg = <0x0 0xd401c000 0x0 0x30>;
   #address-cells = <1>;
   #size-cells = <0>;
   clocks = <&syscon_apbc 67>,
     <&syscon_apbc 70>;
   clock-names = "core", "bus";
   resets = <&syscon_apbc 33>;
   interrupts = <55 4>;
   dmas = <&pdma 20>, <&pdma 19>;
   dma-names = "rx", "tx";
   status = "disabled";
  };

  pwm8: pwm@d4020000 {
   compatible = "spacemit,k3-pwm", "marvell,pxa910-pwm";
   reg = <0x0 0xd4020000 0x0 0x10>;
   clocks = <&syscon_apbc 30>,
     <&syscon_apbc 50>;
   clock-names = "func", "bus";
   resets = <&syscon_apbc 19>;
   #pwm-cells = <3>;
   status = "disabled";
  };

  pwm9: pwm@d4020400 {
   compatible = "spacemit,k3-pwm", "marvell,pxa910-pwm";
   reg = <0x0 0xd4020400 0x0 0x10>;
   clocks = <&syscon_apbc 31>,
     <&syscon_apbc 51>;
   clock-names = "func", "bus";
   resets = <&syscon_apbc 20>;
   #pwm-cells = <3>;
   status = "disabled";
  };

  pwm10: pwm@d4020800 {
   compatible = "spacemit,k3-pwm", "marvell,pxa910-pwm";
   reg = <0x0 0xd4020800 0x0 0x10>;
   clocks = <&syscon_apbc 32>,
     <&syscon_apbc 52>;
   clock-names = "func", "bus";
   resets = <&syscon_apbc 21>;
   #pwm-cells = <3>;
   status = "disabled";
  };

  pwm11: pwm@d4020c00 {
   compatible = "spacemit,k3-pwm", "marvell,pxa910-pwm";
   reg = <0x0 0xd4020c00 0x0 0x10>;
   clocks = <&syscon_apbc 33>,
     <&syscon_apbc 53>;
   clock-names = "func", "bus";
   resets = <&syscon_apbc 22>;
   #pwm-cells = <3>;
   status = "disabled";
  };

  pwm12: pwm@d4021000 {
   compatible = "spacemit,k3-pwm", "marvell,pxa910-pwm";
   reg = <0x0 0xd4021000 0x0 0x10>;
   clocks = <&syscon_apbc 34>,
     <&syscon_apbc 54>;
   clock-names = "func", "bus";
   resets = <&syscon_apbc 23>;
   #pwm-cells = <3>;
   status = "disabled";
  };

  pwm13: pwm@d4021400 {
   compatible = "spacemit,k3-pwm", "marvell,pxa910-pwm";
   reg = <0x0 0xd4021400 0x0 0x10>;
   clocks = <&syscon_apbc 35>,
     <&syscon_apbc 55>;
   clock-names = "func", "bus";
   resets = <&syscon_apbc 24>;
   #pwm-cells = <3>;
   status = "disabled";
  };

  pwm14: pwm@d4021800 {
   compatible = "spacemit,k3-pwm", "marvell,pxa910-pwm";
   reg = <0x0 0xd4021800 0x0 0x10>;
   clocks = <&syscon_apbc 36>,
     <&syscon_apbc 56>;
   clock-names = "func", "bus";
   resets = <&syscon_apbc 25>;
   #pwm-cells = <3>;
   status = "disabled";
  };

  pwm15: pwm@d4021c00 {
   compatible = "spacemit,k3-pwm", "marvell,pxa910-pwm";
   reg = <0x0 0xd4021c00 0x0 0x10>;
   clocks = <&syscon_apbc 37>,
     <&syscon_apbc 57>;
   clock-names = "func", "bus";
   resets = <&syscon_apbc 26>;
   #pwm-cells = <3>;
   status = "disabled";
  };

  pwm16: pwm@d4022000 {
   compatible = "spacemit,k3-pwm", "marvell,pxa910-pwm";
   reg = <0x0 0xd4022000 0x0 0x10>;
   clocks = <&syscon_apbc 38>,
     <&syscon_apbc 58>;
   clock-names = "func", "bus";
   resets = <&syscon_apbc 27>;
   #pwm-cells = <3>;
   status = "disabled";
  };

  pwm17: pwm@d4022400 {
   compatible = "spacemit,k3-pwm", "marvell,pxa910-pwm";
   reg = <0x0 0xd4022400 0x0 0x10>;
   clocks = <&syscon_apbc 39>,
     <&syscon_apbc 59>;
   clock-names = "func", "bus";
   resets = <&syscon_apbc 28>;
   #pwm-cells = <3>;
   status = "disabled";
  };

  pwm18: pwm@d4022800 {
   compatible = "spacemit,k3-pwm", "marvell,pxa910-pwm";
   reg = <0x0 0xd4022800 0x0 0x10>;
   clocks = <&syscon_apbc 40>,
     <&syscon_apbc 60>;
   clock-names = "func", "bus";
   resets = <&syscon_apbc 29>;
   #pwm-cells = <3>;
   status = "disabled";
  };

  pwm19: pwm@d4022c00 {
   compatible = "spacemit,k3-pwm", "marvell,pxa910-pwm";
   reg = <0x0 0xd4022c00 0x0 0x10>;
   clocks = <&syscon_apbc 41>,
     <&syscon_apbc 61>;
   clock-names = "func", "bus";
   resets = <&syscon_apbc 30>;
   #pwm-cells = <3>;
   status = "disabled";
  };

  pinctrl: pinctrl@d401e000 {
   compatible = "spacemit,k3-pinctrl";
   reg = <0x0 0xd401e000 0x0 0x1000>;
   clocks = <&syscon_apbc 103>,
     <&syscon_apbc 104>;
   clock-names = "func", "bus";
   spacemit,apbc = <&syscon_apbc>;
  };

  uart10: serial@d401f000 {
   compatible = "spacemit,k3-uart", "intel,xscale-uart";
   reg = <0x0 0xd401f000 0x0 0x100>;
   reg-shift = <2>;
   reg-io-width = <4>;
   clocks = <&syscon_apbc 9>,
     <&syscon_apbc 19>;
   clock-names = "core", "bus";
   resets = <&syscon_apbc 9>;
   interrupts = <281 4>;
   status = "disabled";
  };

  i2s0: i2s@d4026000 {
   compatible = "spacemit,k3-i2s";
   reg = <0x0 0xd4026000 0x0 0x30>;
   clocks = <&syscon_mpmu 46>,
     <&syscon_apbc 107>,
     <&syscon_apbc 119>,
     <&syscon_apbc 113>,
     <&syscon_mpmu 41>,
     <&syscon_mpmu 51>,
     <&syscon_mpmu 35>;
   clock-names = "sysclk", "bclk", "bus", "func",
          "sysclk_div", "c_sysclk", "c_bclk";
   dmas = <&pdma 21>, <&pdma 22>;
   dma-names = "tx", "rx";
   resets = <&syscon_apbc 52>;
   #sound-dai-cells = <0>;

   status = "disabled";
  };

  i2s1: i2s@d4026800 {
   compatible = "spacemit,k3-i2s";
   reg = <0x0 0xd4026800 0x0 0x30>;
   clocks = <&syscon_mpmu 34>,
     <&syscon_apbc 108>,
     <&syscon_apbc 120>,
     <&syscon_apbc 114>,
     <&syscon_mpmu 51>,
     <&syscon_mpmu 35>;
   clock-names = "sysclk", "bclk", "bus", "func",
          "c_sysclk", "c_bclk";
   dmas = <&pdma 23>, <&pdma 24>;
   dma-names = "tx", "rx";
   resets = <&syscon_apbc 53>;
   #sound-dai-cells = <0>;

   status = "disabled";
  };

  i2s2: i2s@d4027000 {
   compatible = "spacemit,k3-i2s";
   reg = <0x0 0xd4027000 0x0 0x30>;
   clocks = <&syscon_mpmu 47>,
     <&syscon_apbc 109>,
     <&syscon_apbc 121>,
     <&syscon_apbc 115>,
     <&syscon_mpmu 42>,
     <&syscon_mpmu 51>,
     <&syscon_mpmu 35>;
   clock-names = "sysclk", "bclk", "bus", "func",
          "sysclk_div", "c_sysclk", "c_bclk";
   dmas = <&pdma 56>, <&pdma 57>;
   dma-names = "tx", "rx";
   resets = <&syscon_apbc 54>;
   #sound-dai-cells = <0>;

   status = "disabled";
  };

  i2s3: i2s@d4027800 {
   compatible = "spacemit,k3-i2s";
   reg = <0x0 0xd4027800 0x0 0x30>;
   clocks = <&syscon_mpmu 48>,
     <&syscon_apbc 110>,
     <&syscon_apbc 122>,
     <&syscon_apbc 116>,
     <&syscon_mpmu 43>,
     <&syscon_mpmu 51>,
     <&syscon_mpmu 35>;
   clock-names = "sysclk", "bclk", "bus", "func",
          "sysclk_div", "c_sysclk", "c_bclk";
   dmas = <&pdma 58>, <&pdma 59>;
   dma-names = "tx", "rx";
   resets = <&syscon_apbc 55>;
   #sound-dai-cells = <0>;

   status = "disabled";
  };

  spi0: spi@d4040000 {
   compatible = "spacemit,k3-spi", "spacemit,k1-spi";
   reg = <0x0 0xd4040000 0x0 0x30>;
   #address-cells = <1>;
   #size-cells = <0>;
   clocks = <&syscon_apbc 65>,
     <&syscon_apbc 68>;
   clock-names = "core", "bus";
   resets = <&syscon_apbc 31>;
   interrupts = <283 4>;
   dmas = <&pdma 65>, <&pdma 64>;
   dma-names = "rx", "tx";
   status = "disabled";
  };

  spi1: spi@d4040800 {
   compatible = "spacemit,k3-spi", "spacemit,k1-spi";
   reg = <0x0 0xd4040800 0x0 0x30>;
   #address-cells = <1>;
   #size-cells = <0>;
   clocks = <&syscon_apbc 66>,
     <&syscon_apbc 69>;
   clock-names = "core", "bus";
   resets = <&syscon_apbc 32>;
   interrupts = <282 4>;
   dmas = <&pdma 67>, <&pdma 66>;
   dma-names = "rx", "tx";
   status = "disabled";
  };

  i2s4: i2s@d4041000 {
   compatible = "spacemit,k3-i2s";
   reg = <0x0 0xd4041000 0x0 0x30>;
   clocks = <&syscon_mpmu 49>,
     <&syscon_apbc 111>,
     <&syscon_apbc 123>,
     <&syscon_apbc 117>,
     <&syscon_mpmu 44>,
     <&syscon_mpmu 51>,
     <&syscon_mpmu 35>;
   clock-names = "sysclk", "bclk", "bus", "func",
          "sysclk_div", "c_sysclk", "c_bclk";
   dmas = <&pdma 60>, <&pdma 61>;
   dma-names = "tx", "rx";
   resets = <&syscon_apbc 56>;
   #sound-dai-cells = <0>;

   status = "disabled";
  };

  i2s5: i2s@d4041800 {
   compatible = "spacemit,k3-i2s";
   reg = <0x0 0xd4041800 0x0 0x30>;
   clocks = <&syscon_mpmu 50>,
     <&syscon_apbc 112>,
     <&syscon_apbc 124>,
     <&syscon_apbc 118>,
     <&syscon_mpmu 45>,
     <&syscon_mpmu 51>,
     <&syscon_mpmu 35>;
   clock-names = "sysclk", "bclk", "bus", "func",
          "sysclk_div", "c_sysclk", "c_bclk";
   dmas = <&pdma 62>, <&pdma 63>;
   dma-names = "tx", "rx";
   resets = <&syscon_apbc 57>;
   #sound-dai-cells = <0>;

   status = "disabled";
  };

  syscon_mpmu: system-controller@d4050000 {
   compatible = "spacemit,k3-syscon-mpmu";
   reg = <0x0 0xd4050000 0x0 0x10000>;
   clocks = <&osc_32k>, <&vctcxo_1m>, <&vctcxo_3m>, <&vctcxo_24m>;
   clock-names = "osc", "vctcxo_1m", "vctcxo_3m", "vctcxo_24m";
   #clock-cells = <1>;
   #power-domain-cells = <1>;
   #reset-cells = <1>;
  };

  pll: clock-controller@d4090000 {
   compatible = "spacemit,k3-pll";
   reg = <0x0 0xd4090000 0x0 0x10000>;
   clocks = <&vctcxo_24m>;
   spacemit,mpmu = <&syscon_mpmu>;
   #clock-cells = <1>;
  };

  qspi: spi@d420c000 {
   compatible = "spacemit,k3-qspi",
         "spacemit,k1-qspi";
   #address-cells = <1>;
   #size-cells = <0>;
   reg = <0x0 0xd420c000 0x0 0x1000>,
         <0x0 0xb8000000 0x0 0xc00000>;
   reg-names = "QuadSPI", "QuadSPI-memory";
   clocks = <&syscon_apmu 36>,
     <&syscon_apmu 35>;
   clock-names = "qspi_en", "qspi";
   resets = <&syscon_apmu 21>,
     <&syscon_apmu 22>;
   interrupts = <117 4>;
   status = "disabled";
  };

  sdhci0: mmc@d4280000 {
   compatible = "spacemit,k3-sdhci";
   reg = <0x0 0xd4280000 0x0 0x200>;
   clocks = <&syscon_apmu 26>,
     <&syscon_apmu 27>;
   clock-names = "core", "io";
   resets = <&syscon_apmu 12>,
     <&syscon_apmu 13>;
   reset-names = "axi", "sdh";
   interrupts = <99 4>;
   status = "disabled";
  };

  syscon_apmu: system-controller@d4282800 {
   compatible = "spacemit,k3-syscon-apmu";
   reg = <0x0 0xd4282800 0x0 0x400>;
   clocks = <&osc_32k>, <&vctcxo_1m>, <&vctcxo_3m>, <&vctcxo_24m>;
   clock-names = "osc", "vctcxo_1m", "vctcxo_3m", "vctcxo_24m";
   #clock-cells = <1>;
   #power-domain-cells = <1>;
   #reset-cells = <1>;
  };

  syscon_dciu: system-controller@d8440000 {
   compatible = "spacemit,k3-syscon-dciu";
   reg = <0x0 0xd8440000 0x0 0xc000>;
   #clock-cells = <1>;
   #reset-cells = <1>;
  };

  simsic: interrupt-controller@e0400000 {
   compatible = "spacemit,k3-imsics", "riscv,imsics";
   reg = <0x0 0xe0400000 0x0 0x200000>;
   #interrupt-cells = <0>;
   #msi-cells = <0>;
   interrupt-controller;
   interrupts-extended = <&cpu0_intc 9>, <&cpu1_intc 9>,
           <&cpu2_intc 9>, <&cpu3_intc 9>,
           <&cpu4_intc 9>, <&cpu5_intc 9>,
           <&cpu6_intc 9>, <&cpu7_intc 9>;
   msi-controller;
   riscv,guest-index-bits = <6>;
   riscv,hart-index-bits = <4>;
   riscv,num-guest-ids = <63>;
   riscv,num-ids = <511>;
  };

  saplic: interrupt-controller@e0804000 {
   compatible = "spacemit,k3-aplic", "riscv,aplic";
   reg = <0x0 0xe0804000 0x0 0x4000>;
   #interrupt-cells = <2>;
   interrupt-controller;
   msi-parent = <&simsic>;
   riscv,num-sources = <512>;
  };

  clint: timer@e081c000 {
   compatible = "spacemit,k3-clint", "sifive,clint0";
   reg = <0x0 0xe081c000 0x0 0x4000>;
   interrupts-extended = <&cpu0_intc 3>, <&cpu0_intc 7>,
           <&cpu1_intc 3>, <&cpu1_intc 7>,
           <&cpu2_intc 3>, <&cpu2_intc 7>,
           <&cpu3_intc 3>, <&cpu3_intc 7>,
           <&cpu4_intc 3>, <&cpu4_intc 7>,
           <&cpu5_intc 3>, <&cpu5_intc 7>,
           <&cpu6_intc 3>, <&cpu6_intc 7>,
           <&cpu7_intc 3>, <&cpu7_intc 7>;
  };



  mimsic: interrupt-controller@f1000000 {
   compatible = "spacemit,k3-imsics", "riscv,imsics";
   reg = <0x0 0xf1000000 0x0 0x10000>;
   #interrupt-cells = <0>;
   #msi-cells = <0>;
   interrupt-controller;
   interrupts-extended = <&cpu0_intc 11>, <&cpu1_intc 11>,
           <&cpu2_intc 11>, <&cpu3_intc 11>,
           <&cpu4_intc 11>, <&cpu5_intc 11>,
           <&cpu6_intc 11>, <&cpu7_intc 11>;
   msi-controller;
   riscv,hart-index-bits = <4>;
   riscv,num-ids = <511>;
   status = "reserved";
  };

  maplic: interrupt-controller@f1800000 {
   compatible = "spacemit,k3-aplic", "riscv,aplic";
   reg = <0x0 0xf1800000 0x0 0x4000>;
   #interrupt-cells = <2>;
   interrupt-controller;
   msi-parent = <&mimsic>;
   riscv,children = <&saplic>;
   riscv,delegation = <&saplic 1 512>;
   riscv,num-sources = <512>;
   status = "reserved";
  };

  espi0: espi@cac8c000 {
   compatible = "spacemit,k3-espi";
   reg = <0x0 0xcac8c000 0x0 0x1000>;
   #address-cells = <1>;
   #size-cells = <1>;
   ranges = <0x0 0x0 0x84000000 0x1000>;
   pr-mem-base0 = <0x84000000>;
   pr-mem-base1 = <0xcac8c000>;
   clocks = <&syscon_apmu 78>,
     <&syscon_apmu 79>,
     <&syscon_apmu 80>;
   clock-names = "sclk_src", "sclk", "mclk";
   resets = <&syscon_apmu 70>,
     <&syscon_apmu 71>;
   assigned-clocks = <&syscon_apmu 79>;
   assigned-clock-parents = <&syscon_apmu 78>;
   operating-frequency = <20>;
   io-mode = "single";
   alert-mode = "io1";
   alert-type = "open-drain";
   watchdog-timeout = <0xffff>;
   crc-enable;
   auto-gating-enable;
   peripheral-channel-enable;
   vwire-channel-enable;
   oob-channel-enable;
   flash-channel-enable;
   status = "disabled";

   ec: ec@0 {
    compatible = "google,cros-ec-espi";
    reg = <0x0 0x1000>;
    status = "disabled";
   };
  };
 };
};
# 9 "/tmp/k3-independent-audit/platforms/Platform/Spacemit/K3/DeviceTree/Os/Sources/arch/riscv/boot/dts/spacemit/k3-pico-itx.dts" 2
# 1 "/tmp/k3-independent-audit/platforms/Platform/Spacemit/K3/DeviceTree/Os/Sources/arch/riscv/boot/dts/spacemit/k3-display.dtsi" 1
# 13 "/tmp/k3-independent-audit/platforms/Platform/Spacemit/K3/DeviceTree/Os/Sources/arch/riscv/boot/dts/spacemit/k3-display.dtsi"
&soc {
 dpu0_crtc0: dpu@c0340000 {
  compatible = "spacemit,k3-saturn-dpu";
  reg = <0x0 0xc0340000 0x0 0x54000>;
  interrupts = <90 4>,
        <89 4>;
  interrupt-names = "online", "offline";
  clocks = <&syscon_apmu 21>,
    <&syscon_apmu 22>,
    <&syscon_apmu 52>,
    <&syscon_apmu 18>,
    <&syscon_apmu 20>;
  clock-names = "pxclk", "mclk", "aclk", "escclk", "dscclk";
  resets = <&syscon_apmu 7>,
    <&syscon_apmu 5>,
    <&syscon_apmu 4>,
    <&syscon_apmu 58>,
    <&syscon_apmu 8>;
  reset-names = "mclk", "lcd", "esc",
         "aclk", "dsc";
  status = "disabled";

  ports {
   #address-cells = <1>;
   #size-cells = <0>;

   port@0 {
    reg = <0>;
    dpu0_out: endpoint {
     remote-endpoint = <&edp0_in>;
    };
   };
  };
 };

 edp0: edp@cac84000 {
  compatible = "spacemit,k3-inno-dp";
  reg = <0x0 0xcac84000 0x0 0x4000>;
  interrupts = <132 4>;
  clocks = <&syscon_apmu 54>, <&edp0_phy>;
  clock-names = "pxclk", "pll";
  resets = <&syscon_apmu 60>;
  phys = <&edp0_phy>;
  phy-names = "dp";
  status = "disabled";

  edp0_phy: phy {
   compatible = "spacemit,k3-inno-dp-phy";
   #phy-cells = <0>;
   #clock-cells = <0>;
   clock-output-names = "edp0_pll_pxclk";
  };

  ports {
   #address-cells = <1>;
   #size-cells = <0>;

   port@0 {
    reg = <0>;
    edp0_in: endpoint {
     remote-endpoint = <&dpu0_out>;
    };
   };

   port@1 {
    reg = <1>;
    edp0_out: endpoint {
    };
   };
  };
 };

 dpu1_crtc0: dpu@c0440000 {
  compatible = "spacemit,k3-saturn-dpu";
  reg = <0x0 0xc0440000 0x0 0x54000>;
  interrupts = <139 4>,
        <138 4>;
  interrupt-names = "online", "offline";
  clocks = <&syscon_apmu 49>,
    <&syscon_apmu 50>,
    <&syscon_apmu 51>,
    <&syscon_apmu 47>,
    <&syscon_apmu 48>;
  clock-names = "pxclk", "mclk", "aclk", "escclk", "dscclk";
  resets = <&syscon_apmu 55>,
    <&syscon_apmu 54>,
    <&syscon_apmu 53>,
    <&syscon_apmu 57>,
    <&syscon_apmu 56>;
  reset-names = "mclk", "lcd", "esc",
         "aclk", "dsc";
  status = "disabled";

  ports {
   #address-cells = <1>;
   #size-cells = <0>;

   port@0 {
    reg = <0>;
    dpu1_out: endpoint {
     remote-endpoint = <&dp1_in>;
    };
   };
  };
 };

 dp1: dp@cac88000 {
  compatible = "spacemit,k3-inno-dp";
  reg = <0x0 0xcac88000 0x0 0x4000>;
  interrupts = <140 4>;
  clocks = <&syscon_apmu 55>, <&dp1_phy>;
  clock-names = "pxclk", "pll";
  resets = <&syscon_apmu 61>;
  phys = <&dp1_phy>;
  phy-names = "dp";
  status = "disabled";

  dp1_phy: phy {
   compatible = "spacemit,k3-inno-dp-phy";
   #phy-cells = <0>;
   #clock-cells = <0>;
   clock-output-names = "edp1_pll_pxclk";
  };

  ports {
   #address-cells = <1>;
   #size-cells = <0>;

   port@0 {
    reg = <0>;
    dp1_in: endpoint {
     remote-endpoint = <&dpu1_out>;
    };
   };

   port@1 {
    reg = <1>;
    dp1_out: endpoint {
    };
   };
  };
 };
};





&syscon_apmu {
 clocks = <&osc_32k>, <&vctcxo_1m>, <&vctcxo_3m>, <&vctcxo_24m>,
   <&edp0_phy>, <&dp1_phy>;
 clock-names = "osc", "vctcxo_1m", "vctcxo_3m", "vctcxo_24m",
        "edp0_pll_pxclk", "edp1_pll_pxclk";
};
# 10 "/tmp/k3-independent-audit/platforms/Platform/Spacemit/K3/DeviceTree/Os/Sources/arch/riscv/boot/dts/spacemit/k3-pico-itx.dts" 2
# 1 "/tmp/k3-independent-audit/platforms/Platform/Spacemit/K3/DeviceTree/Os/Sources/arch/riscv/boot/dts/spacemit/k3-pinctrl.dtsi" 1
# 13 "/tmp/k3-independent-audit/platforms/Platform/Spacemit/K3/DeviceTree/Os/Sources/arch/riscv/boot/dts/spacemit/k3-pinctrl.dtsi"
&pinctrl {
 /omit-if-no-ref/
 dp1_1_cfg: dp1-1-cfg {
  dp1-pins {
   pinmux = <(((24) << 16) | (6))>;

   bias-disable;
   drive-strength = <25>;
   power-source = <3300>;
  };
 };

 espi0_2_cfg: espi0-2-cfg {
  espi0-0-pins {
   pinmux = <(((91) << 16) | (4))>,
     <(((92) << 16) | (4))>,
     <(((93) << 16) | (4))>,
     <(((94) << 16) | (4))>,
     <(((95) << 16) | (4))>,
     <(((97) << 16) | (4))>,
     <(((98) << 16) | (4))>;

   bias-pull-up;
   drive-strength = <25>;
   power-source = <1800>;
  };

  espi0-1-pins {
   pinmux = <(((96) << 16) | (4))>;

   bias-pull-down;
   drive-strength = <25>;
   power-source = <1800>;
  };
 };

 gmac0_rgmii_0_cfg: gmac0-rgmii-0-cfg {
  gmac0-rgmii-0-pins {
   pinmux = <(((0) << 16) | (1))>,
     <(((1) << 16) | (1))>,
     <(((2) << 16) | (1))>,
     <(((3) << 16) | (1))>,
     <(((4) << 16) | (1))>,
     <(((5) << 16) | (1))>,
     <(((6) << 16) | (1))>,
     <(((7) << 16) | (1))>,
     <(((8) << 16) | (1))>,
     <(((9) << 16) | (1))>,
     <(((10) << 16) | (1))>,
     <(((11) << 16) | (1))>,
     <(((12) << 16) | (1))>,
     <(((13) << 16) | (1))>;

   bias-disable;
   drive-strength = <25>;
   power-source = <1800>;
  };

 };

 gmac0_phy_0_cfg: gmac0-phy-0-cfg {
  gmac0-phy-0-pins {
   pinmux = <(((14) << 16) | (1))>;

   bias-disable;
   drive-strength = <25>;
   power-source = <1800>;
  };
 };

 gmac1_rgmii_0_cfg: gmac1-rgmii-0-cfg {
  gmac1-rgmii-0-pins {
   pinmux = <(((21) << 16) | (1))>,
     <(((22) << 16) | (1))>,
     <(((23) << 16) | (1))>,
     <(((24) << 16) | (1))>,
     <(((25) << 16) | (1))>,
     <(((26) << 16) | (1))>,
     <(((27) << 16) | (1))>,
     <(((28) << 16) | (1))>,
     <(((29) << 16) | (1))>,
     <(((30) << 16) | (1))>,
     <(((31) << 16) | (1))>,
     <(((32) << 16) | (1))>,
     <(((33) << 16) | (1))>,
     <(((34) << 16) | (1))>;

   bias-disable;
   drive-strength = <25>;
   power-source = <1800>;
  };
 };

 gmac1_phy_0_cfg: gmac1-phy-0-cfg {
  gmac1-phy-0-pins {
   pinmux = <(((35) << 16) | (1))>;

   bias-disable;
   drive-strength = <25>;
   power-source = <1800>;
  };
 };

 /omit-if-no-ref/
 i2c0_0_cfg: i2c0-0-cfg {
  i2c0-0-pins {
   pinmux = <(((0) << 16) | (6))>,
     <(((1) << 16) | (6))>;

   bias-pull-up = <1>;
   drive-strength = <25>;
   power-source = <3300>;
  };
 };

 /omit-if-no-ref/
 i2c1_1_cfg: i2c1-1-cfg {
  i2c1-1-pins {
   pinmux = <(((54) << 16) | (5))>,
     <(((55) << 16) | (5))>;

   bias-pull-up = <1>;
   drive-strength = <25>;
   power-source = <1800>;
  };
 };

 i2c1_3_cfg: i2c1-3-cfg {
  i2c1-0-pins {
   pinmux = <(((102) << 16) | (6))>,
     <(((103) << 16) | (6))>;

   bias-pull-up;
   drive-strength = <25>;
  };
 };

 /omit-if-no-ref/
 i2c2_1_cfg: i2c2-1-cfg {
  i2c2-1-pins {
   pinmux = <(((46) << 16) | (5))>,
     <(((47) << 16) | (5))>;

   bias-pull-up = <0>;
   drive-strength = <25>;
  };
 };

 /omit-if-no-ref/
 i2c6_1_cfg: i2c6-1-cfg {
  i2c6-1-pins {
   pinmux = <(((7) << 16) | (6))>,
     <(((8) << 16) | (6))>;

   bias-pull-up = <0>;
   drive-strength = <25>;
  };
 };

 /omit-if-no-ref/
 i2c8_cfg: i2c8-cfg {
  i2c8-pins {
   pinmux = <(((128) << 16) | (0))>,
     <(((129) << 16) | (0))>;

   bias-pull-up = <0>;
   drive-strength = <25>;
  };
 };

 /omit-if-no-ref/
 pwm0_0_cfg: pwm0-0-cfg {
  pwm0-0-pins {
   pinmux = <(((0) << 16) | (3))>;

   bias-pull-up = <0>;
   drive-strength = <25>;
  };
 };

 /omit-if-no-ref/
 pwm0_1_cfg: pwm0-1-cfg {
  pwm0-1-pins {
   pinmux = <(((42) << 16) | (6))>;

   bias-pull-up = <0>;
   drive-strength = <25>;
  };
 };

 /omit-if-no-ref/
 pwm1_0_cfg: pwm1-0-cfg {
  pwm1-0-pins {
   pinmux = <(((1) << 16) | (3))>;

   bias-pull-up = <0>;
   drive-strength = <25>;
  };
 };

 /omit-if-no-ref/
 pwm1_1_cfg: pwm1-1-cfg {
  pwm1-1-pins {
   pinmux = <(((43) << 16) | (6))>;

   bias-pull-up = <0>;
   drive-strength = <25>;
  };
 };

 /omit-if-no-ref/
 pwm1_2_cfg: pwm1-2-cfg {
  pwm1-2-pins {
   pinmux = <(((95) << 16) | (6))>;

   bias-pull-up = <0>;
   drive-strength = <25>;
  };
 };

 /omit-if-no-ref/
 pwm2_0_cfg: pwm2-0-cfg {
  pwm2-0-pins {
   pinmux = <(((2) << 16) | (3))>;

   bias-pull-up = <0>;
   drive-strength = <25>;
  };
 };

 /omit-if-no-ref/
 pwm2_1_cfg: pwm2-1-cfg {
  pwm2-1-pins {
   pinmux = <(((44) << 16) | (6))>;

   bias-pull-up = <0>;
   drive-strength = <25>;
  };
 };

 /omit-if-no-ref/
 pwm2_2_cfg: pwm2-2-cfg {
  pwm2-2-pins {
   pinmux = <(((96) << 16) | (6))>;

   bias-pull-up = <0>;
   drive-strength = <25>;
  };
 };

 /omit-if-no-ref/
 pwm2_3_cfg: pwm2-3-cfg {
  pwm2-3-pins {
   pinmux = <(((134) << 16) | (4))>;

   bias-pull-up = <0>;
   drive-strength = <25>;
  };
 };

 /omit-if-no-ref/
 pwm3_0_cfg: pwm3-0-cfg {
  pwm3-0-pins {
   pinmux = <(((3) << 16) | (3))>;

   bias-pull-up = <0>;
   drive-strength = <25>;
  };
 };

 /omit-if-no-ref/
 pwm3_1_cfg: pwm3-1-cfg {
  pwm3-1-pins {
   pinmux = <(((45) << 16) | (6))>;

   bias-pull-up = <0>;
   drive-strength = <25>;
  };
 };

 /omit-if-no-ref/
 pwm3_2_cfg: pwm3-2-cfg {
  pwm3-2-pins {
   pinmux = <(((97) << 16) | (6))>;

   bias-pull-up = <0>;
   drive-strength = <25>;
  };
 };

 /omit-if-no-ref/
 pwm3_3_cfg: pwm3-3-cfg {
  pwm3-3-pins {
   pinmux = <(((135) << 16) | (4))>;

   bias-pull-up = <0>;
   drive-strength = <25>;
  };
 };

 /omit-if-no-ref/
 pwm4_0_cfg: pwm4-0-cfg {
  pwm4-0-pins {
   pinmux = <(((4) << 16) | (3))>;

   bias-pull-up = <0>;
   drive-strength = <25>;
  };
 };

 /omit-if-no-ref/
 pwm4_1_cfg: pwm4-1-cfg {
  pwm4-1-pins {
   pinmux = <(((46) << 16) | (6))>;

   bias-pull-up = <0>;
   drive-strength = <25>;
  };
 };

 /omit-if-no-ref/
 pwm4_2_cfg: pwm4-2-cfg {
  pwm4-2-pins {
   pinmux = <(((136) << 16) | (4))>;

   bias-pull-up = <0>;
   drive-strength = <25>;
  };
 };

 /omit-if-no-ref/
 pwm5_0_cfg: pwm5-0-cfg {
  pwm5-0-pins {
   pinmux = <(((5) << 16) | (3))>;

   bias-pull-up = <0>;
   drive-strength = <25>;
  };
 };

 /omit-if-no-ref/
 pwm5_1_cfg: pwm5-1-cfg {
  pwm5-1-pins {
   pinmux = <(((47) << 16) | (6))>;

   bias-pull-up = <0>;
   drive-strength = <25>;
  };
 };

 /omit-if-no-ref/
 pwm5_2_cfg: pwm5-2-cfg {
  pwm5-2-pins {
   pinmux = <(((137) << 16) | (4))>;

   bias-pull-up = <0>;
   drive-strength = <25>;
  };
 };

 /omit-if-no-ref/
 pwm6_0_cfg: pwm6-0-cfg {
  pwm6-0-pins {
   pinmux = <(((6) << 16) | (3))>;

   bias-pull-up = <0>;
   drive-strength = <25>;
  };
 };

 /omit-if-no-ref/
 pwm6_1_cfg: pwm6-1-cfg {
  pwm6-1-pins {
   pinmux = <(((145) << 16) | (3))>;

   bias-pull-up = <0>;
   drive-strength = <25>;
  };
 };

 /omit-if-no-ref/
 pwm6_2_cfg: pwm6-2-cfg {
  pwm6-2-pins {
   pinmux = <(((48) << 16) | (6))>;

   bias-pull-up = <0>;
   drive-strength = <25>;
  };
 };

 /omit-if-no-ref/
 pwm7_0_cfg: pwm7-0-cfg {
  pwm7-0-pins {
   pinmux = <(((7) << 16) | (3))>;

   bias-pull-up = <0>;
   drive-strength = <25>;
  };
 };

 /omit-if-no-ref/
 pwm7_1_cfg: pwm7-1-cfg {
  pwm7-1-pins {
   pinmux = <(((146) << 16) | (3))>;

   bias-pull-up = <0>;
   drive-strength = <25>;
  };
 };

 /omit-if-no-ref/
 pwm7_2_cfg: pwm7-2-cfg {
  pwm7-2-pins {
   pinmux = <(((49) << 16) | (6))>;

   bias-pull-up = <0>;
   drive-strength = <25>;
  };
 };

 /omit-if-no-ref/
 pwm8_0_cfg: pwm8-0-cfg {
  pwm8-0-pins {
   pinmux = <(((8) << 16) | (3))>;

   bias-pull-up = <0>;
   drive-strength = <25>;
  };
 };

 /omit-if-no-ref/
 pwm8_1_cfg: pwm8-1-cfg {
  pwm8-1-pins {
   pinmux = <(((147) << 16) | (3))>;

   bias-pull-up = <0>;
   drive-strength = <25>;
  };
 };

 /omit-if-no-ref/
 pwm8_2_cfg: pwm8-2-cfg {
  pwm8-2-pins {
   pinmux = <(((50) << 16) | (6))>;

   bias-pull-up = <0>;
   drive-strength = <25>;
  };
 };

 /omit-if-no-ref/
 pwm9_0_cfg: pwm9-0-cfg {
  pwm9-0-pins {
   pinmux = <(((9) << 16) | (3))>;

   bias-pull-up = <0>;
   drive-strength = <25>;
  };
 };

 /omit-if-no-ref/
 pwm9_1_cfg: pwm9-1-cfg {
  pwm9-1-pins {
   pinmux = <(((148) << 16) | (3))>;

   bias-pull-up = <0>;
   drive-strength = <25>;
  };
 };

 /omit-if-no-ref/
 pwm9_2_cfg: pwm9-2-cfg {
  pwm9-2-pins {
   pinmux = <(((51) << 16) | (6))>;

   bias-pull-up = <0>;
   drive-strength = <25>;
  };
 };

 /omit-if-no-ref/
 pwm10_0_cfg: pwm10-0-cfg {
  pwm10-0-pins {
   pinmux = <(((10) << 16) | (3))>;

   bias-pull-up = <0>;
   drive-strength = <25>;
  };
 };

 /omit-if-no-ref/
 pwm10_1_cfg: pwm10-1-cfg {
  pwm10-1-pins {
   pinmux = <(((52) << 16) | (6))>;

   bias-pull-up = <0>;
   drive-strength = <25>;
  };
 };

 /omit-if-no-ref/
 pwm10_2_cfg: pwm10-2-cfg {
  pwm10-2-pins {
   pinmux = <(((141) << 16) | (4))>;

   bias-pull-up = <0>;
   drive-strength = <25>;
  };
 };

 /omit-if-no-ref/
 pwm11_0_cfg: pwm11-0-cfg {
  pwm11-0-pins {
   pinmux = <(((53) << 16) | (6))>;

   bias-pull-up = <0>;
   drive-strength = <25>;
  };
 };

 /omit-if-no-ref/
 pwm11_1_cfg: pwm11-1-cfg {
  pwm11-1-pins {
   pinmux = <(((140) << 16) | (4))>;

   bias-pull-up = <0>;
   drive-strength = <25>;
  };
 };

 /omit-if-no-ref/
 pwm12_0_cfg: pwm12-0-cfg {
  pwm12-0-pins {
   pinmux = <(((54) << 16) | (6))>;

   bias-pull-up = <0>;
   drive-strength = <25>;
  };
 };

 /omit-if-no-ref/
 pwm12_1_cfg: pwm12-1-cfg {
  pwm12-1-pins {
   pinmux = <(((139) << 16) | (4))>;

   bias-pull-up = <0>;
   drive-strength = <25>;
  };
 };

 /omit-if-no-ref/
 pwm13_0_cfg: pwm13-0-cfg {
  pwm13-0-pins {
   pinmux = <(((55) << 16) | (6))>;

   bias-pull-up = <0>;
   drive-strength = <25>;
  };
 };

 /omit-if-no-ref/
 pwm13_1_cfg: pwm13-1-cfg {
  pwm13-1-pins {
   pinmux = <(((138) << 16) | (4))>;

   bias-pull-up = <0>;
   drive-strength = <25>;
  };
 };

 /omit-if-no-ref/
 pwm13_2_cfg: pwm13-2-cfg {
  pwm13-2-pins {
   pinmux = <(((13) << 16) | (3))>;

   bias-pull-up = <0>;
   drive-strength = <25>;
  };
 };

 /omit-if-no-ref/
 pwm14_0_cfg: pwm14-0-cfg {
  pwm14-0-pins {
   pinmux = <(((56) << 16) | (6))>;

   bias-pull-up = <0>;
   drive-strength = <25>;
  };
 };

 /omit-if-no-ref/
 pwm14_1_cfg: pwm14-1-cfg {
  pwm14-1-pins {
   pinmux = <(((144) << 16) | (4))>;

   bias-pull-up = <0>;
   drive-strength = <25>;
  };
 };

 /omit-if-no-ref/
 pwm14_2_cfg: pwm14-2-cfg {
  pwm14-2-pins {
   pinmux = <(((14) << 16) | (3))>;

   bias-pull-up = <0>;
   drive-strength = <25>;
  };
 };

 /omit-if-no-ref/
 pwm15_0_cfg: pwm15-0-cfg {
  pwm15-0-pins {
   pinmux = <(((57) << 16) | (6))>;

   bias-pull-up = <0>;
   drive-strength = <25>;
  };
 };

 /omit-if-no-ref/
 pwm15_1_cfg: pwm15-1-cfg {
  pwm15-1-pins {
   pinmux = <(((142) << 16) | (4))>;

   bias-pull-up = <0>;
   drive-strength = <25>;
  };
 };

 /omit-if-no-ref/
 pwm15_2_cfg: pwm15-2-cfg {
  pwm15-2-pins {
   pinmux = <(((21) << 16) | (3))>;

   bias-pull-up = <0>;
   drive-strength = <25>;
  };
 };

 /omit-if-no-ref/
 pwm16_0_cfg: pwm16-0-cfg {
  pwm16-0-pins {
   pinmux = <(((58) << 16) | (6))>;

   bias-pull-up = <0>;
   drive-strength = <25>;
  };
 };

 /omit-if-no-ref/
 pwm16_1_cfg: pwm16-1-cfg {
  pwm16-1-pins {
   pinmux = <(((143) << 16) | (4))>;

   bias-pull-up = <0>;
   drive-strength = <25>;
  };
 };

 /omit-if-no-ref/
 pwm16_2_cfg: pwm16-2-cfg {
  pwm16-2-pins {
   pinmux = <(((22) << 16) | (3))>;

   bias-pull-up = <0>;
   drive-strength = <25>;
  };
 };

 /omit-if-no-ref/
 pwm17_0_cfg: pwm17-0-cfg {
  pwm17-0-pins {
   pinmux = <(((23) << 16) | (3))>;

   bias-pull-up = <0>;
   drive-strength = <25>;
  };
 };

 /omit-if-no-ref/
 pwm17_1_cfg: pwm17-1-cfg {
  pwm17-1-pins {
   pinmux = <(((59) << 16) | (6))>;

   bias-pull-up = <0>;
   drive-strength = <25>;
  };
 };

 /omit-if-no-ref/
 pwm17_2_cfg: pwm17-2-cfg {
  pwm17-2-pins {
   pinmux = <(((105) << 16) | (6))>;

   bias-pull-up = <0>;
   drive-strength = <25>;
  };
 };

 /omit-if-no-ref/
 pwm18_0_cfg: pwm18-0-cfg {
  pwm18-0-pins {
   pinmux = <(((24) << 16) | (3))>;

   bias-pull-up = <0>;
   drive-strength = <25>;
  };
 };

 /omit-if-no-ref/
 pwm18_1_cfg: pwm18-1-cfg {
  pwm18-1-pins {
   pinmux = <(((60) << 16) | (6))>;

   bias-pull-up = <0>;
   drive-strength = <25>;
  };
 };

 /omit-if-no-ref/
 pwm18_2_cfg: pwm18-2-cfg {
  pwm18-2-pins {
   pinmux = <(((106) << 16) | (6))>;

   bias-pull-up = <0>;
   drive-strength = <25>;
  };
 };

 /omit-if-no-ref/
 pwm19_0_cfg: pwm19-0-cfg {
  pwm19-0-pins {
   pinmux = <(((25) << 16) | (3))>;

   bias-pull-up = <0>;
   drive-strength = <25>;
  };
 };

 /omit-if-no-ref/
 pwm19_1_cfg: pwm19-1-cfg {
  pwm19-1-pins {
   pinmux = <(((61) << 16) | (6))>;

   bias-pull-up = <0>;
   drive-strength = <25>;
  };
 };

 /omit-if-no-ref/
 pwm19_2_cfg: pwm19-2-cfg {
  pwm19-2-pins {
   pinmux = <(((107) << 16) | (6))>;

   bias-pull-up = <0>;
   drive-strength = <25>;
  };
 };

 /omit-if-no-ref/
 qspi_cfg: qspi-cfg {
  qspi-pins {
   pinmux = <(((138) << 16) | (0))>,
     <(((139) << 16) | (0))>,
     <(((140) << 16) | (0))>,
     <(((141) << 16) | (0))>,
     <(((144) << 16) | (0))>;

   bias-disable;
   drive-strength = <25>;
  };

  qspi-cs0-pins {
   pinmux = <(((142) << 16) | (0))>;

   bias-disable;
   drive-strength = <25>;
  };
 };

 /omit-if-no-ref/
 uart0_0_cfg: uart0-0-cfg {
  uart0-0-pins {
   pinmux = <(((149) << 16) | (2))>,
     <(((150) << 16) | (2))>;

   bias-pull-up = <0>;
   drive-strength = <25>;
  };
 };

 mmc1_cfg: mmc1-cfg {
  mmc1-data-cmd-pins {
   pinmux = <(((132) << 16) | (0))>,
     <(((133) << 16) | (0))>,
     <(((134) << 16) | (0))>,
     <(((135) << 16) | (0))>,
     <(((136) << 16) | (0))>;

   bias-pull-up = <0>;
   drive-strength = <25>;
   power-source = <3300>;
  };

  mmc1-clk-pins {
   pinmux = <(((137) << 16) | (0))>;

   bias-pull-down;
   drive-strength = <25>;
   power-source = <3300>;
  };
 };

 mmc1_uhs_cfg: mmc1-uhs-cfg {
  mmc1-uhs-data-cmd-pins {
   pinmux = <(((132) << 16) | (0))>,
     <(((133) << 16) | (0))>,
     <(((134) << 16) | (0))>,
     <(((135) << 16) | (0))>,
     <(((136) << 16) | (0))>;

   bias-pull-up = <0>;
   drive-strength = <21>;
   power-source = <1800>;
  };

  mmc1-uhs-clk-pins {
   pinmux = <(((137) << 16) | (0))>;

   bias-pull-down;
   drive-strength = <21>;
   power-source = <1800>;
  };
 };

 pcie0_0_cfg: pcie0-0-cfg {
  pcie0-0-pins {
   pinmux = <(((79) << 16) | (5))>,
     <(((81) << 16) | (5))>;

   bias-pull-up = <1>;
   drive-strength = <33>;
   power-source = <1800>;
  };
 };

 pcie0_1_cfg: pcie0-1-cfg {
  pcie0-0-pins {
   pinmux = <(((79) << 16) | (5))>,
     <(((81) << 16) | (5))>;

   bias-pull-up = <1>;
   drive-strength = <38>;
   power-source = <3300>;
  };
 };

 pcie2_0_cfg: pcie2-0-cfg {
  pcie2-0-pins {
   pinmux = <(((25) << 16) | (4))>,
     <(((27) << 16) | (4))>;

   drive-strength = <38>;
   power-source = <3300>;
  };
 };

 pcie3_0_cfg: pcie3-0-cfg {
  pcie3-0-pins {
   pinmux = <(((3) << 16) | (4))>,
     <(((5) << 16) | (4))>;

   bias-pull-up = <1>;
   drive-strength = <38>;
   power-source = <3300>;
  };
 };

 pcie4_0_cfg: pcie4-0-cfg {
  pcie4-0-pins {
   pinmux = <(((76) << 16) | (5))>,
     <(((77) << 16) | (5))>,
     <(((78) << 16) | (5))>;

   bias-pull-up = <1>;
   drive-strength = <33>;
   power-source = <1800>;
  };
 };

 pcie4_1_cfg: pcie4-1-cfg {
  pcie4-0-pins {
   pinmux = <(((76) << 16) | (5))>,
     <(((78) << 16) | (5))>;

   bias-pull-up = <1>;
   drive-strength = <38>;
   power-source = <3300>;
  };
 };

 usb30_drd_dir_0_cfg: usb30_drd_dir-0-cfg {
  usb30_drd_dir-pins {
   pinmux = <(((86) << 16) | (6))>;

   bias-pull-down;
   drive-strength = <25>;
   power-source = <1800>;
  };
 };
};
# 11 "/tmp/k3-independent-audit/platforms/Platform/Spacemit/K3/DeviceTree/Os/Sources/arch/riscv/boot/dts/spacemit/k3-pico-itx.dts" 2

/ {
 model = "SpacemiT K3 Pico-ITX";
 compatible = "spacemit,k3-pico-itx", "spacemit,k3";

 aliases {
  ethernet0 = &eth0;
  i2c2 = &i2c2;
  i2c8 = &i2c8;
  serial0 = &uart0;
 };

 chosen {
  stdout-path = "serial0:115200n8";
 };

 memory@100000000 {
  device_type = "memory";
  reg = <0x1 0x00000000 0x4 0x00000000>;
 };

 fan0: pwm-fan {
  compatible = "pwm-fan";
  pwms = <&cros_ec_pwm 0>;
 };

 reg_aux_vcc3v3: regulator-aux-vcc3v3 {
  compatible = "regulator-fixed";
  regulator-name = "AUX_VCC3V3";
  regulator-min-microvolt = <3300000>;
  regulator-max-microvolt = <3300000>;
  regulator-always-on;
 };

 reg_aux_vcc5v: regulator-aux-vcc5v {
  compatible = "regulator-fixed";
  regulator-name = "AUX_VCC5V";
  regulator-min-microvolt = <5000000>;
  regulator-max-microvolt = <5000000>;
  regulator-always-on;
 };

 rfkill-pcie-wlan {
  compatible = "rfkill-gpio";
  label = "rfkill-pcie-wlan";
  radio-type = "wlan";
  shutdown-gpios = <&gpio 1 3 0>;
 };

 rfkill-usb-bt {
  compatible = "rfkill-gpio";
  label = "rfkill-usb-bt";
  radio-type = "bluetooth";
  shutdown-gpios = <&gpio 0 30 0>;
 };
};

&i2c1 {
 pinctrl-names = "default";
 pinctrl-0 = <&i2c1_3_cfg>;
 status = "okay";

 tcpc@25 {
  compatible = "onsemi,fusb301";
  reg = <0x25>;
  irq-gpios = <&gpio 2 21 1>;
  suspend-vbus-off;
  wakeup-source;
  status = "okay";

  typec_0: connector@0 {
   compatible = "usb-c-connector";
   label = "USB-C";
   data-role = "dual";
   power-role = "dual";
   try-power-role = "sink";
   typec-power-opmode = "default";
   pd-disable;

   ports {
    #address-cells = <0x1>;
    #size-cells = <0x0>;

    port@0 {
     reg = <0x0>;
     fusb301_ep: endpoint {
      remote-endpoint = <&porta_role_switch>;
     };
    };
   };
  };
 };
};

&i2c2 {
 pinctrl-names = "default";
 pinctrl-0 = <&i2c2_1_cfg>;
 status = "okay";

 eeprom@50 {
  compatible = "atmel,24c02";
  reg = <0x50>;
  pagesize = <8>;
  read-only;
  size = <256>;
  status = "okay";

  nvmem-layout {
   compatible = "onie,tlv-layout";

   mac-address {
    #nvmem-cell-cells = <1>;
   };

   num-macs {
   };

   part-number {
   };

   product-name {
   };

   serial-number {
   };

  };
 };
};

&i2c8 {
 pinctrl-names = "default";
 pinctrl-0 = <&i2c8_cfg>;
 status = "okay";

 p1@41 {
  compatible = "spacemit,p1";
  reg = <0x41>;
  interrupts = <64 4>;
  vin1-supply = <&reg_aux_vcc5v>;
  vin2-supply = <&reg_aux_vcc5v>;
  vin3-supply = <&reg_aux_vcc5v>;
  vin4-supply = <&reg_aux_vcc5v>;
  vin5-supply = <&reg_aux_vcc5v>;
  vin6-supply = <&reg_aux_vcc5v>;
  aldoin-supply = <&reg_aux_vcc5v>;
  dldoin1-supply = <&buck4>;
  dldoin2-supply = <&buck4>;

  regulators {
   buck1: buck1 {
    regulator-min-microvolt = <1050000>;
    regulator-max-microvolt = <1050000>;
    regulator-ramp-delay = <5000>;
    regulator-always-on;
   };

   buck2: buck2 {
    regulator-min-microvolt = <1050000>;
    regulator-max-microvolt = <1050000>;
    regulator-ramp-delay = <5000>;
    regulator-always-on;
   };

   buck3: buck3 {
    regulator-min-microvolt = <800000>;
    regulator-max-microvolt = <800000>;
    regulator-ramp-delay = <5000>;
    regulator-always-on;
   };

   buck4: buck4 {
    regulator-min-microvolt = <2100000>;
    regulator-max-microvolt = <2100000>;
    regulator-ramp-delay = <5000>;
    regulator-always-on;
   };

   buck5: buck5 {
    regulator-min-microvolt = <1800000>;
    regulator-max-microvolt = <1800000>;
    regulator-ramp-delay = <5000>;
    regulator-always-on;
   };

   buck6: buck6 {
    regulator-min-microvolt = <500000>;
    regulator-max-microvolt = <500000>;
    regulator-ramp-delay = <5000>;
    regulator-always-on;
   };

   aldo1: aldo1 {
    regulator-min-microvolt = <1800000>;
    regulator-max-microvolt = <3300000>;
    regulator-always-on;
    regulator-boot-on;
   };

   aldo2: aldo2 {
    regulator-min-microvolt = <1800000>;
    regulator-max-microvolt = <1800000>;
    regulator-always-on;
    regulator-boot-on;
   };

   aldo3: aldo3 {
    regulator-min-microvolt = <500000>;
    regulator-max-microvolt = <3400000>;
   };

   aldo4: aldo4 {
    regulator-min-microvolt = <3300000>;
    regulator-max-microvolt = <3300000>;
    regulator-always-on;
    regulator-boot-on;
   };

   dldo1: dldo1 {
    regulator-min-microvolt = <1200000>;
    regulator-max-microvolt = <1200000>;
    regulator-always-on;
    regulator-boot-on;
   };

   dldo2: dldo2 {
    regulator-min-microvolt = <900000>;
    regulator-max-microvolt = <900000>;
    regulator-always-on;
    regulator-boot-on;
   };

   dldo3: dldo3 {
    regulator-min-microvolt = <800000>;
    regulator-max-microvolt = <800000>;
    regulator-always-on;
    regulator-boot-on;
   };

   dldo4: dldo4 {
    regulator-min-microvolt = <1800000>;
    regulator-max-microvolt = <1800000>;
    regulator-boot-on;
   };

   dldo5: dldo5 {
    regulator-min-microvolt = <1800000>;
    regulator-max-microvolt = <1800000>;
    regulator-always-on;
    regulator-boot-on;
   };

   dldo6: dldo6 {
    regulator-min-microvolt = <1800000>;
    regulator-max-microvolt = <1800000>;
    regulator-always-on;
    regulator-boot-on;
   };

   dldo7: dldo7 {
    regulator-min-microvolt = <1800000>;
    regulator-max-microvolt = <1800000>;
    regulator-always-on;
    regulator-boot-on;
   };
  };
 };
};

&combophy {
 spacemit,apmu = <&syscon_apmu 0x11>;
 status = "okay";
};

&eth0 {
 pinctrl-names = "default";
 pinctrl-0 = <&gmac0_rgmii_0_cfg>, <&gmac0_phy_0_cfg>;
 phy-mode = "rgmii-id";
 phy-handle = <&phy0>;
 status = "okay";

 mdio {
  phy0: ethernet-phy@1 {
   compatible = "ethernet-phy-id001c.c916";
   reg = <1>;
   reset-gpios = <&gpio 0 15 1>;
   reset-assert-us = <10000>;
   reset-deassert-us = <50000>;
   realtek,aldps-enable;
   realtek,clkout-disable;
  };
 };
};

&qspi_cfg {
 qspi-pins {
  power-source = <1800>;
 };

 qspi-cs0-pins {
  power-source = <1800>;
 };
};

&qspi {
 pinctrl-names = "default";
 pinctrl-0 = <&qspi_cfg>;
 status = "okay";

 flash@0 {
  compatible = "jedec,spi-nor";
  reg = <0>;
  spi-max-frequency = <26500000>;
  spi-rx-bus-width = <4>;
  spi-tx-bus-width = <4>;
  vcc-supply = <&aldo2>;
  m25p,fast-read;

  partitions {
   compatible = "fixed-partitions";
   #address-cells = <1>;
   #size-cells = <1>;

   bootinfo@0 {
    reg = <0x0 0x20000>;
   };

   fsbl@20000 {
    reg = <0x20000 0x80000>;
   };

   env@a0000 {
    reg = <0xa0000 0x10000>;
   };

   esos@b0000 {
    reg = <0xb0000 0x100000>;
   };

   opensbi@1b0000 {
    reg = <0x1b0000 0x60000>;
   };

   uboot@210000 {
    reg = <0x210000 0x5f0000>;
   };
  };
 };
};

&pcie0_rc {
 pinctrl-names = "default";
 pinctrl-0 = <&pcie0_0_cfg>;
 num-lanes = <4>;
 status = "okay";

 pcie@0 {
  vpcie3v3-supply = <&reg_aux_vcc3v3>;
  phys = <&combophy 0 2>,
         <&combophy 1 2>;
 };
};

&pcie2_rc {
 pinctrl-names = "default";
 pinctrl-0 = <&pcie2_0_cfg>;
 num-lanes = <2>;
 status = "okay";

 pcie@0 {
  vpcie3v3-supply = <&reg_aux_vcc3v3>;
  phys = <&combophy 2 2>,
         <&combophy 3 2>;
 };
};

&pcie4_rc {
 pinctrl-names = "default";
 pinctrl-0 = <&pcie4_0_cfg>;
 num-lanes = <1>;
 status = "okay";

 pcie@0 {
  vpcie3v3-supply = <&reg_aux_vcc3v3>;
  phys = <&combophy 5 2>;
 };
};

&uart0 {
 pinctrl-names = "default";
 pinctrl-0 = <&uart0_0_cfg>;
 status = "okay";
};

&ufshc {
 status = "okay";
};

&usb2_host {
 #address-cells = <1>;
 #size-cells = <0>;
 status = "okay";

 hub@1 {
  compatible = "usb1a40,0101";
  reg = <1>;
  vdd-supply = <&reg_aux_vcc3v3>;
 };
};

&usb2_phy {
 status = "okay";
};

&usb3a_u2phy {
 status = "okay";
};

&usb3a_u3phy {
 pinctrl-names = "default";
 pinctrl-0 = <&usb30_drd_dir_0_cfg>;
 status = "okay";
};

&usb3a {
 dr_mode = "otg";
 usb-role-switch;
 role-switch-default-mode = "peripheral";
 monitor-vbus;
 reset-on-resume;
 status = "okay";

 ports {
  #address-cells = <1>;
  #size-cells = <0>;
  port@0 {
   reg = <0x0>;
   porta_role_switch: endpoint {
    remote-endpoint = <&fusb301_ep>;
   };
  };
 };
};

&usb3b {
 phys = <&usb3b_u2phy>;
 phy-names = "usb2-phy";
 maximum-speed = "high-speed";
 status = "okay";
};

&usb3b_u2phy {
 status = "okay";
};

&usb3c {
 phys = <&usb3c_u2phy>;
 phy-names = "usb2-phy";
 maximum-speed = "high-speed";
 status = "okay";
};

&usb3c_u2phy {
 status = "okay";
};

&usb3d_u2phy {
 status = "okay";
};

&usb3d {
 phys = <&usb3d_u2phy>, <&combophy 4 4>;
 phy-names = "usb2-phy", "usb3-phy";
 status = "okay";
};

&dpu1_crtc0 {
 status = "okay";
};

&dp1 {
 pinctrl-names = "default";
 pinctrl-0 = <&dp1_1_cfg>;
 status = "okay";
};

&espi0 {
 pinctrl-names = "default";
 pinctrl-0 = <&espi0_2_cfg>;
 status = "okay";
 ec: ec@0 {
  status = "okay";
  interrupt-parent = <&gpio>;
  interrupts = <1 11 1>;
  gpio-controller;
  #gpio-cells = <2>;

  cros_ec_pwm: pwm {
   compatible = "google,cros-ec-pwm";
   #pwm-cells = <1>;
  };
 };
};
# 3 "/tmp/k3-independent-audit/platforms/Platform/Spacemit/K3/DeviceTree/Os/k3-pico-itx.os.dts" 2
